## airoha/mcu/dts/bindings/ab162x/airoha,air-qdec.yaml
```yaml
# SPDX-License-Identifier: Apache-2.0

description: |
    This is a representation of the qdec sensor

compatible: "airoha,air-qdec"

include: [base.yaml, pinctrl-device.yaml]

properties:
    reg:
      required: true

    interrupts:
      required: true

    led_force_off:
        type: int
        default: 0
        description: |
         close led


    led_active_output:
        type: int
        default: 0
        description: |
         led active output value

    z_sum_thr:
        type: int
        default: 2
        description: |
         z sum irq thr setting

    smp_period_a:
        type: int
        default: 3
        description: |
         A reg:sample period 

    led_period_a:
        type: int
        default: 3
        description: |
         A reg: sample period -> led open time

    dbc_count_a:
        type: int
        default: 0
        description: |
         A reg: debounce conut setting

    smp_period_b:
        type: int
        default: 10
        description: |
         B reg:sample period 

    led_period_b:
        type: int
        default: 10
        description: |
         B reg: sample period -> led open time

    dbc_count_b:
        type: int
        default: 10
        description: |
         B reg: debounce conut setting
    pina:
        type: int
        default: 0
        description: |
         pina

    pinb:
        type: int
        default: 1
        description: |
         pinb
    pin_led:
        type: int
        default: 4
        description: |
         led pin
```

## airoha/mcu/dts/bindings/ab162x/airoha,air-ramboz.yaml
```yaml
# SPDX-License-Identifier: Apache-2.0

description: |
    This is a representation of the ramboz sensor

compatible: "airoha,air-ramboz"

include: base.yaml

properties:
    reg:
      required: true

    interrupts:
      required: true

    direction:
        type: int
        default: 0
        description: |
         close led


    mode:
        type: int
        default: 0
        description: |
         led active output value

    filter_period:
        type: int
        default: 9
        description: |
         z sum irq thr setting

    fast_sample_period:
        type: int
        default: 10
        description: |
         A reg:sample period 

    slow_sample_period:
        type: int
        default: 255
        description: |
         A reg: sample period -> led open time

    fast_roll_period:
        type: int
        default: 10
        description: |
         A reg: debounce conut setting

    pin_led:
        type: int
        default: 12
        description: |
         pinb

    pin_mcu_ctrl:
        type: int
        default: 13
        description: |
         pinb
```

## airoha/mcu/dts/bindings/ab162x/airoha,air-sdadc.yaml
```yaml
description: |
  SDADC.

compatible: "airoha,air-sdadc"

include: [base.yaml]

properties:
  reg:
    required: true

  gain:
    type: string
    description: |
      Gain selection:
      - ADC_GAIN_1_6: x 1/6
      - ADC_GAIN_1_5: x 1/5
      - ADC_GAIN_1_4: x 1/4
      - ADC_GAIN_1_3: x 1/3
      - ADC_GAIN_2_5: x 2/5
      - ADC_GAIN_1_2: x 1/2
      - ADC_GAIN_2_3: x 2/3
      - ADC_GAIN_4_5: x 4/5
      - ADC_GAIN_1:   x 1
      - ADC_GAIN_2:   x 2
      - ADC_GAIN_3:   x 3
      - ADC_GAIN_4:   x 4
      - ADC_GAIN_6:   x 6
      - ADC_GAIN_8:   x 8
      - ADC_GAIN_12:  x 12
      - ADC_GAIN_16:  x 16
      - ADC_GAIN_24:  x 24
      - ADC_GAIN_32:  x 32
      - ADC_GAIN_64:  x 64
      - ADC_GAIN_128: x 128
    enum:
      - "ADC_GAIN_1_6"
      - "ADC_GAIN_1_5"
      - "ADC_GAIN_1_4"
      - "ADC_GAIN_1_3"
      - "ADC_GAIN_2_5"
      - "ADC_GAIN_1_2"
      - "ADC_GAIN_2_3"
      - "ADC_GAIN_4_5"
      - "ADC_GAIN_1"
      - "ADC_GAIN_2"
      - "ADC_GAIN_3"
      - "ADC_GAIN_4"
      - "ADC_GAIN_6"
      - "ADC_GAIN_8"
      - "ADC_GAIN_12"
      - "ADC_GAIN_16"
      - "ADC_GAIN_24"
      - "ADC_GAIN_32"
      - "ADC_GAIN_64"
      - "ADC_GAIN_128"

  reference:
    type: string
    description: |
      Reference selection:
      - ADC_REF_VDD_1:     VDD
      - ADC_REF_VDD_1_2:   VDD/2
      - ADC_REF_VDD_1_3:   VDD/3
      - ADC_REF_VDD_1_4:   VDD/4
      - ADC_REF_INTERNAL:  Internal
      - ADC_REF_EXTERNAL0: External, input 0
      - ADC_REF_EXTERNAL1: External, input 1
    enum:
      - "ADC_REF_VDD_1"
      - "ADC_REF_VDD_1_2"
      - "ADC_REF_VDD_1_3"
      - "ADC_REF_VDD_1_4"
      - "ADC_REF_INTERNAL"
      - "ADC_REF_EXTERNAL0"
      - "ADC_REF_EXTERNAL1"

  acquisition_time:
      type: int
      description: |
        Acquisition time.
        Use the ADC_ACQ_TIME macro to compose the value for this property
        or pass ADC_ACQ_TIME_DEFAULT to use the default setting for a given
        hardware (e.g. when the hardware does not allow to configure the
        acquisition time).
  
  channel_id:
    type: int
    description: |
      ADC channel id to be used for the channel.

  resolution:
    type: int
    description: |
      ADC resolution to be used for that channel.

  oversampling:
    type: int
    description: |
      Oversampling setting to be used for that channel.
```

## airoha/mcu/dts/bindings/ab162x/airoha,air-spmcfg.yaml
```yaml
description: |
  Airoha system power management.

compatible: "airoha,air-spmcfg"

include: [base.yaml]

properties:
    reg:
      required: true

    label:
      required: false
```

## airoha/mcu/dts/bindings/ab162x/airoha,air-spmtop.yaml
```yaml
description: |
  Airoha system power management.

compatible: "airoha,air-spmtop"

include: [base.yaml]

properties:
    reg:
      required: true

    label:
      required: false
```

## airoha/mcu/dts/bindings/ab162x/airoha,air-trng.yaml
```yaml
# SPDX-License-Identifier: Apache-2.0

description: Airoha True Random Number Generator

compatible: "airoha,air-trng"

include: base.yaml

properties:
    reg:
        required: true

    von-neumann-extractor:
        type: boolean

    ring-oscillator-combination:
        type: int
        default: 0x7F    # enable all ring oscillator
        description: ring oscillator combination enable bits
            1  <=> enable H-FIRO
            2  <=> enable H-RO
            4  <=> enable H-GARO
            8  <=> enable H-GARO2
            16 <=> enable H-GARO3
            32 <=> enable H-GARO4
            64 <=> enable H-GARO5

    timeout-cycles:
        type: int
        default: 1024
```

## airoha/mcu/dts/bindings/ab162x/airoha,air-uart.yaml
```yaml
description: |
  Airoha family UART.

compatible: "airoha,air-uart"

include: [base.yaml]

properties:
    tx-pin:
      type: int
      description: |
        IMPORTANT: This option will only be used if the new pin control driver
        is not enabled. It will be deprecated in the future.

        The TX pin to use.

        For pins P0.0 through P0.31, use the pin number. For example,
        to use P0.16 for TX, set:

          tx-pin = <16>;

        For pins P1.0 through P1.31, add 32 to the pin number. For
        example, to use P1.2 for TX, set:

          tx-pin = <34>;  /* 32 + 2 */

    rx-pin:
      type: int
      description: |
        IMPORTANT: This option will only be used if the new pin control driver
        is not enabled. It will be deprecated in the future.

        The RX pin to use. The pin numbering scheme is the same as the
        tx-pin property's.

    rts-pin:
      type: int
      description: |
        IMPORTANT: This option will only be used if the new pin control driver
        is not enabled. It will be deprecated in the future.

        The RTS pin to use. The pin numbering scheme is the same as the
        tx-pin property's.

    cts-pin:
      type: int
      description: |
        IMPORTANT: This option will only be used if the new pin control driver
        is not enabled. It will be deprecated in the future.

        The CTS pin to use. The pin numbering scheme is the same as the
        tx-pin property's.

    rx-pull-up:
      type: boolean
      description: |
        IMPORTANT: This option will only be used if the new pin control driver
        is not enabled. It will be deprecated in the future.

        Enable pull-up resistor on the RX pin.

    cts-pull-up:
      type: boolean
      description: |
        IMPORTANT: This option will only be used if the new pin control driver
        is not enabled. It will be deprecated in the future.

        Enable pull-up resistor on the CTS pin.

    hw-flow-control:
      type: boolean  
      description: |
        Set to enable RTS/CTS flow control at boot time.

    sw-flow-control:
      type: boolean 
      description: |
        Set to enable xon/xoff flow control at boot time.

    current-speed:
        type: int
        description: |
          Initial baud rate setting for UART. Only a fixed set of baud
          rates are selectable on these devices.
        enum:
          - 1200
          - 2400
          - 4800
          - 9600
          - 14400
          - 19200
          - 28800
          - 31250
          - 38400
          - 56000
          - 57600
          - 76800
          - 115200
          - 230400
          - 250000
          - 460800
          - 921600
          - 1000000
          - 2000000
          - 3000000
          - 3200000
          - 6000000
          - 8666000

    data-bits:
      type: int
      description: |
        data bits 0:5-bit/1:6-bit/2:7-bit/3:8-bit/4:9-bit

    stop-bits:
      type: int
      description: |
        stop bits 0:1 bit/1:2bit

    parity:
      type: int
      description: |
        Configures the parity of the adapter. Enumeration id 0 for none, 1 for odd
        and 2 for even parity. Default to none if not specified.

    flow_ctrl:
      type: int
      description: |
        Configures uart sw flow ctrl ,2:enable sw flow ctrl ,1:enable hw flow ctrl , 0:disable flow ctrl

    tbuf-size:
      type: int
      description: |
        Size of the buffer for transmission


    rbuf-size:
      type: int
      description: |
        Size of the buffer for reception
```

## airoha/mcu/dts/bindings/ab162x/airoha,air-usbd.yaml
```yaml
description: |
    Airoha USB device controller

compatible: "airoha,air-usbd"

include: usb-ep.yaml

properties:
  reg:
    required: true

  interrupts:
    required: true

  ram-size:
    type: int
    required: true
    description: Size of USB dedicated RAM.
```

## airoha/mcu/dts/bindings/ab162x/airoha,air-usbda-cdc.yaml
```yaml
# Copyright (c) 2021 Nordic Semiconductor ASA
# SPDX-License-Identifier: Apache-2.0

description: Airoha USB CDC DA port

compatible: "airoha,air-usbda-cdc"

include: uart-controller.yaml

on-bus: usb

properties:
  tx-endpoint:
    type: int
    default: 1
    description: The tx endpoint of usb device

  rx-endpoint:
    type: int
    default: 1
    description: The rx endpoint of usb device

  tx-fifo-size:
    type: int
    default: 1024
    description: |
      Size of the virtual CDC ACM UART TX FIFO

  rx-fifo-size:
    type: int
    default: 1024
    description: |
      Size of the virtual CDC ACM UART RX FIFO
```

## airoha/mcu/soc/airoha/ab162x/Kconfig.init_priority
```kconfig
# init level early start
config UART_EARLY_INIT_PRIORITY
	int
	default 0
# init level early end


# init level pre_kernel 1 start
config INTC_INIT_PRIORITY
	int
	default 1

config FLASH_CFG_INIT_PRIORITY
	int
	default 2

config FPGA_CLOCK_INIT_PRIORITY
	int
	default 14

config CLOCK_INIT_PRIORITY
	int
	default 15

config GPIO_INIT_PRIORITY
	int
	default 25

config PINMUX_INIT_PRIORITY
	int
	default 26

config CCM_INIT_PRIORITY
	int
	default 27

config CORE_STATUS_BOOT_INIT_PRIORITY
	int
	default 28

config SERIAL_INIT_PRIORITY
	int
	default 29

config LOG_EARLY_INIT_PRIORITY
	int
	default 30

config SLEEP_MANAGER_INIT_PRIORITY
	int
	default 31

config RAM_BLOCKS_CONTROL_INIT_PRIORITY
	int
	default 32

config PD_DOMAIN_CONTROL_INIT_PRIORITY
	int
	default 33

config I2C_INIT_PRIORITY
	int
	default 34

config SPIM_INIT_PRIORITY
	int
	default 35

config SPIS_INIT_PRIORITY
	int
	default 36

config TRNG_INIT_PRIORITY
	int
	default 37

config CACHE_INIT_PRIORITY
	int
	default 40

config FLASH_INIT_PRIORITY
	int
	default 45

config ESC_DEVICE_INIT_PRIORITY
	int
	default 46

config PARTITION_TABLE_INIT_PRIORITY
	int
	default 47

config PWM_INIT_PRIORITY
	int
	default 48

config PWM_DMA_INIT_PRIORITY
	int
	default 49

config LED_INIT_PRIORITY
	int
	default 50

config CCNI_INIT_PRIORITY
	int
	default 52

config MOUSE_SENSOR_PREINIT_PRIORITY
	int
	default 54

config RTC_INIT_PRIORITY
	int
	default 55

config IRRX_INIT_PRIORITY
	int
	default 56

# init level pre_kernel 1 end


# init level pre_kernel 2 start
config NVDATA_INIT_PRIORITY
	int
	default 10

config PMU_INIT_PRIORITY
	int
	default 15

config BATTER_MANAGEMENT_INIT_PRIORITY
	int
	default 16

config DCXO_INIT_PRIORITY
	int
	default 20

config DVFS_INIT_PRIORITY
	int
	default 21

config LOG_INIT_PRIORITY
	int
	default 25

config WDT_INIT_PRIORITY
	int
	default 29

config EXCEPTION_DUMP_INIT_PRIORITY
	int
	default 30

config OFFLINE_DUMP_INIT_PRIORITY
	int
	default 31

config BOOT_REASON_INIT_PRIORITY
	int
	default 40

config SYS_HANG_TRACER_INIT_PRIORITY
	int
	default 45

config USB_INIT_PRIORITY
	int
	default 50

config OST_INIT_PRIORITY
	int
	default 95

config SWLA_INIT_PRIORITY
	int
	default 96

config MOUSE_SENSOR_INIT_PRIORITY
	int
	default 97

config IO_EXPANDER_SENSOR_INIT_PRIORITY
	int
	default 97

config START_RISCV_INIT_PRIORITY
	int
	default 99
# init level pre_kernel 2 end


# init level post_kernel start
config DAEMON_WORK_Q_INIT_PRIORITY
	int
	default 0

config SHELL_BACKEND_SERIAL_INIT_PRIORITY
	int
	default 1

config USB_VBUS_DETECT_INIT_PRIORITY
	int
	default 50

config IEEE802154_INIT_PRIORITY
	int
	default 79

config RACE_CMD_INIT_PRIORITY
	int
	default 98

config MPU_INIT_PRIORITY
	int
	default 99

config SAR_ADC_INIT_PRIORITY
	int
	default 99

config AIOADC_INIT_PRIORITY
	int
	default 99

# init level post_kernel end


# init level application start
config DVFS_INIT_END_PRIORITY
	int
	default 98

config BUILD_INFO_INIT_PRIORITY
	int
	default 99

config CORE_STATUS_ACTIVE_INIT_PRIORITY
	int
	default 99

# init level application end
```
