## airoha/mcu/dts/bindings/ab162x/airoha,air-bt-hci.yaml
```yaml
descryption: Bluetooth HCI using the AIROHA system

compatible: "airoha,air-bt-hci.yaml"

include: bt-hci.yaml

properties:
  bt-hci-name: 
    default: "Airoha HCI"
  bt-hci-bus:
    default: "BT_HCI_DRIVER_BUS_VIRTUAL"
  bt-hci-quirks:
    default: "BT_QUIRK_NO_AUTO_DLE"
  
```

## airoha/mcu/dts/bindings/ab162x/airoha,air-cache.yaml
```yaml
# SPDX-License-Identifier: Apache-2.0

description: Airoha External CMSYS L1 Cache Controller

compatible: "airoha,air-cache"

include: base.yaml

properties:
    reg:
        required: true

    label:
        required: false

    remap-channel-num:
        type: int
        required: false
        description: Number of cache controller remapping channels

    cacheable-channel-num:
        type: int
        required: true
        description: Number of cache controller cacheable channels

    icache-line-size:
        type: int
        required: true

    dcache-line-size:
        type: int
        required: true

    cache-memory-size:
        type: int
        required: true
        description: |
            0 =>    0b00
            8KB =>  0b01
            16KB => 0b10
            32KB => 0b11

    cacheable-region-alignment:
        type: int
        required: true
```

## airoha/mcu/dts/bindings/ab162x/airoha,air-esc.yaml
```yaml
description: Airoha External Serial Controller

compatible: "airoha,air-esc"

include: flash-controller.yaml

properties:
    partial-erase:
      type: boolean
      description: |
        If set, indicates that the NVMC supports partial erase of flash pages.
```

## airoha/mcu/dts/bindings/ab162x/airoha,air-flash-controller.yaml
```yaml
description: Airoha Flash Controller

compatible: "airoha,air-flash-controller"

include: flash-controller.yaml

properties:
    partial-erase:
      type: boolean
      description: |
        If set, indicates that the NVMC supports partial erase of flash pages.
```

## airoha/mcu/dts/bindings/ab162x/airoha,air-hw-semaphore.yaml
```yaml
# SPDX-License-Identifier: Apache-2.0

description: Airoha HW Semaphore

compatible: "airoha,air-hw-semaphore"

include: base.yaml

properties:
    reg:
        required: true

    channels:
        type: int
        required: true
```

## airoha/mcu/dts/bindings/ab162x/airoha,air-irq-gen.yaml
```yaml
# SPDX-License-Identifier: Apache-2.0

description: Airoha Interrupt Generator Between Cores

compatible: "airoha,air-irq-gen"

include: base.yaml

properties:
    reg:
        required: true

    label:
        required: false
```

## airoha/mcu/dts/bindings/ab162x/airoha,air-misc.yaml
```yaml
# SPDX-License-Identifier: Apache-2.0

description: Airoha Misc

compatible: "airoha,air-misc"

include: base.yaml

properties:
    reg:
        required: true

    label:
        required: false
```

## airoha/mcu/dts/bindings/ab162x/airoha,air-ost.yaml
```yaml
# SPDX-License-Identifier: Apache-2.0

description: Airoha standalone operating system timer

compatible: "airoha,air-ost"

include: base.yaml

properties:
    reg:
        required: true

    channel-num:
        type: int
        required: true
        description: Number of OST channels

    label:
        required: false

    clock-divider:
        type: int
        required: false
        description: |
            divides the clock by
            1, 2, 3, 4, 5, 6, 7, 8, 9, 10, 11, 12, 13, 16,
            32, or 64

    clock-source:
        type: int
        required: false
        description: |
            0 means system clock( 13MHz )
            1 means real time clock( RTC, 32KHz with calibration )
            NOTE( only RTC is available during sleep mode !!! )
```

## airoha/mcu/dts/bindings/ab162x/airoha,air-pinctrl.yaml
```yaml
# SPDX-License-Identifier: Apache-2.0
description: Airoha pinctrl

compatible: "airoha,air-pinctrl"

include: base.yaml

child-binding:
  description: |
     This binding gives a base representation of the airoha pins configuration.
  child-binding:
    include:
      - name: pincfg-node.yaml
        property-allowlist:
          - bias-high-impedance
          - bias-pull-down
          - bias-pull-up
          - output-enable
          - output-high
          - input-schmitt-enable
          - drive-strength
          - slew-rate
          - debounce

    properties:
      pinmux:
        required: true
        type: array
        description: |
          The array is expected to have up to two elements. The first element is
          the pin the second optional element is the pin function.
      # !!! for property int, it must has a default value !!!
      drive-strength:
        enum:
          - 2
          - 4
          - 8
          - 12
        default: 4
        description: |
          The drive strength of a pin, in mA. The default value is 4mA, as this
          is the power on reset value.
      slew-rate:
        default: 0
        description: |
          The slew rate of a pin. 0 corresponds to slow, and 1 corresponds to fast.
          The default value is 0 (slow), as this is the power on reset value.
      debounce:
        type: int
        default: 0
        description: |
          debounce uint :ms
```

## airoha/mcu/dts/bindings/ab162x/airoha,air-pmu.yaml
```yaml
# SPDX-License-Identifier: Apache-2.0

description: Airoha Power Management Unit

compatible: "airoha,air-pmu"

include: base.yaml

properties:
    reg:
        required: true

    label:
        required: false

    module-str:
        type: string-array
        required: false
        description: pmu related modules name string
```
