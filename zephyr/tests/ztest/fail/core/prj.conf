## CMakeLists.txt
```
# Copyright (c) 2022 Google LLC
# SPDX-License-Identifier: Apache-2.0

cmake_minimum_required(VERSION 3.20.0)

set(KCONFIG_ROOT ${CMAKE_CURRENT_LIST_DIR}/../Kconfig)

# Add the sources
list(APPEND SOURCES src/main.cpp)
if(CONFIG_ZTEST_FAIL_TEST_ASSERT_AFTER)
  list(APPEND SOURCES src/assert_after.cpp)
elseif(CONFIG_ZTEST_FAIL_TEST_ASSERT_TEARDOWN)
  list(APPEND SOURCES src/assert_teardown.cpp)
elseif(CONFIG_ZTEST_FAIL_TEST_ASSUME_AFTER)
  list(APPEND SOURCES src/assume_after.cpp)
elseif(CONFIG_ZTEST_FAIL_TEST_ASSUME_TEARDOWN)
  list(APPEND SOURCES src/assume_teardown.cpp)
elseif(CONFIG_ZTEST_FAIL_TEST_PASS_AFTER)
  list(APPEND SOURCES src/pass_after.cpp)
elseif(CONFIG_ZTEST_FAIL_TEST_PASS_TEARDOWN)
  list(APPEND SOURCES src/pass_teardown.cpp)
elseif(CONFIG_ZTEST_FAIL_TEST_UNEXPECTED_ASSUME)
  list(APPEND SOURCES src/unexpected_assume.cpp)
endif()

if(BOARD STREQUAL unit_testing)
  find_package(Zephyr COMPONENTS unittest REQUIRED HINTS $ENV{ZEPHYR_BASE})
  project(base)

  target_include_directories(testbinary PRIVATE include)
  install(TARGETS testbinary)
else()
  find_package(Zephyr REQUIRED HINTS $ENV{ZEPHYR_BASE})
  project(base)

  target_sources(app PRIVATE ${SOURCES})
  target_include_directories(app PRIVATE include)
  install(FILES ${APPLICATION_BINARY_DIR}/zephyr/${KERNEL_EXE_NAME}
    DESTINATION bin/
    PERMISSIONS OWNER_EXECUTE OWNER_WRITE OWNER_READ GROUP_EXECUTE GROUP_READ
      WORLD_EXECUTE WORLD_READ
  )
endif()
```

## prj.conf
```kconfig
# Copyright (c) 2022 Google LLC
# SPDX-License-Identifier: Apache-2.0

CONFIG_ZTEST=y

CONFIG_CPP=y
```

## src/main.cpp
```c
/* Copyright (c) 2022 Google LLC
 * SPDX-License-Identifier: Apache-2.0
 */

#include <zephyr/ztest.h>

#include "fail_test.hpp"

static void fail_after(void *) {
	fail_test_after_impl();
}

static void fail_teardown(void *) {
	fail_test_teardown_impl();
}

ZTEST_SUITE(fail, nullptr, nullptr, nullptr, fail_after, fail_teardown);

ZTEST(fail, test_framework) {}
```

## include/fail_test.hpp
```c
/* Copyright (c) 2022 Google LLC
 * SPDX-License-Identifier: Apache-2.0
 */

#pragma once

void fail_test_after_impl(void);

void fail_test_teardown_impl(void);
```

## src/assert_after.cpp
```c
/* Copyright (c) 2022 Google LLC
 * SPDX-License-Identifier: Apache-2.0
 */

#include <zephyr/ztest.h>

#include "fail_test.hpp"

void fail_test_after_impl(void)
{
	zassert_true(false, nullptr);
}

void fail_test_teardown_impl(void) {}
```

## src/assert_teardown.cpp
```c
/* Copyright (c) 2022 Google LLC
 * SPDX-License-Identifier: Apache-2.0
 */

#include <zephyr/ztest.h>

#include "fail_test.hpp"

void fail_test_after_impl(void) {}

void fail_test_teardown_impl(void)
{
	zassert_true(false, nullptr);
}
```

## src/assume_after.cpp
```c
/* Copyright (c) 2022 Google LLC
 * SPDX-License-Identifier: Apache-2.0
 */

#include <zephyr/ztest.h>

#include "fail_test.hpp"

void fail_test_after_impl(void)
{
	zassume_true(false, nullptr);
}

void fail_test_teardown_impl(void) {}
```

## src/assume_teardown.cpp
```c
/* Copyright (c) 2022 Google LLC
 * SPDX-License-Identifier: Apache-2.0
 */

#include <zephyr/ztest.h>

#include "fail_test.hpp"

void fail_test_after_impl(void) {}

void fail_test_teardown_impl(void)
{
	zassume_true(false, nullptr);
}
```

## src/pass_after.cpp
```c
/* Copyright (c) 2022 Google LLC
 * SPDX-License-Identifier: Apache-2.0
 */

#include <zephyr/ztest.h>

#include "fail_test.hpp"

void fail_test_after_impl(void)
{
	ztest_test_pass();
}

void fail_test_teardown_impl(void) {}
```

## src/pass_teardown.cpp
```c
/* Copyright (c) 2022 Google LLC
 * SPDX-License-Identifier: Apache-2.0
 */

#include <zephyr/ztest.h>

#include "fail_test.hpp"

void fail_test_after_impl(void) {}

void fail_test_teardown_impl(void)
{
	ztest_test_pass();
}
```

## src/unexpected_assume.cpp
```c
/* Copyright (c) 2022 Google LLC
 * SPDX-License-Identifier: Apache-2.0
 */

#include <zephyr/ztest.h>

#include "fail_test.hpp"

void fail_test_after_impl(void) {}

void fail_test_teardown_impl(void) {}

ZTEST(fail, test_unexpected_assume)
{
	zassume_true(false, NULL);
}
```
