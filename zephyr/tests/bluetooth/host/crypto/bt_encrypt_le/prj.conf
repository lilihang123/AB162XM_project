## CMakeLists.txt
```
# SPDX-License-Identifier: Apache-2.0

cmake_minimum_required(VERSION 3.20.0)

set(SOURCES
  src/main.c
  src/test_suite_invalid_inputs.c
)

project(bt_encrypt_le)

find_package(Zephyr COMPONENTS unittest HINTS $ENV{ZEPHYR_BASE})

add_subdirectory(${ZEPHYR_BASE}/tests/bluetooth/host host_mocks)
add_subdirectory(${ZEPHYR_BASE}/tests/bluetooth/host/crypto mocks)

target_link_libraries(testbinary PRIVATE mocks host_mocks)
```

## prj.conf
```kconfig
CONFIG_ZTEST=y
CONFIG_BT=y
CONFIG_BT_CENTRAL=y
CONFIG_BT_MAX_PAIRED=7
CONFIG_ASSERT=y
CONFIG_ASSERT_LEVEL=2
CONFIG_ASSERT_VERBOSE=y
CONFIG_ASSERT_ON_ERRORS=y
```

## src/main.c
```c
/*
 * Copyright (c) 2022 Nordic Semiconductor ASA
 *
 * SPDX-License-Identifier: Apache-2.0
 */

#include "mocks/aes.h"
#include "mocks/aes_expects.h"

#include <zephyr/bluetooth/crypto.h>
#include <zephyr/fff.h>
#include <zephyr/kernel.h>

#include <host/crypto.h>

DEFINE_FFF_GLOBALS;

static void fff_reset_rule_before(const struct ztest_unit_test *test, void *fixture)
{
	AES_FFF_FAKES_LIST(RESET_FAKE);
}

ZTEST_RULE(fff_reset_rule, fff_reset_rule_before, NULL);

ZTEST_SUITE(bt_encrypt_le, NULL, NULL, NULL, NULL, NULL);

/*
 *  Test bt_encrypt_le() succeeds
 *
 *  Constraints:
 *   - tc_aes128_set_encrypt_key() succeeds and returns 'TC_CRYPTO_SUCCESS'.
 *   - tc_aes_encrypt() succeeds and returns 'TC_CRYPTO_SUCCESS'.
 *
 *  Expected behaviour:
 *   - bt_encrypt_le() returns 0 (success)
 */
ZTEST(bt_encrypt_le, test_bt_encrypt_le_succeeds)
{
	int err;
	const uint8_t key[16] = {0};
	const uint8_t plaintext[16] = {0};
	uint8_t enc_data[16] = {0};

	tc_aes128_set_encrypt_key_fake.return_val = TC_CRYPTO_SUCCESS;
	tc_aes_encrypt_fake.return_val = TC_CRYPTO_SUCCESS;

	err = bt_encrypt_le(key, plaintext, enc_data);

	expect_single_call_tc_aes_encrypt(enc_data);

	zassert_ok(err, "Unexpected error code '%d' was returned", err);
}
```

## src/test_suite_invalid_inputs.c
```c
/*
 * Copyright (c) 2022 Nordic Semiconductor ASA
 *
 * SPDX-License-Identifier: Apache-2.0
 */

#include "host_mocks/assert.h"
#include "mocks/aes.h"

#include <zephyr/bluetooth/crypto.h>
#include <zephyr/kernel.h>

#include <host/crypto.h>

ZTEST_SUITE(bt_encrypt_le_invalid_cases, NULL, NULL, NULL, NULL, NULL);

/*
 *  Test passing NULL reference for the key argument
 *
 *  Constraints:
 *   - NULL reference is used for the key argument
 *   - Valid references are used for the other arguments
 *
 *  Expected behaviour:
 *   - An assertion is raised and execution stops
 */
ZTEST(bt_encrypt_le_invalid_cases, test_null_key_reference)
{
	const uint8_t plaintext[16] = {0};
	uint8_t enc_data[16] = {0};

	expect_assert();
	bt_encrypt_le(NULL, plaintext, enc_data);
}

/*
 *  Test passing NULL reference for the plain text argument
 *
 *  Constraints:
 *   - NULL reference is used for the plain text argument
 *   - Valid references are used for the other arguments
 *
 *  Expected behaviour:
 *   - An assertion is raised and execution stops
 */
ZTEST(bt_encrypt_le_invalid_cases, test_null_plaintext_reference)
{
	const uint8_t key[16] = {0};
	uint8_t enc_data[16] = {0};

	expect_assert();
	bt_encrypt_le(key, NULL, enc_data);
}

/*
 *  Test passing NULL reference for the encrypted data destination buffer argument
 *
 *  Constraints:
 *   - NULL reference is used for the encrypted data destination buffer argument
 *   - Valid references are used for the other arguments
 *
 *  Expected behaviour:
 *   - An assertion is raised and execution stops
 */
ZTEST(bt_encrypt_le_invalid_cases, test_null_enc_data_reference)
{
	const uint8_t key[16] = {0};
	const uint8_t plaintext[16] = {0};

	expect_assert();
	bt_encrypt_le(key, plaintext, NULL);
}

/*
 *  Test bt_encrypt_le() fails when tc_aes128_set_encrypt_key() fails
 *
 *  Constraints:
 *   - tc_aes128_set_encrypt_key() fails and returns 'TC_CRYPTO_FAIL'.
 *
 *  Expected behaviour:
 *   - bt_encrypt_le() returns a negative error code '-EINVAL' (failure)
 */
ZTEST(bt_encrypt_le_invalid_cases, test_tc_aes128_set_encrypt_key_fails)
{
	int err;
	const uint8_t key[16] = {0};
	const uint8_t plaintext[16] = {0};
	uint8_t enc_data[16] = {0};

	tc_aes128_set_encrypt_key_fake.return_val = TC_CRYPTO_FAIL;

	err = bt_encrypt_le(key, plaintext, enc_data);

	zassert_true(err == -EINVAL, "Unexpected error code '%d' was returned", err);
}

/*
 *  Test bt_encrypt_le() fails when tc_aes_encrypt() fails
 *
 *  Constraints:
 *   - tc_aes128_set_encrypt_key() succeeds and returns 'TC_CRYPTO_SUCCESS'.
 *   - tc_aes_encrypt() fails and returns 'TC_CRYPTO_FAIL'.
 *
 *  Expected behaviour:
 *   - bt_encrypt_le() returns a negative error code '-EINVAL' (failure)
 */
ZTEST(bt_encrypt_le_invalid_cases, test_tc_aes_encrypt_fails)
{
	int err;
	const uint8_t key[16] = {0};
	const uint8_t plaintext[16] = {0};
	uint8_t enc_data[16] = {0};

	tc_aes128_set_encrypt_key_fake.return_val = TC_CRYPTO_SUCCESS;
	tc_aes_encrypt_fake.return_val = TC_CRYPTO_FAIL;

	err = bt_encrypt_le(key, plaintext, enc_data);

	zassert_true(err == -EINVAL, "Unexpected error code '%d' was returned", err);
}
```
