## CMakeLists.txt
```
# SPDX-License-Identifier: Apache-2.0

cmake_minimum_required(VERSION 3.20.0)

project(bt_id_adv_random_addr_check)

# Suppress the format-zero-length error if GNUC is used
if (CMAKE_C_COMPILER_ID MATCHES "GNU")
add_compile_options(-Wno-error=format-zero-length -Wno-format-zero-length)
endif()

find_package(Zephyr COMPONENTS unittest REQUIRED HINTS $ENV{ZEPHYR_BASE})

include_directories(BEFORE
    ${ZEPHYR_BASE}/tests/bluetooth/host/id/mocks
)

add_subdirectory(${ZEPHYR_BASE}/tests/bluetooth/host host_mocks)
add_subdirectory(${ZEPHYR_BASE}/tests/bluetooth/host/id/mocks mocks)

target_link_libraries(testbinary PRIVATE mocks host_mocks)

target_sources(testbinary
    PRIVATE
    src/main.c
    src/test_suite_invalid_inputs.c

    ${ZEPHYR_BASE}/subsys/bluetooth/host/id.c
    ${ZEPHYR_BASE}/subsys/bluetooth/common/addr.c
    ${ZEPHYR_BASE}/subsys/logging/log_minimal.c
    ${ZEPHYR_BASE}/subsys/bluetooth/common/bt_str.c
    ${ZEPHYR_BASE}/subsys/bluetooth/host/uuid.c
)
```

## prj.conf
```kconfig
CONFIG_ZTEST=y
CONFIG_BT=y
CONFIG_BT_ID_MAX=2
CONFIG_ASSERT=y
CONFIG_ASSERT_LEVEL=2
CONFIG_ASSERT_VERBOSE=y
CONFIG_ASSERT_ON_ERRORS=y
```

## src/main.c
```c
/*
 * Copyright (c) 2022 Nordic Semiconductor ASA
 *
 * SPDX-License-Identifier: Apache-2.0
 */

#include "mocks/adv.h"
#include "mocks/adv_expects.h"

#include <zephyr/bluetooth/hci.h>
#include <zephyr/fff.h>
#include <zephyr/kernel.h>

#include <host/hci_core.h>
#include <host/id.h>

DEFINE_FFF_GLOBALS;

static void fff_reset_rule_before(const struct ztest_unit_test *test, void *fixture)
{
	memset(&bt_dev, 0x00, sizeof(struct bt_dev));

	ADV_FFF_FAKES_LIST(RESET_FAKE);
}

ZTEST_RULE(fff_reset_rule, fff_reset_rule_before, NULL);

ZTEST_SUITE(bt_id_adv_random_addr_check, NULL, NULL, NULL, NULL, NULL);

/*
 *  Test checking advertising random address if observer role isn't enabled
 *
 *  Constraints:
 *   - 'CONFIG_BT_OBSERVER' isn't enabled
 *
 *  Expected behaviour:
 *   - bt_id_adv_random_addr_check() returns true
 */
ZTEST(bt_id_adv_random_addr_check, test_check_returns_true_observer_role_not_supported)
{
	bool result;
	struct bt_le_adv_param adv_param = {0};

	Z_TEST_SKIP_IFDEF(CONFIG_BT_OBSERVER);

	result = bt_id_adv_random_addr_check(&adv_param);

	zassert_true(result, "Incorrect result was returned");
}

/*
 *  Test checking scan random address if extended advertising is enabled
 *
 *  Constraints:
 *   - 'CONFIG_BT_EXT_ADV' is enabled
 *
 *  Expected behaviour:
 *   - bt_id_scan_random_addr_check() returns true
 */
ZTEST(bt_id_adv_random_addr_check, test_check_returns_true_ext_adv_enabled)
{
	bool result;
	struct bt_le_adv_param adv_param = {0};

	Z_TEST_SKIP_IFNDEF(CONFIG_BT_EXT_ADV);

	result = bt_id_adv_random_addr_check(&adv_param);

	zassert_true(result, "Incorrect result was returned");
}

/*
 *  Test checking advertising random address when scanner roles aren't active so that
 *  'BT_DEV_INITIATING' and 'BT_DEV_SCANNING' aren't set in bt_dev.flags
 *
 *  Constraints:
 *   - 'CONFIG_BT_OBSERVER' is enabled
 *   - 'CONFIG_BT_EXT_ADV' isn't enabled
 *   - 'BT_DEV_INITIATING' and 'BT_DEV_SCANNING' aren't set in bt_dev.flags
 *
 *  Expected behaviour:
 *   - bt_id_scan_random_addr_check() returns true
 */
ZTEST(bt_id_adv_random_addr_check, test_scanner_roles_not_active)
{
	bool result;
	struct bt_le_adv_param adv_param;

	Z_TEST_SKIP_IFNDEF(CONFIG_BT_OBSERVER);
	Z_TEST_SKIP_IFDEF(CONFIG_BT_EXT_ADV);

	atomic_clear_bit(bt_dev.flags, BT_DEV_INITIATING);
	atomic_clear_bit(bt_dev.flags, BT_DEV_SCANNING);

	result = bt_id_adv_random_addr_check(&adv_param);

	zassert_true(result, "Incorrect result was returned");
}

/*
 *  Test that advertiser cannot start with random static identity or
 *  using an RPA generated for a different identity than scanner roles when privacy is enabled
 *
 *  Constraints:
 *   - 'CONFIG_BT_PRIVACY' is enabled
 *   - 'CONFIG_BT_OBSERVER' is enabled
 *   - 'CONFIG_BT_EXT_ADV' isn't enabled
 *
 *  Expected behaviour:
 *   - bt_id_scan_random_addr_check() returns false
 */
ZTEST(bt_id_adv_random_addr_check, test_check_returns_false_scanner_uses_random_identity)
{
	bool result;
	struct bt_le_adv_param adv_param = {0};

	Z_TEST_SKIP_IFNDEF(CONFIG_BT_PRIVACY);
	Z_TEST_SKIP_IFNDEF(CONFIG_BT_OBSERVER);
	Z_TEST_SKIP_IFDEF(CONFIG_BT_EXT_ADV);

	atomic_set_bit(bt_dev.flags, BT_DEV_INITIATING);
	atomic_set_bit(bt_dev.flags, BT_DEV_SCANNING);

	adv_param.options |= BT_LE_ADV_OPT_USE_IDENTITY;
	bt_dev.id_addr[adv_param.id].type = BT_ADDR_LE_RANDOM;

	result = bt_id_adv_random_addr_check(&adv_param);

	zassert_false(result, "Incorrect result was returned");
}

/*
 *  Test that advertiser cannot start with random static identity or using an RPA generated for
 *  a different identity than scanner roles while 'CONFIG_BT_PRIVACY' isn't enabled and
 *  'CONFIG_BT_SCAN_WITH_IDENTITY' is enabled
 *
 *  Constraints:
 *   - 'CONFIG_BT_SCAN_WITH_IDENTITY' is enabled
 *   - 'CONFIG_BT_PRIVACY' isn't enabled
 *   - 'CONFIG_BT_OBSERVER' is enabled
 *   - 'CONFIG_BT_EXT_ADV' isn't enabled
 *
 *  Expected behaviour:
 *   - bt_id_scan_random_addr_check() returns false
 */
ZTEST(bt_id_adv_random_addr_check, test_check_returns_false_advertise_with_local_identity)
{
	bool result;
	struct bt_le_adv_param adv_param = {0};

	Z_TEST_SKIP_IFNDEF(CONFIG_BT_SCAN_WITH_IDENTITY);
	Z_TEST_SKIP_IFNDEF(CONFIG_BT_OBSERVER);
	Z_TEST_SKIP_IFDEF(CONFIG_BT_EXT_ADV);

	atomic_set_bit(bt_dev.flags, BT_DEV_SCANNING);

	adv_param.options &= ~BT_LE_ADV_OPT_CONNECTABLE;
	adv_param.options |= BT_LE_ADV_OPT_USE_IDENTITY;
	bt_dev.id_addr[BT_ID_DEFAULT].type = BT_ADDR_LE_RANDOM;

	result = bt_id_adv_random_addr_check(&adv_param);

	zassert_false(result, "Incorrect result was returned");
}

/*
 *  Test that advertiser cannot start with random static identity or using an RPA generated for
 *  a different identity than scanner roles while 'CONFIG_BT_PRIVACY' isn't enabled and
 *  'CONFIG_BT_SCAN_WITH_IDENTITY' is enabled
 *
 *  Constraints:
 *   - 'CONFIG_BT_SCAN_WITH_IDENTITY' is enabled
 *   - 'CONFIG_BT_PRIVACY' isn't enabled
 *   - 'CONFIG_BT_OBSERVER' is enabled
 *   - 'CONFIG_BT_EXT_ADV' isn't enabled
 *
 *  Expected behaviour:
 *   - bt_id_scan_random_addr_check() returns false
 */
ZTEST(bt_id_adv_random_addr_check, test_check_returns_false_advertise_with_different_identity)
{
	bool result;
	struct bt_le_adv_param adv_param = {0};

	Z_TEST_SKIP_IFNDEF(CONFIG_BT_SCAN_WITH_IDENTITY);
	Z_TEST_SKIP_IFNDEF(CONFIG_BT_OBSERVER);
	Z_TEST_SKIP_IFDEF(CONFIG_BT_EXT_ADV);

	atomic_set_bit(bt_dev.flags, BT_DEV_SCANNING);

	adv_param.id = 1;
	bt_dev.id_addr[adv_param.id].type = BT_ADDR_LE_RANDOM;
	bt_dev.id_addr[BT_ID_DEFAULT].type = BT_ADDR_LE_RANDOM;

	result = bt_id_adv_random_addr_check(&adv_param);

	zassert_false(result, "Incorrect result was returned");
}

/*
 *  Test checking advertising random address returns 'true' as a default value
 *
 *  Constraints:
 *   - 'CONFIG_BT_OBSERVER' is enabled
 *   - 'CONFIG_BT_EXT_ADV' isn't enabled
 *   - 'BT_DEV_INITIATING' and 'BT_DEV_SCANNING' are set in bt_dev.flags
 *   - 'CONFIG_BT_SCAN_WITH_IDENTITY' isn't enabled
 *   - 'CONFIG_BT_PRIVACY' isn't enabled
 *
 *  Expected behaviour:
 *   - bt_id_scan_random_addr_check() returns true
 */
ZTEST(bt_id_adv_random_addr_check, test_default_return_value)
{
	bool result;
	struct bt_le_adv_param adv_param;

	Z_TEST_SKIP_IFNDEF(CONFIG_BT_OBSERVER);
	Z_TEST_SKIP_IFDEF(CONFIG_BT_EXT_ADV);
	Z_TEST_SKIP_IFDEF(CONFIG_BT_SCAN_WITH_IDENTITY);
	Z_TEST_SKIP_IFDEF(CONFIG_BT_PRIVACY);

	atomic_set_bit(bt_dev.flags, BT_DEV_INITIATING);
	atomic_set_bit(bt_dev.flags, BT_DEV_SCANNING);

	result = bt_id_adv_random_addr_check(&adv_param);

	zassert_true(result, "Incorrect result was returned");
}
```

## src/test_suite_invalid_inputs.c
```c
/*
 * Copyright (c) 2022 Nordic Semiconductor ASA
 *
 * SPDX-License-Identifier: Apache-2.0
 */

#include "host_mocks/assert.h"

#include <zephyr/bluetooth/hci.h>
#include <zephyr/kernel.h>
#include <zephyr/ztest.h>

#include <host/hci_core.h>
#include <host/id.h>

ZTEST_SUITE(bt_id_adv_random_addr_check_invalid_inputs, NULL, NULL, NULL, NULL, NULL);

/*
 *  Test passing NULL value for the advertising parameters
 *
 *  Constraints:
 *   - Advertising parameters reference is passed as NULL
 *
 *  Expected behaviour:
 *   - An assertion is raised and execution stops
 */
ZTEST(bt_id_adv_random_addr_check_invalid_inputs, test_null_advertising_parameters_ref)
{
	expect_assert();
	bt_id_adv_random_addr_check(NULL);
}
```
