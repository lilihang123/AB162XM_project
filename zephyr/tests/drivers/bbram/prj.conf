## CMakeLists.txt
```
# Copyright 2021 Google LLC
# SPDX-License-Identifier: Apache-2.0

cmake_minimum_required(VERSION 3.20.0)

find_package(Zephyr REQUIRED HINTS $ENV{ZEPHYR_BASE})
project(bbram)

FILE(GLOB app_sources src/*.c)
target_sources(app PRIVATE ${app_sources})
```

## prj.conf
```kconfig
# Copyright 2021 Google LLC
# SPDX-License-Identifier: Apache-2.0

CONFIG_ZTEST=y
CONFIG_BBRAM=y
```

## stm32.conf
```kconfig
CONFIG_COUNTER=y
```

## stm32_rtc.conf
```kconfig
CONFIG_RTC=y
```

## src/main.c
```c
/*
 * Copyright 2021 Google LLC
 * SPDX-License-Identifier: Apache-2.0
 */

#include <zephyr/ztest.h>

void test_main(void)
{
	/* Build only test, this is a stub. */
}
```
