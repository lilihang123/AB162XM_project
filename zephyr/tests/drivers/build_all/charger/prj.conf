## CMakeLists.txt
```
# Copyright (c) 2023 Cirrus Logic, Inc.
# SPDX-License-Identifier: Apache-2.0

cmake_minimum_required(VERSION 3.20.0)
find_package(Zephyr REQUIRED HINTS $ENV{ZEPHYR_BASE})
project(build_all)

target_sources(app PRIVATE src/main.c)
```

## prj.conf
```kconfig
CONFIG_CHARGER=y
```

## app.overlay
```dts
/*
 * Copyright (c) 2023 Cirrus Logic, Inc.
 * SPDX-License-Identifier: Apache-2.0
 */

 #include <zephyr/dt-bindings/i2c/i2c.h>

/ {
	test {
		#address-cells = <1>;
		#size-cells = <1>;

		test_gpio: gpio@deadbeef {
			compatible = "vnd,gpio";
			gpio-controller;
			reg = <0xdeadbeef 0x1000>;
			#gpio-cells = <0x2>;
			status = "okay";
		};

		test_i2c: i2c@11112222 {
			#address-cells = <1>;
			#size-cells = <0>;
			compatible = "vnd,i2c";
			reg = <0x11112222 0x1000>;
			status = "okay";
			clock-frequency = <I2C_BITRATE_STANDARD>;

			#include "i2c.dtsi"
		};
	};
};
```

## i2c.dtsi
```dts
/*
 * Copyright (c) 2023 Cirrus Logic, Inc.
 * SPDX-License-Identifier: Apache-2.0
 */

/****************************************
 * PLEASE KEEP REG ADDRESSES SEQUENTIAL *
 ***************************************/

bq24190@0 {
	compatible = "ti,bq24190";
	reg = <0x0>;
	status = "okay";

	constant-charge-current-max-microamp = <1000000>;
	constant-charge-voltage-max-microvolt = <4208000>;
};

max20335@1 {
	compatible = "maxim,max20335";
	reg = <0x01>;
	status = "okay";

	charger: charger {
		compatible = "maxim,max20335-charger";

		chgin-to-sys-current-limit-microamp = <100000>;
		constant-charge-voltage-max-microvolt = <4050000>;
		system-voltage-min-threshold-microvolt = <3600000>;
		re-charge-threshold-microvolt = <170000>;
		thermistor-monitoring-mode = "JEITA-2";
		int-gpios = <&test_gpio 0 0>;
	};
};

bq25180@2 {
	compatible = "ti,bq25180";
	reg = <0x2>;
	constant-charge-current-max-microamp = <500000>;
};
```

## src/main.c
```c
/*
 * Copyright (c) 2023 Cirrus Logic, Inc.
 * SPDX-License-Identifier: Apache-2.0
 */

int main(void)
{
	return 0;
}
```
