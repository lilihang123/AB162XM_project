## CMakeLists.txt
```
# Copyright 2020 Peter Bigot Consulting, LLC
# SPDX-License-Identifier: Apache-2.0

cmake_minimum_required(VERSION 3.20.0)
find_package(Zephyr REQUIRED HINTS $ENV{ZEPHYR_BASE})
project(regulator_fixed)

target_sources(app PRIVATE src/main.c)
```

## prj.conf
```kconfig
CONFIG_ZTEST=y
CONFIG_GPIO=y
CONFIG_REGULATOR=y
```

## boards/nrf52840dk_nrf52840.overlay
```dts
/*
 * Copyright 2020 Peter Bigot Consulting, LLC
 * SPDX-License-Identifier: Apache-2.0
 */

#include "test_common.dtsi"

/ {
	regulator {
		/* Arduino D0 */
		enable-gpios = <&gpio1 1 GPIO_ACTIVE_HIGH>;
	};
	resources {
		/* Arduino D1 */
		check-gpios = <&gpio1 2 (GPIO_ACTIVE_HIGH | GPIO_PULL_DOWN)>;
	};
};
```

## boards/nrf5340dk_nrf5340_cpuapp.overlay
```dts
/*
 * Copyright 2023 Nordic Semiconductor ASA
 * SPDX-License-Identifier: Apache-2.0
 */

#include "test_common.dtsi"

/ {
	regulator {
		/* Arduino D11 */
		enable-gpios = <&gpio0 4 GPIO_ACTIVE_HIGH>;
	};
	resources {
		/* Arduino D13 */
		check-gpios = <&gpio0 5 (GPIO_ACTIVE_HIGH | GPIO_PULL_DOWN)>;
	};
};
```

## boards/nrf9160dk_nrf9160.overlay
```dts
/*
 * Copyright 2023 Nordic Semiconductor ASA
 * SPDX-License-Identifier: Apache-2.0
 */

#include "test_common.dtsi"

/ {
	regulator {
		/* Arduino D10 */
		enable-gpios = <&gpio0 10 GPIO_ACTIVE_HIGH>;
	};
	resources {
		/* Arduino D11 */
		check-gpios = <&gpio0 11 (GPIO_ACTIVE_HIGH | GPIO_PULL_DOWN)>;
	};
};

&uart1 {
	/* Default-enabled Arduino UART steals the pins we want. */
	status = "disabled";
};
```

## dts/test_common.dtsi
```dts
/*
 * Copyright 2020 Peter Bigot Consulting, LLC
 * SPDX-License-Identifier: Apache-2.0
 */

/ {
	regulator {
		compatible = "regulator-fixed";
		regulator-name = "test";
		regulator-boot-on;
		startup-delay-us = <1000000>;
		off-on-delay-us = <20000>;
	};

	resources {
		compatible = "test-regulator-fixed";
	};
};
```

## dts/bindings/test-regulator-fixed.yaml
```yaml
# Copyright 2020 Peter Bigot Consulting, LLC
# SPDX-License-Identifier: Apache-2.0

description: |
    This binding provides resources required to build and run the
    tests/drivers/regulator/fixed test in Zephyr.

compatible: "test-regulator-fixed"

properties:
  check-gpios:
    type: phandle-array
    required: true
    description: |
      Identity of a GPIO that is shorted to the GPIO identified in the test
      regulator enable-gpios property. This is used to confirm that signal's
      state.

      The active level in the flags cell of this must match the active level
      of the flags cell in the regulator's enable-gpios property, and the
      flags must include a PULL to the inactive level.
```

## src/main.c
```c
/*
 * Copyright 2020 Peter Bigot Consulting, LLC
 * Copyright 2022 Nordic Semiconductor ASA
 * SPDX-License-Identifier: Apache-2.0
 */

#include <zephyr/kernel.h>
#include <zephyr/drivers/gpio.h>
#include <zephyr/drivers/regulator.h>
#include <zephyr/ztest.h>

static const struct device *const reg = DEVICE_DT_GET(DT_PATH(regulator));
static const struct gpio_dt_spec check_gpio =
	GPIO_DT_SPEC_GET(DT_PATH(resources), check_gpios);
static const uint32_t startup_delay_ms = DT_PROP(DT_PATH(regulator),
						 startup_delay_us) / 1000U;
static const uint32_t off_on_delay_ms = DT_PROP(DT_PATH(regulator),
						off_on_delay_us) / 1000U;

ZTEST(regulator_fixed, test_enable_disable)
{
	int ret;
	int64_t init;

	zassert_true(k_uptime_get() >= startup_delay_ms);

	ret = gpio_pin_get_dt(&check_gpio);
	zassert_equal(ret, 1);

	zassert_true(regulator_is_enabled(reg));

	ret = regulator_disable(reg);
	zassert_equal(ret, 0);

	ret = gpio_pin_get_dt(&check_gpio);
	zassert_equal(ret, 0);

	init = k_uptime_get();
	ret = regulator_enable(reg);
	zassert_equal(ret, 0);
	zassert_true(k_uptime_delta(&init) >= off_on_delay_ms);

	ret = gpio_pin_get_dt(&check_gpio);
	zassert_equal(ret, 1);

	ret = regulator_disable(reg);
	zassert_equal(ret, 0);

	ret = gpio_pin_get_dt(&check_gpio);
	zassert_equal(ret, 0);
}

void *setup(void)
{
	zassert_true(device_is_ready(reg));
	zassert_equal(gpio_pin_configure_dt(&check_gpio, GPIO_INPUT), 0);

	return NULL;
}

ZTEST_SUITE(regulator_fixed, NULL, setup, NULL, NULL, NULL);
```
