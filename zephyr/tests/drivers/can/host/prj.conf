## CMakeLists.txt
```
# SPDX-License-Identifier: Apache-2.0

cmake_minimum_required(VERSION 3.20.0)
find_package(Zephyr REQUIRED HINTS $ENV{ZEPHYR_BASE})
project(can_host)

FILE(GLOB app_sources src/*.c)
target_sources(app PRIVATE ${app_sources})
```

## prj.conf
```kconfig
CONFIG_SHELL=y
CONFIG_CAN=y
CONFIG_CAN_FD_MODE=y
CONFIG_CAN_SHELL=y
CONFIG_CAN_SHELL_SCRIPTING_FRIENDLY=y
```

## boards/native_sim.overlay
```dts
/*
 * Copyright 2024 Vestas Wind Systems A/S
 *
 * SPDX-License-Identifier: Apache-2.0
 */

/ {
	chosen {
		zephyr,canbus = &can0;
	};
};

&can_loopback0 {
	status = "disabled";
};

&can0 {
	status = "okay";
};
```

## boards/native_sim_native_64.overlay
```dts
/*
 * Copyright 2024 Vestas Wind Systems A/S
 *
 * SPDX-License-Identifier: Apache-2.0
 */

#include "native_sim.overlay"
```

## src/main.c
```c
/*
 * Copyright (c) 2024 Vestas Wind Systems A/S
 *
 * SPDX-License-Identifier: Apache-2.0
 */

#include <zephyr/device.h>
#include <zephyr/shell/shell.h>

static const struct device *chosen = DEVICE_DT_GET(DT_CHOSEN(zephyr_canbus));

static int cmd_can_host_chosen(const struct shell *sh, size_t argc, char **argv)
{
	ARG_UNUSED(argc);
	ARG_UNUSED(argv);

	if (!device_is_ready(chosen)) {
		shell_error(sh, "zephyr,canbus device %s not ready", chosen->name);
		return -ENODEV;
	}

	shell_print(sh, "zephyr,canbus: %s", chosen->name);

	return 0;
}

SHELL_STATIC_SUBCMD_SET_CREATE(sub_can_host_cmds,
	SHELL_CMD(chosen, NULL,
		"Get zephyr,canbus chosen device name\n"
		"Usage: can_host chosen",
		cmd_can_host_chosen),
	SHELL_SUBCMD_SET_END
);

SHELL_CMD_REGISTER(can_host, &sub_can_host_cmds, "CAN host test commands", NULL);
```
