## CMakeLists.txt
```
# Copyright (c) 2022 Bjarki Arge Andreasen
# SPDX-License-Identifier: Apache-2.0

cmake_minimum_required(VERSION 3.20.0)

find_package(Zephyr REQUIRED HINTS $ENV{ZEPHYR_BASE})

project(rtc_api)

target_sources(app PRIVATE
	src/main.c
	src/test_rtc_time_to_tm.c
	src/test_rtc_calibration_from_frequency.c
)
```

## prj.conf
```kconfig
# Copyright (c) 2022 Bjarki Arge Andreasen
# SPDX-License-Identifier: Apache-2.0

CONFIG_RTC=y
CONFIG_ZTEST=y
```

## src/main.c
```c
/*
 * Copyright 2022 Bjarki Arge Andreasen
 *
 * SPDX-License-Identifier: Apache-2.0
 */

#include <zephyr/ztest.h>

ZTEST_SUITE(rtc_api_helpers, NULL, NULL, NULL, NULL, NULL);
```

## src/test_rtc_calibration_from_frequency.c
```c
/*
 * Copyright 2022 Bjarki Arge Andreasen
 *
 * SPDX-License-Identifier: Apache-2.0
 */

#include <zephyr/ztest.h>
#include <zephyr/drivers/rtc.h>

struct test_sample {
	uint32_t frequency;
	int32_t calibration;
};

static const struct test_sample test_samples[] = {
	{
		.frequency = 1000000000,
		.calibration = 0,
	},
	{
		.frequency = 1000000001,
		.calibration = -1,
	},
	{
		.frequency = 999999999,
		.calibration = 1,
	},
	{
		.frequency = 2000000000,
		.calibration = -500000000,
	},
	{
		.frequency = 500000000,
		.calibration = 1000000000,
	},
};

ZTEST(rtc_api_helpers, test_validate_calibration_from_frequency)
{
	uint32_t frequency;
	int32_t calibration;
	int32_t result;

	ARRAY_FOR_EACH(test_samples, i) {
		frequency = test_samples[i].frequency;
		calibration = test_samples[i].calibration;
		result = rtc_calibration_from_frequency(frequency);
		zassert_equal(result, calibration);
	}
}
```

## src/test_rtc_time_to_tm.c
```c
/*
 * Copyright 2022 Bjarki Arge Andreasen
 *
 * SPDX-License-Identifier: Apache-2.0
 */

#include <zephyr/ztest.h>
#include <zephyr/drivers/rtc.h>
#include <time.h>

ZTEST(rtc_api_helpers, test_validate_rtc_time_compat_with_tm)
{
	zassert_equal(offsetof(struct rtc_time, tm_sec), offsetof(struct tm, tm_sec),
		      "Offset of tm_sec in struct rtc_time does not match struct tm");

	zassert_equal(offsetof(struct rtc_time, tm_min), offsetof(struct tm, tm_min),
		      "Offset of tm_min in struct rtc_time does not match struct tm");

	zassert_equal(offsetof(struct rtc_time, tm_hour), offsetof(struct tm, tm_hour),
		      "Offset of tm_hour in struct rtc_time does not match struct tm");

	zassert_equal(offsetof(struct rtc_time, tm_mday), offsetof(struct tm, tm_mday),
		      "Offset of tm_mday in struct rtc_time does not match struct tm");

	zassert_equal(offsetof(struct rtc_time, tm_mon), offsetof(struct tm, tm_mon),
		      "Offset of tm_mon in struct rtc_time does not match struct tm");

	zassert_equal(offsetof(struct rtc_time, tm_year), offsetof(struct tm, tm_year),
		      "Offset of tm_year in struct rtc_time does not match struct tm");

	zassert_equal(offsetof(struct rtc_time, tm_wday), offsetof(struct tm, tm_wday),
		      "Offset of tm_wday in struct rtc_time does not match struct tm");

	zassert_equal(offsetof(struct rtc_time, tm_yday), offsetof(struct tm, tm_yday),
		      "Offset of tm_yday in struct rtc_time does not match struct tm");

	zassert_equal(offsetof(struct rtc_time, tm_isdst), offsetof(struct tm, tm_isdst),
		      "Offset of tm_isdts in struct rtc_time does not match struct tm");
}

ZTEST(rtc_api_helpers, test_validate_rtc_time_to_tm)
{
	struct rtc_time rtc_datetime;
	struct tm *datetime = NULL;

	datetime = rtc_time_to_tm(&rtc_datetime);

	zassert(((struct tm *)&rtc_datetime) == datetime, "Incorrect typecast");
}
```
