## CMakeLists.txt
```
# SPDX-License-Identifier: Apache-2.0

cmake_minimum_required(VERSION 3.20.0)

find_package(Zephyr REQUIRED HINTS $ENV{ZEPHYR_BASE})
project(test_mcuboot)

FILE(GLOB app_sources src/*.c)
target_sources(app PRIVATE ${app_sources})
```

## prj.conf
```kconfig
# Enable zephyr dfu boot utility library
CONFIG_IMG_MANAGER=y
# Enable flash drivers for MCUBoot
CONFIG_FLASH=y
CONFIG_FLASH_MAP=y
CONFIG_STREAM_FLASH=y
# Enable reboot API to reset board after selecting new image
CONFIG_REBOOT=y
```

## src/main.c
```c
/*
 * Copyright 2022-2024 NXP
 *
 * SPDX-License-Identifier: Apache-2.0
 */

#include <zephyr/kernel.h>
#include <zephyr/sys/reboot.h>
#include <zephyr/dfu/mcuboot.h>

/* Main entry point */
int main(void)
{
	int err;

	printk("Launching primary slot application on %s\n", CONFIG_BOARD);
	/* Perform a permanent swap of MCUBoot application */
	err = boot_request_upgrade(BOOT_UPGRADE_PERMANENT);
	if (err) {
		printk("Failed to request upgrade: %d", err);
	} else {
		printk("Secondary application ready for swap, rebooting\n");
		sys_reboot(SYS_REBOOT_COLD);
	}
	return 0;
}
```
