## CMakeLists.txt
```
# Copyright (c) 2024 Meta
# SPDX-License-Identifier: Apache-2.0

cmake_minimum_required(VERSION 3.20.0)
find_package(Zephyr REQUIRED HINTS $ENV{ZEPHYR_BASE})
project(stack_unwind_test)

FILE(GLOB app_sources src/*.c)
target_sources(app PRIVATE ${app_sources})
```

## prj.conf
```kconfig
CONFIG_TEST=y

CONFIG_LOG=y
CONFIG_LOG_BUFFER_SIZE=2048

CONFIG_EXCEPTION_STACK_TRACE=y
CONFIG_DEBUG=y
```

## src/main.c
```c
/*
 * Copyright (c) 2024 Meta
 *
 * SPDX-License-Identifier: Apache-2.0
 */

#include <stdio.h>
#include <stdbool.h>

#include <zephyr/kernel.h>

static void func1(int a);
static void func2(int a);

static void func2(int a)
{
	printf("%d: %s\n", a, __func__);

	if (a >= 5) {
		k_oops();
	}

	func1(a + 1);
}

static void func1(int a)
{
	printf("%d: %s\n", a, __func__);
	func2(a + 1);
}

int main(void)
{
	printf("Hello World! %s\n", CONFIG_BOARD);

	func1(1);

	return 0;
}
```
