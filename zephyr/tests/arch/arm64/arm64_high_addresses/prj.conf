## CMakeLists.txt
```
# SPDX-License-Identifier: Apache-2.0

cmake_minimum_required(VERSION 3.20.0)

find_package(Zephyr REQUIRED HINTS $ENV{ZEPHYR_BASE})
project(arm64_high_addresses)

target_sources(app PRIVATE src/main.c)
```

## prj.conf
```kconfig
CONFIG_TEST_USERSPACE=y
CONFIG_ASSERT=y
CONFIG_LOG=y
CONFIG_LOG_MODE_MINIMAL=y
CONFIG_MAIN_STACK_SIZE=2560
CONFIG_ZTEST=y
```

## src/main.c
```c
/*
 * Copyright (c) 2020 BayLibre, SAS
 *
 * SPDX-License-Identifier: Apache-2.0
 */

#include <zephyr/kernel.h>
#include <zephyr/ztest.h>

ZTEST_USER(arm64_high_addresses, test_arm64_high_addresses)
{
	ztest_test_pass();
}

ZTEST_SUITE(arm64_high_addresses, NULL, NULL, NULL, NULL, NULL);
```
