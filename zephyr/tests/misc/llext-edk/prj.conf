## CMakeLists.txt
```
# SPDX-License-Identifier: Apache-2.0

cmake_minimum_required(VERSION 3.20.0)
find_package(Zephyr REQUIRED HINTS $ENV{ZEPHYR_BASE})
project(llext_edk_test LANGUAGES C)

target_sources(app PRIVATE src/main.c)
zephyr_include_directories(include)
zephyr_include_directories(${ZEPHYR_BASE}/boards/native/common)
```

## prj.conf
```kconfig
CONFIG_APPLICATION_DEFINED_SYSCALL=y
#CONFIG_USERSPACE=y
CONFIG_LLEXT=y
```

## src/main.c
```c
/*
 * Copyright (c) 2024 Intel Corporation
 *
 * SPDX-License-Identifier: Apache-2.0
 */

#include <app_api.h>

#include <zephyr/llext/llext.h>

int main(void)
{
	return 0;
}
```

## include/app_api.h
```c
/*
 * Copyright (c) 2024 Intel Corporation
 *
 * SPDX-License-Identifier: Apache-2.0
 */

#ifndef _TEST_EDK_H_
#define _TEST_EDK_H_
#include <zephyr/kernel.h>

#ifdef __cplusplus
extern "C" {
#endif

__syscall int foo(int bar);

#ifdef __cplusplus
}
#endif

#include <zephyr/syscalls/app_api.h>
#endif /* _TEST_EDK_H_ */
```

## src/foo.c
```c
/*
 * Copyright (c) 2024 Intel Corporation
 *
 * SPDX-License-Identifier: Apache-2.0
 */

#include <app_api.h>
#include <app_api.h>

int z_impl_foo(int bar)
{
	return bar * bar;
}
EXPORT_SYMBOL(z_impl_foo);

#ifdef CONFIG_USERSPACE
static inline int z_vrfy_foo(int bar)
{
	/* Nothing to verify */
	return z_impl_foo(bar);
}
#include <zephyr/syscalls/foo_mrsh.c>
#endif
```
