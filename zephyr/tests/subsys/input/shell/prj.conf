## CMakeLists.txt
```
# SPDX-License-Identifier: Apache-2.0

cmake_minimum_required(VERSION 3.20.0)
find_package(Zephyr REQUIRED HINTS $ENV{ZEPHYR_BASE})

project(input_shell)

target_sources(app PRIVATE src/main.c)
```

## prj.conf
```kconfig
# SPDX-License-Identifier: Apache-2.0

CONFIG_LOG=y
CONFIG_LOG_MODE_MINIMAL=y
CONFIG_SHELL=y
CONFIG_SHELL_BACKEND_SERIAL=n
CONFIG_SHELL_BACKEND_DUMMY=y

CONFIG_INPUT=y
CONFIG_INPUT_EVENT_DUMP=y
CONFIG_INPUT_SHELL=y
```

## src/main.c
```c
/*
 * Copyright 2023 Google LLC
 *
 * SPDX-License-Identifier: Apache-2.0
 */

#include <stdio.h>
#include <zephyr/shell/shell.h>
#include <zephyr/shell/shell_dummy.h>

#define SLEEP_TIME_MS 200
#define CMD_BUF_LEN 128

int main(void)
{
	const struct shell *sh = shell_backend_dummy_get_ptr();
	bool val = false;
	int err;
	char buf[CMD_BUF_LEN];

	err = shell_execute_cmd(sh, "input dump on");
	if (err) {
		printf("Failed to execute the shell command: %d.\n",
		       err);
	}

	while (true) {
		snprintf(buf, 128, "input report 1 2 %d", val);
		err = shell_execute_cmd(sh, buf);
		if (err) {
			printf("Failed to execute the shell command: %d.\n",
			       err);
		}

		val = !val;

		k_msleep(SLEEP_TIME_MS);
	}

	return 0;
}
```
