## CMakeLists.txt
```
# SPDX-License-Identifier: Apache-2.0

cmake_minimum_required(VERSION 3.20.0)

find_package(Zephyr REQUIRED HINTS $ENV{ZEPHYR_BASE})
project(debug_gdbstub)

target_sources(app PRIVATE src/main.c)
```

## prj.conf
```kconfig
CONFIG_GDBSTUB=y
CONFIG_GDBSTUB_SERIAL_BACKEND=y
CONFIG_GDBSTUB_TRACE=n
CONFIG_NO_OPTIMIZATIONS=y
CONFIG_USERSPACE=y
CONFIG_KOBJECT_TEXT_AREA=4096
```

## boards/qemu_cortex_a9.overlay
```dts
/* SPDX-License-Identifier: Apache-2.0 */

/ {
	chosen {
		zephyr,gdbstub-uart = &uart1;
	};
};
```

## src/main.c
```c
/*
 * Copyright (c) 2020 Intel Corporation.
 *
 * SPDX-License-Identifier: Apache-2.0
 */

#include <zephyr/kernel.h>
#include <zephyr/sys/printk.h>

#define STACKSIZE 512

static int test(void)
{
	int a;
	int b;

	a = 10;
	b = a * 2;

	return a + b;
}

int main(void)
{
	int ret;

	printk("%s():enter\n", __func__);
	ret = test();
	printk("ret=%d\n", ret);
	return 0;
}
```
