## CMakeLists.txt
```
# SPDX-License-Identifier: Apache-2.0
cmake_minimum_required(VERSION 3.20.0)

find_package(Zephyr REQUIRED HINTS $ENV{ZEPHYR_BASE})
project(test_unit)

FILE(GLOB app_sources src/*.c)
target_sources(app PRIVATE ${app_sources})
```

## prj.conf
```kconfig
CONFIG_ZTEST=y
CONFIG_ASSERT=y
CONFIG_LOG=y
CONFIG_ZBUS=y
CONFIG_ZBUS_LOG_LEVEL_DBG=y
CONFIG_ZBUS_ASSERT_MOCK=y
CONFIG_IRQ_OFFLOAD=y
CONFIG_ZBUS_MSG_SUBSCRIBER=y
CONFIG_ZBUS_MSG_SUBSCRIBER_NET_BUF_POOL_SIZE=2
CONFIG_ZBUS_RUNTIME_OBSERVERS=y
CONFIG_HEAP_MEM_POOL_SIZE=2048
CONFIG_ZBUS_CHANNEL_NAME=y
CONFIG_ZBUS_OBSERVER_NAME=y
```

## src/messages.h
```c
/*
 * Copyright (c) 2022 Rodrigo Peixoto <rodrigopex@gmail.com>
 * SPDX-License-Identifier: Apache-2.0
 */
#ifndef _ZBUS_MESSAGES_H_
#define _ZBUS_MESSAGES_H_
#include <stdbool.h>
#include <stddef.h>
#include <stdint.h>

struct version_msg {
	uint8_t major;
	uint8_t minor;
	uint16_t build;
};

struct sensor_data_msg {
	int a;
	int b;
};

struct net_pkt_msg {
	char x;
	bool y;
};

struct action_msg {
	bool status;
};

struct s1_msg {
	int m;
	struct {
		int a, b, c;
	} field;
};

struct hard_msg {
	int16_t range;	  /* Range 0 to 1023 */
	uint8_t binary;	  /* Range 0 to 1 */
	int16_t *pointer; /* Not null */
};

#endif /* _ZBUS_MESSAGES_H_ */
```
