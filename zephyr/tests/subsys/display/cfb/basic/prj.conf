## CMakeLists.txt
```
# Copyright (c) 2024 TOKITA Hiroshi
# SPDX-License-Identifier: Apache-2.0

cmake_minimum_required(VERSION 3.20.0)

find_package(Zephyr REQUIRED HINTS $ENV{ZEPHYR_BASE})

project(cfb_basic)

if(CONFIG_TEST_MSB_FIRST_FONT)
	target_sources(app PRIVATE src/testdata.c
				   src/utils.c
				   src/clear.c
				   src/draw_point.c
				   src/draw_line.c
				   src/draw_rect.c
				   src/draw_text_rectspace1016.c
				   src/invert.c
				   src/invert_area.c
				   src/print_rectspace1016.c
				   src/cfb_font_rectspace1016_msb.c)
else()
	target_sources(app PRIVATE src/testdata.c
				   src/utils.c
				   src/clear.c
				   src/draw_point.c
				   src/draw_line.c
				   src/draw_rect.c
				   src/draw_text_rectspace1016.c
				   src/invert.c
				   src/invert_area.c
				   src/print_rectspace1016.c
				   src/cfb_font_rectspace1016.c)
endif()
```

## Kconfig
```
# Copyright (c) 2024 TOKITA Hiroshi
# SPDX-License-Identifier: Apache-2.0

menu "Zephyr"
source "Kconfig.zephyr"
endmenu

config TEST_MSB_FIRST_FONT
	bool "Use MSB_FIRST font"
```

## prj.conf
```kconfig
# Copyright (c) 2024 TOKITA Hiroshi
# SPDX-License-Identifier: Apache-2.0

CONFIG_ZTEST=y
CONFIG_DISPLAY=y
CONFIG_CHARACTER_FRAMEBUFFER=y
CONFIG_CHARACTER_FRAMEBUFFER_USE_DEFAULT_FONTS=n

CONFIG_HEAP_MEM_POOL_SIZE=16384

CONFIG_LOG=y
```

## src/cfb_font_rectspace1016.c
```c
/*
 * Copyright (c) 2024 TOKITA Hiroshi
 *
 * SPDX-License-Identifier: Apache-2.0
 */

#include <zephyr/kernel.h>
#include <zephyr/display/cfb.h>

const uint8_t cfb_font_1016_rectspace[1][20] = {
	/*   */
	{
		0xFF, 0xFF, 0x01, 0x80, 0x01, 0x80, 0x01, 0x80, 0x01, 0x80,
		0x01, 0x80, 0x01, 0x80, 0x01, 0x80, 0x01, 0x80, 0xFF, 0xFF,
	},
};

FONT_ENTRY_DEFINE(font1016_rectspace, 10, 16, CFB_FONT_MONO_VPACKED, cfb_font_1016_rectspace, 32,
		  33);
```

## src/cfb_font_rectspace1016_msb.c
```c
/*
 * Copyright (c) 2024 TOKITA Hiroshi
 *
 * SPDX-License-Identifier: Apache-2.0
 */

#include <zephyr/kernel.h>
#include <zephyr/display/cfb.h>

const uint8_t cfb_font_1016_rectspace[1][20] = {
	/*   */
	{
		0xFF, 0xFF, 0x80, 0x01, 0x80, 0x01, 0x80, 0x01, 0x80, 0x01,
		0x80, 0x01, 0x80, 0x01, 0x80, 0x01, 0x80, 0x01, 0xFF, 0xFF,
	},
};

FONT_ENTRY_DEFINE(font1016_rectspace, 10, 16, CFB_FONT_MONO_VPACKED | CFB_FONT_MSB_FIRST,
		  cfb_font_1016_rectspace, 32, 33);
```

## src/clear.c
```c
/*
 * Copyright (c) 2024 TOKITA Hiroshi
 *
 * SPDX-License-Identifier: Apache-2.0
 */

#include <zephyr/drivers/display.h>
#include <zephyr/ztest.h>
#include <zephyr/device.h>
#include <zephyr/logging/log.h>
#include <zephyr/display/cfb.h>

#include "testdata.h"
#include "utils.h"

LOG_MODULE_REGISTER(clear, CONFIG_DISPLAY_LOG_LEVEL);

static const struct device *dev = DEVICE_DT_GET(DT_CHOSEN(zephyr_display));
static const uint32_t display_width = DT_PROP(DT_CHOSEN(zephyr_display), width);
static const uint32_t display_height = DT_PROP(DT_CHOSEN(zephyr_display), height);

/**
 * Fill the buffer with 0xAA before running tests.
 */
static void cfb_test_before(void *text_fixture)
{
	struct display_buffer_descriptor desc = {
		.height = display_height,
		.pitch = display_width,
		.width = display_width,
		.buf_size = display_height * display_width / 8,
	};

	memset(read_buffer, 0xAA, sizeof(read_buffer));
	zassert_ok(display_write(dev, 0, 0, &desc, read_buffer));

	zassert_ok(display_blanking_off(dev));

	zassert_ok(cfb_framebuffer_init(dev));
}

static void cfb_test_after(void *test_fixture)
{
	cfb_framebuffer_deinit(dev);
}

ZTEST(clear, test_clear_false)
{
	zassert_ok(cfb_framebuffer_clear(dev, false));

	/* checking memory not updated */
	zassert_false(verify_color_inside_rect(0, 0, 320, 240, 0x0));
}

ZTEST(clear, test_clear_true)
{
	zassert_ok(cfb_framebuffer_clear(dev, true));

	zassert_true(verify_color_inside_rect(0, 0, 320, 240, 0x0));
}

ZTEST_SUITE(clear, NULL, NULL, cfb_test_before, cfb_test_after, NULL);
```

## src/draw_line.c
```c
/*
 * Copyright (c) 2024 TOKITA Hiroshi
 *
 * SPDX-License-Identifier: Apache-2.0
 */

#include <zephyr/drivers/display.h>
#include <zephyr/ztest.h>
#include <zephyr/device.h>
#include <zephyr/logging/log.h>
#include <zephyr/display/cfb.h>

#include "testdata.h"
#include "utils.h"

LOG_MODULE_REGISTER(draw_line, CONFIG_DISPLAY_LOG_LEVEL);

static const struct device *dev = DEVICE_DT_GET(DT_CHOSEN(zephyr_display));
static const uint32_t display_width = DT_PROP(DT_CHOSEN(zephyr_display), width);
static const uint32_t display_height = DT_PROP(DT_CHOSEN(zephyr_display), height);

/**
 * Fill the buffer with 0 before running tests.
 */
static void cfb_test_before(void *text_fixture)
{
	struct display_buffer_descriptor desc = {
		.height = display_height,
		.pitch = display_width,
		.width = display_width,
		.buf_size = display_height * display_width / 8,
	};

	memset(read_buffer, 0, sizeof(read_buffer));
	zassert_ok(display_write(dev, 0, 0, &desc, read_buffer));

	zassert_ok(display_blanking_off(dev));

	zassert_ok(cfb_framebuffer_init(dev));
}

static void cfb_test_after(void *test_fixture)
{
	cfb_framebuffer_deinit(dev);
}

ZTEST(draw_line, test_draw_line_top_end)
{
	struct cfb_position start = {0, 0};
	struct cfb_position end = {display_width, 0};

	zassert_ok(cfb_draw_line(dev, &start, &end));
	zassert_ok(cfb_framebuffer_finalize(dev));

	zassert_true(verify_color_inside_rect(0, 0, display_width, 1, 0xFFFFFF));
}

ZTEST(draw_line, test_draw_line_left_end)
{
	struct cfb_position start = {0, 0};
	struct cfb_position end = {0, display_height};

	zassert_ok(cfb_draw_line(dev, &start, &end));
	zassert_ok(cfb_framebuffer_finalize(dev));

	zassert_true(verify_color_inside_rect(0, 0, 1, display_height, 0xFFFFFF));
}

ZTEST(draw_line, test_draw_right_end)
{
	struct cfb_position start = {display_width - 1, 0};
	struct cfb_position end = {display_width - 1, display_height};

	zassert_ok(cfb_draw_line(dev, &start, &end));
	zassert_ok(cfb_framebuffer_finalize(dev));

	zassert_true(verify_color_inside_rect(display_width - 1, 0, 1, display_height, 0xFFFFFF));
}

ZTEST(draw_line, test_draw_line_bottom_end)
{
	struct cfb_position start = {0, 239};
	struct cfb_position end = {display_width, 239};

	zassert_ok(cfb_draw_line(dev, &start, &end));
	zassert_ok(cfb_framebuffer_finalize(dev));

	zassert_true(verify_color_inside_rect(0, display_height - 1, display_width, 1, 0xFFFFFF));
}

ZTEST(draw_line, test_render_twice_on_same_tile)
{
	struct cfb_position start = {0, 0};
	struct cfb_position end = {display_width, 0};

	zassert_ok(cfb_draw_line(dev, &start, &end));
	start.y = 7;
	end.y = 7;
	zassert_ok(cfb_draw_line(dev, &start, &end));
	zassert_ok(cfb_framebuffer_finalize(dev));

	zassert_true(verify_color_inside_rect(0, 0, display_width, 1, 0xFFFFFF));
	zassert_true(verify_color_inside_rect(0, 1, display_width, 6, 0x0));
	zassert_true(verify_color_inside_rect(0, 7, display_width, 1, 0xFFFFFF));
	zassert_true(verify_color_inside_rect(0, 8, display_width, 232, 0x0));
}

ZTEST(draw_line, test_crossing_diagonally_end_to_end)
{
	struct cfb_position start = {0, 0};
	struct cfb_position end = {320, 240};

	zassert_ok(cfb_draw_line(dev, &start, &end));
	zassert_ok(cfb_framebuffer_finalize(dev));

	for (size_t i = 0; i < 10; i++) {
		zassert_true(verify_image(32 * i, 24 * i, diagonal3224, 32, 24));
	}
}

ZTEST(draw_line, test_crossing_diagonally_from_outside_area)
{
	struct cfb_position start = {-32, -48};
	struct cfb_position end = {384, 264};

	zassert_ok(cfb_draw_line(dev, &start, &end));
	zassert_ok(cfb_framebuffer_finalize(dev));

	for (size_t i = 0; i < 9; i++) {
		zassert_true(verify_image(32 + 32 * i, 24 * i, diagonal3224, 32, 24));
	}
}

ZTEST_SUITE(draw_line, NULL, NULL, cfb_test_before, cfb_test_after, NULL);
```

## src/draw_point.c
```c
/*
 * Copyright (c) 2024 TOKITA Hiroshi
 *
 * SPDX-License-Identifier: Apache-2.0
 */

#include <zephyr/drivers/display.h>
#include <zephyr/ztest.h>
#include <zephyr/device.h>
#include <zephyr/logging/log.h>
#include <zephyr/display/cfb.h>

#include "testdata.h"
#include "utils.h"

LOG_MODULE_REGISTER(draw_point, CONFIG_DISPLAY_LOG_LEVEL);

static const struct device *dev = DEVICE_DT_GET(DT_CHOSEN(zephyr_display));
static const uint32_t display_width = DT_PROP(DT_CHOSEN(zephyr_display), width);
static const uint32_t display_height = DT_PROP(DT_CHOSEN(zephyr_display), height);

/**
 * Fill the buffer with 0 before running tests.
 */
static void cfb_test_before(void *text_fixture)
{
	struct display_buffer_descriptor desc = {
		.height = display_height,
		.pitch = display_width,
		.width = display_width,
		.buf_size = display_height * display_width / 8,
	};

	memset(read_buffer, 0, sizeof(read_buffer));
	zassert_ok(display_write(dev, 0, 0, &desc, read_buffer));

	zassert_ok(display_blanking_off(dev));

	zassert_ok(cfb_framebuffer_init(dev));
}

static void cfb_test_after(void *test_fixture)
{
	cfb_framebuffer_deinit(dev);
}

/*
 * normal rendering
 */
ZTEST(draw_point, test_draw_point_at_0_0)
{
	struct cfb_position pos = {0, 0};

	zassert_ok(cfb_draw_point(dev, &pos));
	zassert_ok(cfb_framebuffer_finalize(dev));

	zassert_true(verify_pixel_and_bg(0, 0, 1, 0));
}

ZTEST(draw_point, test_draw_point_at_1_1)
{
	struct cfb_position pos = {1, 1};

	zassert_ok(cfb_draw_point(dev, &pos));
	zassert_ok(cfb_framebuffer_finalize(dev));

	zassert_true(verify_pixel_and_bg(1, 1, 1, 0));
}

/*
 * around tile border
 */
ZTEST(draw_point, test_draw_pont_at_9_15)
{
	struct cfb_position pos = {9, 15};

	zassert_ok(cfb_draw_point(dev, &pos));
	zassert_ok(cfb_framebuffer_finalize(dev));

	zassert_true(verify_pixel_and_bg(9, 15, 1, 0));
}

ZTEST(draw_point, test_draw_point_at_10_16)
{
	struct cfb_position pos = {10, 16};

	zassert_ok(cfb_draw_point(dev, &pos));
	zassert_ok(cfb_framebuffer_finalize(dev));

	zassert_true(verify_pixel_and_bg(10, 16, 1, 0));
}

ZTEST(draw_point, test_draw_point_at_11_17)
{
	struct cfb_position pos = {11, 17};

	zassert_ok(cfb_draw_point(dev, &pos));
	zassert_ok(cfb_framebuffer_finalize(dev));

	zassert_true(verify_pixel_and_bg(11, 17, 1, 0));
}

ZTEST(draw_point, test_draw_point_twice_on_same_tile)
{
	struct cfb_position pos = {10, 0};

	pos.y = 7;
	zassert_ok(cfb_draw_point(dev, &pos));

	pos.y = 8;
	zassert_ok(cfb_draw_point(dev, &pos));

	pos.y = 9;
	zassert_ok(cfb_draw_point(dev, &pos));

	zassert_ok(cfb_framebuffer_finalize(dev));

	zassert_true(verify_color_inside_rect(10, 7, 1, 3, 0xFFFFFF));
	zassert_true(verify_color_outside_rect(10, 7, 1, 3, 0x0));
}

ZTEST(draw_point, test_draw_point_outside_top_left)
{
	struct cfb_position pos = {0, -1};

	zassert_ok(cfb_draw_point(dev, &pos));
	zassert_ok(cfb_framebuffer_finalize(dev));

	zassert_true(verify_color_inside_rect(0, 0, display_width, display_height, 0));
}

ZTEST(draw_point, test_draw_point_outside_top_right)
{
	struct cfb_position pos = {display_width, 0};

	zassert_ok(cfb_draw_point(dev, &pos));
	zassert_ok(cfb_framebuffer_finalize(dev));

	zassert_true(verify_color_inside_rect(0, 0, display_width, display_height, 0));
}

ZTEST(draw_point, test_draw_point_outside_bottom_right)
{
	struct cfb_position pos = {0, display_height};

	zassert_ok(cfb_draw_point(dev, &pos));
	zassert_ok(cfb_framebuffer_finalize(dev));

	zassert_true(verify_color_inside_rect(0, 0, display_width, display_height, 0));
}

ZTEST(draw_point, test_draw_point_outside_bottom_left)
{
	struct cfb_position pos = {-1, display_height};

	zassert_ok(cfb_draw_point(dev, &pos));
	zassert_ok(cfb_framebuffer_finalize(dev));

	zassert_true(verify_color_inside_rect(0, 0, display_width, display_height, 0));
}

ZTEST_SUITE(draw_point, NULL, NULL, cfb_test_before, cfb_test_after, NULL);
```

## src/draw_rect.c
```c
/*
 * Copyright (c) 2024 TOKITA Hiroshi
 *
 * SPDX-License-Identifier: Apache-2.0
 */

#include <zephyr/drivers/display.h>
#include <zephyr/ztest.h>
#include <zephyr/device.h>
#include <zephyr/logging/log.h>
#include <zephyr/display/cfb.h>

#include "testdata.h"
#include "utils.h"

LOG_MODULE_REGISTER(draw_rect, CONFIG_DISPLAY_LOG_LEVEL);

static const struct device *dev = DEVICE_DT_GET(DT_CHOSEN(zephyr_display));
static const uint32_t display_width = DT_PROP(DT_CHOSEN(zephyr_display), width);
static const uint32_t display_height = DT_PROP(DT_CHOSEN(zephyr_display), height);

/**
 * Fill the buffer with 0 before running tests.
 */
static void cfb_test_before(void *text_fixture)
{
	struct display_buffer_descriptor desc = {
		.height = display_height,
		.pitch = display_width,
		.width = display_width,
		.buf_size = display_height * display_width / 8,
	};

	memset(read_buffer, 0, sizeof(read_buffer));
	zassert_ok(display_write(dev, 0, 0, &desc, read_buffer));

	zassert_ok(display_blanking_off(dev));

	zassert_ok(cfb_framebuffer_init(dev));
}

static void cfb_test_after(void *test_fixture)
{
	cfb_framebuffer_deinit(dev);
}

/*
 * normal rendering
 */
ZTEST(draw_rect, test_draw_rect_1123_at_0_0)
{
	struct cfb_position start = {0, 0};
	struct cfb_position end = {start.x + 10, start.y + 22};

	zassert_ok(cfb_draw_rect(dev, &start, &end), "");
	zassert_ok(cfb_framebuffer_finalize(dev), "");

	zassert_true(verify_image_and_bg(0, 0, rectspace1123, 11, 23, 0), "");
}

ZTEST(draw_rect, test_draw_rect_1123_at_1_1)
{
	struct cfb_position start = {1, 1};
	struct cfb_position end = {start.x + 10, start.y + 22};

	zassert_ok(cfb_draw_rect(dev, &start, &end), "");
	zassert_ok(cfb_framebuffer_finalize(dev), "");

	zassert_true(verify_image_and_bg(1, 1, rectspace1123, 11, 23, 0), "");
}

/* tile border case */
ZTEST(draw_rect, test_draw_rect_1123_at_9_15)
{
	struct cfb_position start = {9, 15};
	struct cfb_position end = {start.x + 10, start.y + 22};

	zassert_ok(cfb_draw_rect(dev, &start, &end), "");
	zassert_ok(cfb_framebuffer_finalize(dev), "");

	zassert_true(verify_image_and_bg(9, 15, rectspace1123, 11, 23, 0), "");
}

ZTEST(draw_rect, test_draw_rect_1123_at_10_16)
{
	struct cfb_position start = {10, 16};
	struct cfb_position end = {start.x + 10, start.y + 22};

	zassert_ok(cfb_draw_rect(dev, &start, &end), "");
	zassert_ok(cfb_framebuffer_finalize(dev), "");

	zassert_true(verify_image_and_bg(10, 16, rectspace1123, 11, 23, 0), "");
}

ZTEST(draw_rect, test_draw_rect_1123_at_11_17)
{
	struct cfb_position start = {11, 17};
	struct cfb_position end = {start.x + 10, start.y + 22};

	zassert_ok(cfb_draw_rect(dev, &start, &end), "");
	zassert_ok(cfb_framebuffer_finalize(dev), "");

	zassert_true(verify_image_and_bg(11, 17, rectspace1123, 11, 23, 0), "");
}

/*
 * Case of including coordinates outside the area
 */
ZTEST(draw_rect, test_draw_rect_1123_outside_top_left)
{
	struct cfb_position start = {-(11 - 3), -(23 - 4)};
	struct cfb_position end = {start.x + 10, start.y + 22};

	zassert_ok(cfb_draw_rect(dev, &start, &end), "");
	zassert_ok(cfb_framebuffer_finalize(dev), "");

	zassert_true(verify_image_and_bg(0, 0, outside_top_left, 3, 4, 0), "");
}

ZTEST(draw_rect, test_draw_rect_1123_outside_top_right)
{
	struct cfb_position start = {display_width - 5, -(23 - 8)};
	struct cfb_position end = {start.x + 10, start.y + 22};

	zassert_ok(cfb_draw_rect(dev, &start, &end), "");
	zassert_ok(cfb_framebuffer_finalize(dev), "");

	zassert_true(verify_image(display_width - 5, 0, outside_top_right, 5, 8), "");
}

ZTEST(draw_rect, test_draw_rect_1123_outside_bottom_right)
{
	struct cfb_position start = {display_width - 3, display_height - 5};
	struct cfb_position end = {start.x + 10, start.y + 22};

	zassert_ok(cfb_draw_rect(dev, &start, &end), "");
	zassert_ok(cfb_framebuffer_finalize(dev), "");

	zassert_true(
		verify_image(display_width - 3, display_height - 5, outside_bottom_right, 3, 5),
		"");
}

ZTEST(draw_rect, test_draw_rect_1123_outside_bottom_left)
{
	struct cfb_position start = {-(11 - 3), display_height - 14};
	struct cfb_position end = {start.x + 10, start.y + 22};

	zassert_ok(cfb_draw_rect(dev, &start, &end), "");
	zassert_ok(cfb_framebuffer_finalize(dev), "");

	zassert_true(verify_image(0, display_height - 14, outside_bottom_left, 3, 14), "");
}

ZTEST_SUITE(draw_rect, NULL, NULL, cfb_test_before, cfb_test_after, NULL);
```

## src/draw_text_rectspace1016.c
```c
/*
 * Copyright (c) 2024 TOKITA Hiroshi
 *
 * SPDX-License-Identifier: Apache-2.0
 */

#include <zephyr/drivers/display.h>
#include <zephyr/ztest.h>
#include <zephyr/device.h>
#include <zephyr/logging/log.h>
#include <zephyr/display/cfb.h>

#include "testdata.h"
#include "utils.h"

LOG_MODULE_REGISTER(draw_text_rectspace1016, CONFIG_DISPLAY_LOG_LEVEL);

static const struct device *dev = DEVICE_DT_GET(DT_CHOSEN(zephyr_display));
static const uint32_t display_width = DT_PROP(DT_CHOSEN(zephyr_display), width);
static const uint32_t display_height = DT_PROP(DT_CHOSEN(zephyr_display), height);

/**
 * Fill the buffer with 0 before running tests.
 */
static void cfb_test_before(void *text_fixture)
{
	struct display_buffer_descriptor desc = {
		.height = display_height,
		.pitch = display_width,
		.width = display_width,
		.buf_size = display_height * display_width / 8,
	};
	uint8_t font_width;
	uint8_t font_height;
	bool font_found = false;

	memset(read_buffer, 0, sizeof(read_buffer));
	zassert_ok(display_write(dev, 0, 0, &desc, read_buffer));

	zassert_ok(display_blanking_off(dev));

	zassert_ok(cfb_framebuffer_init(dev));

	for (int idx = 0; idx < cfb_get_numof_fonts(dev); idx++) {
		if (cfb_get_font_size(dev, idx, &font_width, &font_height)) {
			break;
		}

		if (font_width == 10 && font_height == 16) {
			cfb_framebuffer_set_font(dev, idx);
			font_found = true;
			break;
		}
	}

	zassert_true(font_found);
}

static void cfb_test_after(void *test_fixture)
{
	cfb_framebuffer_deinit(dev);
}

/*
 * normal rendering
 */
ZTEST(draw_text_rectspace1016, test_draw_text_at_0_0)
{
	zassert_ok(cfb_draw_text(dev, " ", 0, 0));
	zassert_ok(cfb_framebuffer_finalize(dev));

	zassert_true(verify_image_and_bg(0, 0, rectspace1016, 10, 16, 0));
}

ZTEST(draw_text_rectspace1016, test_draw_text_at_1_1)
{
	zassert_ok(cfb_draw_text(dev, " ", 1, 1));
	zassert_ok(cfb_framebuffer_finalize(dev));

	zassert_true(verify_image_and_bg(1, 1, rectspace1016, 10, 16, 0));
}

/*
 * around tile border
 */
ZTEST(draw_text_rectspace1016, test_draw_text_at_9_15)
{
	zassert_ok(cfb_draw_text(dev, " ", 9, 15));
	zassert_ok(cfb_framebuffer_finalize(dev));

	zassert_true(verify_image_and_bg(9, 15, rectspace1016, 10, 16, 0));
}

ZTEST(draw_text_rectspace1016, test_draw_text_at_10_16)
{
	zassert_ok(cfb_draw_text(dev, " ", 10, 16));
	zassert_ok(cfb_framebuffer_finalize(dev));

	zassert_true(verify_image_and_bg(10, 16, rectspace1016, 10, 16, 0));
}

ZTEST(draw_text_rectspace1016, test_draw_text_at_11_17)
{
	zassert_ok(cfb_draw_text(dev, " ", 11, 17));
	zassert_ok(cfb_framebuffer_finalize(dev));

	zassert_true(verify_image_and_bg(11, 17, rectspace1016, 10, 16, 0));
}

/*
 * with kerning
 */
ZTEST(draw_text_rectspace1016, test_draw_text_at_0_0_kerning_3)
{
	cfb_set_kerning(dev, 3);
	zassert_ok(cfb_draw_text(dev, "  ", 0, 0));
	zassert_ok(cfb_framebuffer_finalize(dev));

	zassert_true(verify_image_and_bg(0, 0, kerning_3_2rectspace1016, 23, 16, 0));
}

ZTEST(draw_text_rectspace1016, test_draw_text_at_1_1_kerning_3)
{
	cfb_set_kerning(dev, 3);
	zassert_ok(cfb_draw_text(dev, "  ", 1, 1));
	zassert_ok(cfb_framebuffer_finalize(dev));

	zassert_true(verify_image_and_bg(1, 1, kerning_3_2rectspace1016, 23, 16, 0));
}

ZTEST(draw_text_rectspace1016, test_draw_text_at_9_15_kerning_3)
{
	cfb_set_kerning(dev, 3);
	zassert_ok(cfb_draw_text(dev, "  ", 9, 15));
	zassert_ok(cfb_framebuffer_finalize(dev));

	zassert_true(verify_image_and_bg(9, 15, kerning_3_2rectspace1016, 23, 16, 0));
}

ZTEST(draw_text_rectspace1016, test_draw_text_at_10_16_kerning_3)
{
	cfb_set_kerning(dev, 3);
	zassert_ok(cfb_draw_text(dev, "  ", 10, 16));
	zassert_ok(cfb_framebuffer_finalize(dev));

	zassert_true(verify_image_and_bg(10, 16, kerning_3_2rectspace1016, 23, 16, 0));
}

ZTEST(draw_text_rectspace1016, test_draw_text_at_11_17_kerning_3)
{
	cfb_set_kerning(dev, 3);
	zassert_ok(cfb_draw_text(dev, "  ", 11, 17));
	zassert_ok(cfb_framebuffer_finalize(dev));

	zassert_true(verify_image_and_bg(11, 17, kerning_3_2rectspace1016, 23, 16, 0));
}

ZTEST(draw_text_rectspace1016, test_draw_text_kerning_3_within_right_border)
{
	cfb_set_kerning(dev, 3);
	zassert_ok(cfb_draw_text(dev, "  ", display_width - 23, 17));
	zassert_ok(cfb_framebuffer_finalize(dev));

	zassert_true(verify_image(display_width - 23, 17, kerning_3_2rectspace1016, 23, 16));
}

ZTEST(draw_text_rectspace1016, test_draw_text_kerning_3_over_right_border)
{
	cfb_set_kerning(dev, 3);
	zassert_ok(cfb_draw_text(dev, "  ", display_width - 22, 17));
	zassert_ok(cfb_framebuffer_finalize(dev));

	zassert_true(
		verify_image(display_width - 22, 17, kerning_3_rightclip_1_2rectspace1016, 22, 16));
}

ZTEST(draw_text_rectspace1016, test_draw_text_outside_top_left)
{
	zassert_ok(cfb_draw_text(dev, " ", -(10 - 3), -(16 - 4)));
	zassert_ok(cfb_framebuffer_finalize(dev));

	zassert_true(verify_image_and_bg(0, 0, outside_top_left, 3, 4, 0));
}

ZTEST(draw_text_rectspace1016, test_draw_text_outside_top_right)
{
	zassert_ok(cfb_draw_text(dev, " ", display_width - 5, -(16 - 8)));
	zassert_ok(cfb_framebuffer_finalize(dev));

	zassert_true(verify_image(display_width - 5, 0, outside_top_right, 5, 8));
}

ZTEST(draw_text_rectspace1016, test_draw_text_outside_bottom_right)
{
	zassert_ok(cfb_draw_text(dev, " ", display_width - 3, display_height - 5));
	zassert_ok(cfb_framebuffer_finalize(dev));

	zassert_true(
		verify_image(display_width - 3, display_height - 5, outside_bottom_right, 3, 5));
}

ZTEST(draw_text_rectspace1016, test_draw_text_outside_bottom_left)
{
	zassert_ok(cfb_draw_text(dev, " ", -(10 - 3), display_height - 14));
	zassert_ok(cfb_framebuffer_finalize(dev));

	zassert_true(verify_image(0, display_height - 14, outside_bottom_left, 3, 14));
}

ZTEST_SUITE(draw_text_rectspace1016, NULL, NULL, cfb_test_before, cfb_test_after, NULL);
```

## src/invert.c
```c
/*
 * Copyright (c) 2024 TOKITA Hiroshi
 *
 * SPDX-License-Identifier: Apache-2.0
 */

#include <zephyr/drivers/display.h>
#include <zephyr/ztest.h>
#include <zephyr/device.h>
#include <zephyr/logging/log.h>
#include <zephyr/display/cfb.h>

#include "testdata.h"
#include "utils.h"

LOG_MODULE_REGISTER(invert, CONFIG_DISPLAY_LOG_LEVEL);

static const struct device *dev = DEVICE_DT_GET(DT_CHOSEN(zephyr_display));
static const uint32_t display_width = DT_PROP(DT_CHOSEN(zephyr_display), width);
static const uint32_t display_height = DT_PROP(DT_CHOSEN(zephyr_display), height);

/**
 * Fill the buffer with 0 before running tests.
 */
static void cfb_test_before(void *text_fixture)
{
	struct display_buffer_descriptor desc = {
		.height = display_height,
		.pitch = display_width,
		.width = display_width,
		.buf_size = display_height * display_width / 8,
	};

	memset(read_buffer, 0, sizeof(read_buffer));
	zassert_ok(display_write(dev, 0, 0, &desc, read_buffer));

	zassert_ok(display_blanking_off(dev));

	zassert_ok(cfb_framebuffer_init(dev));
}

static void cfb_test_after(void *test_fixture)
{
	cfb_framebuffer_deinit(dev);
}

ZTEST(invert, test_invert)
{
	zassert_ok(cfb_framebuffer_invert(dev));
	zassert_ok(cfb_framebuffer_finalize(dev));

	zassert_true(verify_color_inside_rect(0, 0, 320, 240, 0xFFFFFF));
}

ZTEST(invert, test_invert_contents)
{
	zassert_ok(cfb_invert_area(dev, 10, 10, 10, 10));
	zassert_ok(cfb_framebuffer_finalize(dev));
	zassert_true(verify_color_outside_rect(10, 10, 10, 10, 0));
	zassert_true(verify_color_inside_rect(10, 10, 10, 10, 0xFFFFFF));

	zassert_ok(cfb_framebuffer_invert(dev));
	zassert_ok(cfb_framebuffer_finalize(dev));

	zassert_true(verify_color_outside_rect(10, 10, 10, 10, 0xFFFFFF));
}

ZTEST_SUITE(invert, NULL, NULL, cfb_test_before, cfb_test_after, NULL);
```

## src/invert_area.c
```c
/*
 * Copyright (c) 2024 TOKITA Hiroshi
 *
 * SPDX-License-Identifier: Apache-2.0
 */

#include <zephyr/drivers/display.h>
#include <zephyr/ztest.h>
#include <zephyr/device.h>
#include <zephyr/logging/log.h>
#include <zephyr/display/cfb.h>

#include "testdata.h"
#include "utils.h"

LOG_MODULE_REGISTER(invert_area, CONFIG_DISPLAY_LOG_LEVEL);

static const struct device *dev = DEVICE_DT_GET(DT_CHOSEN(zephyr_display));
static const uint32_t display_width = DT_PROP(DT_CHOSEN(zephyr_display), width);
static const uint32_t display_height = DT_PROP(DT_CHOSEN(zephyr_display), height);

/**
 * Fill the buffer with 0 before running tests.
 */
static void cfb_test_before(void *text_fixture)
{
	struct display_buffer_descriptor desc = {
		.height = display_height,
		.pitch = display_width,
		.width = display_width,
		.buf_size = display_height * display_width / 8,
	};

	memset(read_buffer, 0, sizeof(read_buffer));
	zassert_ok(display_write(dev, 0, 0, &desc, read_buffer));

	zassert_ok(display_blanking_off(dev));

	zassert_ok(cfb_framebuffer_init(dev));
}

static void cfb_test_after(void *test_fixture)
{
	cfb_framebuffer_deinit(dev);
}

ZTEST(invert_area, test_invert_area_whole_screen)
{
	zassert_ok(cfb_invert_area(dev, 0, 0, 320, 240));
	zassert_ok(cfb_framebuffer_finalize(dev), "cfb_framebuffer_finalize failed");

	zassert_true(verify_color_inside_rect(0, 0, 320, 240, 0xFFFFFF));
}

ZTEST(invert_area, test_invert_area_overlapped_2times)
{
	zassert_ok(cfb_invert_area(dev, 33, 37, 79, 77));
	zassert_ok(cfb_invert_area(dev, 100, 37, 53, 77));
	zassert_ok(cfb_framebuffer_finalize(dev), "cfb_framebuffer_finalize failed");

	zassert_true(verify_color_inside_rect(33, 37, 67, 77, 0xFFFFFF));
	zassert_true(verify_color_inside_rect(100, 37, 12, 77, 0x0));
	zassert_true(verify_color_inside_rect(112, 37, 41, 77, 0xFFFFFF));
	zassert_true(verify_color_outside_rect(33, 37, 120, 77, 0x0));
}

ZTEST(invert_area, test_invert_area_overlap_top_left)
{
	int err;

	err = cfb_invert_area(dev, -10, -10, 20, 20);
	zassert_not_ok(err, "out of rect");
}

ZTEST(invert_area, test_invert_area_overlap_top_right)
{
	int err;

	err = cfb_invert_area(dev, 230, -10, 20, 20);
	zassert_not_ok(err, "out of rect");
}

ZTEST(invert_area, test_invert_area_overlap_bottom_left)
{
	int err;

	err = cfb_invert_area(dev, -10, display_height - 10, 20, 20);
	zassert_not_ok(err, "out of rect");
}

ZTEST(invert_area, test_invert_area_overlap_bottom_right)
{
	zassert_ok(cfb_invert_area(dev, display_width - 10, display_height - 10, 20, 20));
	zassert_ok(cfb_framebuffer_finalize(dev));

	zassert_true(verify_color_inside_rect(display_width - 10, display_height - 10, 10, 10,
					      0xFFFFFF));
	zassert_true(
		verify_color_outside_rect(display_width - 10, display_height - 10, 10, 10, 0x0));
}

ZTEST(invert_area, test_invert_area_outside_top_left)
{
	zassert_not_ok(cfb_invert_area(dev, -10, -10, 10, 10), "out of rect");
}

ZTEST(invert_area, test_invert_area_outside_bottom_right)
{
	zassert_not_ok(cfb_invert_area(dev, display_width, display_height, 20, 20), "out of rect");
}

ZTEST_SUITE(invert_area, NULL, NULL, cfb_test_before, cfb_test_after, NULL);
```

## src/print_rectspace1016.c
```c
/*
 * Copyright (c) 2024 TOKITA Hiroshi
 *
 * SPDX-License-Identifier: Apache-2.0
 */

#include <zephyr/drivers/display.h>
#include <zephyr/ztest.h>
#include <zephyr/device.h>
#include <zephyr/logging/log.h>
#include <zephyr/display/cfb.h>

#include "testdata.h"
#include "utils.h"

LOG_MODULE_REGISTER(print_rectspace1016, CONFIG_DISPLAY_LOG_LEVEL);

static const struct device *dev = DEVICE_DT_GET(DT_CHOSEN(zephyr_display));
static const uint32_t display_width = DT_PROP(DT_CHOSEN(zephyr_display), width);
static const uint32_t display_height = DT_PROP(DT_CHOSEN(zephyr_display), height);

/**
 * Fill the buffer with 0 before running tests.
 */
static void cfb_test_before(void *text_fixture)
{
	struct display_buffer_descriptor desc = {
		.height = display_height,
		.pitch = display_width,
		.width = display_width,
		.buf_size = display_height * display_width / 8,
	};
	uint8_t font_width;
	uint8_t font_height;
	bool font_found = false;

	memset(read_buffer, 0, sizeof(read_buffer));
	zassert_ok(display_write(dev, 0, 0, &desc, read_buffer));

	zassert_ok(display_blanking_off(dev));

	zassert_ok(cfb_framebuffer_init(dev));

	for (int idx = 0; idx < cfb_get_numof_fonts(dev); idx++) {
		if (cfb_get_font_size(dev, idx, &font_width, &font_height)) {
			break;
		}

		if (font_width == 10 && font_height == 16) {
			cfb_framebuffer_set_font(dev, idx);
			font_found = true;
			break;
		}
	}

	zassert_true(font_found);
}

static void cfb_test_after(void *test_fixture)
{
	cfb_framebuffer_deinit(dev);
}

/*
 * normal rendering
 */
ZTEST(print_rectspace1016, test_print_at_0_0)
{
	zassert_ok(cfb_print(dev, " ", 0, 0));
	zassert_ok(cfb_framebuffer_finalize(dev));

	zassert_true(verify_image_and_bg(0, 0, rectspace1016, 10, 16, 0));
}

ZTEST(print_rectspace1016, test_print_at_1_1)
{
	zassert_ok(cfb_print(dev, " ", 1, 1));
	zassert_ok(cfb_framebuffer_finalize(dev));

	zassert_true(verify_image_and_bg(1, 1, rectspace1016, 10, 16, 0));
}

/*
 * around tile border
 */
ZTEST(print_rectspace1016, test_print_at_9_15)
{
	zassert_ok(cfb_print(dev, " ", 9, 15));
	zassert_ok(cfb_framebuffer_finalize(dev));

	zassert_true(verify_image_and_bg(9, 15, rectspace1016, 10, 16, 0));
}

ZTEST(print_rectspace1016, test_print_at_10_16)
{
	zassert_ok(cfb_print(dev, " ", 10, 16));
	zassert_ok(cfb_framebuffer_finalize(dev));

	zassert_true(verify_image_and_bg(10, 16, rectspace1016, 10, 16, 0));
}

ZTEST(print_rectspace1016, test_print_at_11_17)
{
	zassert_ok(cfb_print(dev, " ", 11, 17));
	zassert_ok(cfb_framebuffer_finalize(dev));

	zassert_true(verify_image_and_bg(11, 17, rectspace1016, 10, 16, 0));
}

/*
 * kerning
 */
ZTEST(print_rectspace1016, test_print_at_0_0_kerning_3)
{
	cfb_set_kerning(dev, 3);
	zassert_ok(cfb_print(dev, "  ", 0, 0));
	zassert_ok(cfb_framebuffer_finalize(dev));

	zassert_true(verify_image_and_bg(0, 0, kerning_3_2rectspace1016, 23, 16, 0));
}

ZTEST(print_rectspace1016, test_print_at_1_1_kerning_3)
{
	cfb_set_kerning(dev, 3);
	zassert_ok(cfb_print(dev, "  ", 1, 1));
	zassert_ok(cfb_framebuffer_finalize(dev));

	zassert_true(verify_image_and_bg(1, 1, kerning_3_2rectspace1016, 23, 16, 0));
}

ZTEST(print_rectspace1016, test_print_at_9_15_kerning_3)
{
	cfb_set_kerning(dev, 3);
	zassert_ok(cfb_print(dev, "  ", 9, 15));
	zassert_ok(cfb_framebuffer_finalize(dev));

	zassert_true(verify_image_and_bg(9, 15, kerning_3_2rectspace1016, 23, 16, 0));
}

ZTEST(print_rectspace1016, test_print_at_10_16_kerning_3)
{
	cfb_set_kerning(dev, 3);
	zassert_ok(cfb_print(dev, "  ", 10, 16));
	zassert_ok(cfb_framebuffer_finalize(dev));

	zassert_true(verify_image_and_bg(10, 16, kerning_3_2rectspace1016, 23, 16, 0));
}

ZTEST(print_rectspace1016, test_print_at_11_17_kerning_3)
{
	cfb_set_kerning(dev, 3);
	zassert_ok(cfb_print(dev, "  ", 11, 17));
	zassert_ok(cfb_framebuffer_finalize(dev));

	zassert_true(verify_image_and_bg(11, 17, kerning_3_2rectspace1016, 23, 16, 0));
}

ZTEST(print_rectspace1016, test_print_kerning_3_within_right_border)
{
	cfb_set_kerning(dev, 3);
	zassert_ok(cfb_print(dev, "  ", display_width - 23, 17));
	zassert_ok(cfb_framebuffer_finalize(dev));

	zassert_true(verify_image(display_width - 23, 17, kerning_3_2rectspace1016, 23, 16));
}

ZTEST(print_rectspace1016, test_print_kerning_3_text_wrap)
{
	cfb_set_kerning(dev, 3);
	zassert_ok(cfb_print(dev, "  ", display_width - 22, 17));
	zassert_ok(cfb_framebuffer_finalize(dev));

	zassert_true(verify_image(display_width - 22, 17, rectspace1016, 10, 16));
	zassert_true(verify_image(0, 33, rectspace1016, 10, 16));
}

ZTEST(print_rectspace1016, test_print_outside_top_left)
{
	zassert_ok(cfb_print(dev, " ", -(10 - 3), -(16 - 4)));
	zassert_ok(cfb_framebuffer_finalize(dev));

	zassert_true(verify_image_and_bg(0, 0, outside_top_left, 3, 4, 0));
}

ZTEST(print_rectspace1016, test_print_outside_top_right)
{
	zassert_ok(cfb_print(dev, " ", display_width - 5, -8));
	zassert_ok(cfb_framebuffer_finalize(dev));

	zassert_true(verify_image_and_bg(0, 8, rectspace1016, 10, 16, 0));
}

ZTEST(print_rectspace1016, test_print_outside_bottom_right)
{
	zassert_ok(cfb_print(dev, " ", display_width - 3, display_height - 5));
	zassert_ok(cfb_framebuffer_finalize(dev));

	zassert_true(verify_color_inside_rect(0, 0, display_width, display_height, 0));
}

ZTEST(print_rectspace1016, test_print_outside_bottom_left)
{
	zassert_ok(cfb_print(dev, " ", -(10 - 3), display_height - 14));
	zassert_ok(cfb_framebuffer_finalize(dev));

	zassert_true(verify_image(0, display_height - 14, outside_bottom_left, 3, 14));
}

ZTEST(print_rectspace1016, test_print_wrap_to_3_lines)
{
	cfb_set_kerning(dev, 3);
	zassert_ok(cfb_print(dev, "                                                 ", 160, 17));
	zassert_ok(cfb_framebuffer_finalize(dev));

	zassert_true(verify_image(160, 17, kerning_3_12rectspace1016, 153, 16));
	zassert_true(verify_image(0, 33, kerning_3_12rectspace1016, 153, 16));
	zassert_true(verify_image(156, 33, kerning_3_12rectspace1016, 153, 16));
	zassert_true(verify_image(0, 49, kerning_3_12rectspace1016, 153, 16));
	zassert_true(verify_image(13, 49, kerning_3_12rectspace1016, 153, 16));
}

ZTEST_SUITE(print_rectspace1016, NULL, NULL, cfb_test_before, cfb_test_after, NULL);
```

## src/testdata.h
```c
/*
 * Copyright (c) 2024 TOKITA Hiroshi
 *
 * SPDX-License-Identifier: Apache-2.0
 */

#ifndef TESTS_SUBSYS_DISPLAY_CFB_DRAW_TEXT_AND_PRINT_SRC_TESTDATA_H__
#define TESTS_SUBSYS_DISPLAY_CFB_DRAW_TEXT_AND_PRINT_SRC_TESTDATA_H__

#include <stdint.h>

extern uint32_t diagonal3224[];
extern uint32_t kerning_3_12rectspace1016[];
extern uint32_t kerning_3_2rectspace1016[];
extern uint32_t kerning_3_rightclip_1_2rectspace1016[];
extern uint32_t outside_bottom_left[];
extern uint32_t outside_bottom_right[];
extern uint32_t outside_top_left[];
extern uint32_t outside_top_right[];
extern uint32_t rectspace1016[];
extern uint32_t rectspace1123[];

#endif /* TESTS_SUBSYS_DISPLAY_CFB_DRAW_TEXT_AND_PRINT_SRC_TESTDATA_H__ */
```
