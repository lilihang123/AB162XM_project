## CMakeLists.txt
```
# Copyright 2021 Google LLC
# SPDX-License-Identifier: Apache-2.0

cmake_minimum_required(VERSION 3.20.0)

find_package(Zephyr REQUIRED HINTS $ENV{ZEPHYR_BASE})
project(ipc_service)

FILE(GLOB app_sources src/*.c)
target_sources(app PRIVATE ${app_sources})
```

## prj.conf
```kconfig
# Copyright 2021 Carlo Caione <ccaione@baylibre.com>
# SPDX-License-Identifier: Apache-2.0

CONFIG_ZTEST=y
CONFIG_MMU=y
CONFIG_IPC_SERVICE=y
```

## boards/qemu_cortex_a53.overlay
```dts
/* Copyright 2021 Carlo Caione <ccaione@baylibre.com>
 * SPDX-License-Identifier: Apache-2.0
 */

/ {
	ipc10: ipc10 {
		compatible = "ipc-service-backend";
		offset = <10>;
		status = "okay";
	};

	ipc20: ipc20 {
		compatible = "ipc-service-backend";
		offset = <20>;
		status = "okay";
	};
};
```

## dts/bindings/ipc-service-backend.yaml
```yaml
#
# Copyright (c) 2021 Carlo Caione <ccaione@baylibre.com>
#
# SPDX-License-Identifier: Apache-2.0
#

description: Backend binding to test the IPC service

compatible: "ipc-service-backend"

properties:
  offset:
    type: int
    required: true
    description: offset to add
```

## src/main.c
```c
/* Copyright 2021 Carlo Caione, <ccaione@baylibre.com>
 * SPDX-License-Identifier: Apache-2.0
 */

#include <zephyr/device.h>
#include <zephyr/devicetree.h>
#include <zephyr/ztest.h>
#include <zephyr/ipc/ipc_service.h>

static void received_cb(const void *data, size_t len, void *priv)
{
	uintptr_t expected = (uintptr_t) priv;
	uint8_t *msg = (uint8_t *) data;

	zassert_equal(*msg, expected, "msg doesn't match the expected value");

	printk("Received: %d, expected: %ld\n", *msg, expected);
}

static struct ipc_ept_cfg ept_cfg = {
	.name = "test_ept",
	.cb = {
		.received = received_cb,
	},
};

ZTEST(ipc_service, test_ipc_service)
{
	const struct device *dev_10;
	const struct device *dev_20;
	struct ipc_ept ept_10;
	struct ipc_ept ept_20;
	uint8_t msg;
	int ret;

	dev_10 = DEVICE_DT_GET(DT_NODELABEL(ipc10));
	dev_20 = DEVICE_DT_GET(DT_NODELABEL(ipc20));

	/*
	 * We send 10 through the ipc10 instance so we expect 20 in the
	 * receiving callback (10 + 10 == 20)
	 */
	msg = 10;
	printk("Sending %d\n", msg);

	/* Save the expected result in priv */
	ept_cfg.priv = (void *) 20;

	ret = ipc_service_register_endpoint(dev_10, &ept_10, &ept_cfg);
	zassert_ok(ret, "ipc_service_register_endpoint() failed");

	ret = ipc_service_send(&ept_10, &msg, sizeof(msg));
	zassert_ok(ret, "ipc_service_send() failed");

	/*
	 * We send 10 again this time through the ipc20 instance so we expect
	 * 20 in the receiving callback (10 + 20 == 30)
	 */
	msg = 10;
	printk("Sending %d\n", msg);

	/* Save the expected result in priv */
	ept_cfg.priv = (void *) 30;

	ret = ipc_service_register_endpoint(dev_20, &ept_20, &ept_cfg);
	zassert_ok(ret, "ipc_service_register_endpoint() failed");

	ret = ipc_service_send(&ept_20, &msg, sizeof(msg));
	zassert_ok(ret, "ipc_service_send() failed");

	/*
	 * Deregister the endpoint and ensure that we fail
	 * correctly
	 */
	ret = ipc_service_deregister_endpoint(&ept_10);
	zassert_ok(ret, "ipc_service_deregister_endpoint() failed");

	ret = ipc_service_send(&ept_10, &msg, sizeof(msg));
	zassert_equal(ret, -ENOENT, "ipc_service_send() should return -ENOENT");
}

ZTEST_SUITE(ipc_service, NULL, NULL, NULL, NULL, NULL);
```

## src/backend.c
```c
/*
 * Copyright (c) 2021, Carlo Caione <ccaione@baylibre.com>
 *
 * SPDX-License-Identifier: Apache-2.0
 *
 * Simple backend that adds an offset (defined into the DT) to whatever it is
 * passed in input as IPC message.
 */

#include <zephyr/ipc/ipc_service_backend.h>

#include <zephyr/logging/log.h>
#include <zephyr/sys/util_macro.h>
#include <zephyr/kernel.h>
#include <zephyr/device.h>

#define DT_DRV_COMPAT		ipc_service_backend

struct backend_data_t {
	const struct ipc_ept_cfg *cfg;
};

struct backend_config_t {
	unsigned int offset;
};

static int send(const struct device *instance, void *token,
		const void *p_data, size_t len)
{
	const struct backend_config_t *config;
	struct backend_data_t *data;
	uint8_t *msg;

	config = instance->config;
	data = instance->data;
	msg = (uint8_t *) p_data;

	*msg += config->offset;

	data->cfg->cb.received(msg, sizeof(*msg), data->cfg->priv);

	return 0;
}

static int register_ept(const struct device *instance,
			void **token,
			const struct ipc_ept_cfg *cfg)
{
	struct backend_data_t *data = instance->data;

	data->cfg = cfg;

	return 0;
}

static int deregister_ept(const struct device *instance, void *token)
{
	struct backend_data_t *data = instance->data;

	data->cfg = NULL;

	return 0;
}

const static struct ipc_service_backend backend_ops = {
	.send = send,
	.register_endpoint = register_ept,
	.deregister_endpoint = deregister_ept,
};

#define DEFINE_BACKEND_DEVICE(i)					\
	static struct backend_config_t backend_config_##i = {		\
		.offset = DT_INST_PROP(i, offset),			\
	};								\
									\
	static struct backend_data_t backend_data_##i;			\
									\
	DEVICE_DT_INST_DEFINE(i,					\
			 NULL,						\
			 NULL,						\
			 &backend_data_##i,				\
			 &backend_config_##i,				\
			 POST_KERNEL,					\
			 CONFIG_IPC_SERVICE_REG_BACKEND_PRIORITY,	\
			 &backend_ops);

DT_INST_FOREACH_STATUS_OKAY(DEFINE_BACKEND_DEVICE)
```
