## CMakeLists.txt
```
# Copyright (c) 2023 Nordic Semiconductor ASA
# SPDX-License-Identifier: Apache-2.0

cmake_minimum_required(VERSION 3.20.0)

# This adds the example module to the list of extra zephyr modules
list(APPEND ZEPHYR_EXTRA_MODULES "${CMAKE_CURRENT_SOURCE_DIR}/example_as_module")

find_package(Zephyr REQUIRED HINTS $ENV{ZEPHYR_BASE})
project(handler_demo)

target_sources(app PRIVATE src/main.c)

# Include handler files
if(CONFIG_MCUMGR_GRP_EXAMPLE_APP)
  target_sources(app PRIVATE example_as_module/src/example_mgmt.c)
  zephyr_include_directories(example_as_module/include)
endif()
```

## Kconfig
```
# Copyright Nordic Semiconductor ASA 2023. All rights reserved.
# SPDX-License-Identifier: Apache-2.0
# The Kconfig file is dedicated to example management group of
# of MCUmgr subsystem and provides Kconfig options to configure
# group commands behaviour and other aspects.
#
# Options defined in this file should be prefixed:
#  MCUMGR_GRP_EXAMPLE_ -- general group options;
#
# When adding Kconfig options, that control the same feature,
# try to group them together by the same stem after prefix.
if MCUMGR

menuconfig MCUMGR_GRP_EXAMPLE_APP
	bool "MCUmgr handlers for example management (app)"
	select MCUMGR_SMP_CBOR_MIN_DECODING_LEVEL_2
	default y
	help
	  Enables MCUmgr handlers for example management. This demonstrates the
	  file at application-level.

if MCUMGR_GRP_EXAMPLE_APP
config MCUMGR_GRP_EXAMPLE_OTHER_HOOK
	bool "Other hook"
	depends on MCUMGR_MGMT_NOTIFICATION_HOOKS
	help
	  Allows applications to receive callback when the "other" example
	  management function is called

module = MCUMGR_GRP_EXAMPLE
module-str = mcumgr_grp_example
source "subsys/logging/Kconfig.template.log_config"

endif

endif

source "Kconfig.zephyr"
```

## prj.conf
```kconfig
CONFIG_NET_BUF=y
CONFIG_ZCBOR=y
CONFIG_CRC=y
CONFIG_MCUMGR=y

CONFIG_SYSTEM_WORKQUEUE_STACK_SIZE=2304
CONFIG_MAIN_STACK_SIZE=2048

CONFIG_LOG=y
CONFIG_MCUBOOT_UTIL_LOG_LEVEL_WRN=y
CONFIG_LOG_MAX_LEVEL=3

CONFIG_BASE64=y
CONFIG_SHELL=y
CONFIG_SHELL_BACKEND_SERIAL=y
CONFIG_MCUMGR_TRANSPORT_SHELL=y

CONFIG_MCUMGR_MGMT_NOTIFICATION_HOOKS=y
CONFIG_MCUMGR_GRP_EXAMPLE_OTHER_HOOK=y
```

## module.conf
```kconfig
# Copyright (c) 2023 Nordic Semiconductor ASA
# SPDX-License-Identifier: Apache-2.0
CONFIG_MCUMGR_GRP_EXAMPLE_APP=n
CONFIG_MCUMGR_GRP_EXAMPLE_MODULE=y
```

## src/main.c
```c
/*
 * Copyright (c) 2023 Nordic Semiconductor ASA
 *
 * SPDX-License-Identifier: Apache-2.0
 */

#include <zephyr/kernel.h>

#define LOG_LEVEL LOG_LEVEL_DBG
#include <zephyr/logging/log.h>
LOG_MODULE_REGISTER(handler_demo);

#if !defined(CONFIG_MCUMGR_GRP_EXAMPLE_APP) && !defined(CONFIG_MCUMGR_GRP_EXAMPLE_MODULE)
#error Building this application with neither CONFIG_MCUMGR_GRP_EXAMPLE_APP or \
	CONFIG_MCUMGR_GRP_EXAMPLE_MODULE enabled is not valid
#endif

#ifdef CONFIG_MCUMGR_GRP_EXAMPLE_OTHER_HOOK
#include <zephyr/mgmt/mcumgr/mgmt/mgmt.h>
#include <zephyr/mgmt/mcumgr/mgmt/callbacks.h>
#include <example_mgmt.h>
#include <example_mgmt_callbacks.h>

static struct mgmt_callback test_callback;
static bool last_run;

enum mgmt_cb_return test_function(uint32_t event, enum mgmt_cb_return prev_status, int32_t *rc,
				  uint16_t *group, bool *abort_more, void *data, size_t data_size)
{
	if (event == MGMT_EVT_OP_EXAMPLE_OTHER) {
		last_run = !last_run;

		if (last_run) {
			/* Return a dummy error for a demo */
			*group = MGMT_GROUP_ID_EXAMPLE;
			*rc = EXAMPLE_MGMT_ERR_REJECTED_BY_HOOK;

			LOG_INF("Received hook, rejecting!");
			return MGMT_CB_ERROR_ERR;
		}

		LOG_INF("Received hook, allowing");
	} else {
		LOG_ERR("Received unknown event: %d", event);
	}

	/* Return OK status code to continue with acceptance to underlying handler */
	return MGMT_CB_OK;
}
#endif

int main(void)
{
#ifdef CONFIG_MCUMGR_GRP_EXAMPLE_OTHER_HOOK
	/* Register for the example hook */
	test_callback.callback = test_function;
	test_callback.event_id = MGMT_EVT_OP_EXAMPLE_OTHER;
	mgmt_callback_register(&test_callback);
#endif

	return 0;
}
```
