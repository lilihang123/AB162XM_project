## CMakeLists.txt
```
#
# Copyright (c) 2023 Nordic Semiconductor ASA
#
# SPDX-License-Identifier: Apache-2.0
#

cmake_minimum_required(VERSION 3.20.0)
find_package(Zephyr REQUIRED HINTS $ENV{ZEPHYR_BASE})
project(mcumgr_client)

FILE(GLOB app_sources
	src/*.c
)

target_sources(app PRIVATE ${app_sources})

zephyr_library_link_libraries(MCUBOOT_BOOTUTIL)
```

## prj.conf
```kconfig
#
# Copyright (c) 2023 Nordic Semiconductor ASA
#
# SPDX-License-Identifier: Apache-2.0
#
# ZTEST config
CONFIG_ZTEST=y
CONFIG_ZTEST_STACK_SIZE=2048

CONFIG_NET_BUF=y
CONFIG_BASE64=y
CONFIG_ZCBOR=y
CONFIG_CRC=y
# Enable MCUboot util library
CONFIG_MCUBOOT_BOOTUTIL_LIB=y
# Enable mcumgr client
CONFIG_MCUMGR=y
CONFIG_SMP_CLIENT=y
CONFIG_MCUMGR_GRP_OS_CLIENT=y
CONFIG_MCUMGR_GRP_IMG_CLIENT=y
CONFIG_MCUMGR_GRP_OS_CLIENT_ECHO=y
CONFIG_MCUMGR_GRP_OS_CLIENT_RESET=y
# disable default image group build
CONFIG_IMG_MANAGER=n

# Extend System Workqueue stack size
CONFIG_SYSTEM_WORKQUEUE_STACK_SIZE=2304
```

## src/main.c
```c
/*
 * Copyright (c) 2023 Nordic Semiconductor ASA
 *
 * SPDX-License-Identifier: Apache-2.0
 */

#include <zephyr/ztest.h>
#include <zephyr/net/buf.h>
#include <string.h>
#include <zephyr/mgmt/mcumgr/smp/smp_client.h>
#include <zephyr/mgmt/mcumgr/mgmt/mgmt.h>
#include <zephyr/mgmt/mcumgr/grp/img_mgmt/img_mgmt_client.h>
#include <zephyr/mgmt/mcumgr/grp/os_mgmt/os_mgmt.h>
#include <zephyr/mgmt/mcumgr/grp/os_mgmt/os_mgmt_client.h>
/* Include stubbed test helpers */
#include "smp_stub.h"
#include "img_gr_stub.h"
#include "os_gr_stub.h"

/* IMG group data */
static uint8_t image_hash[32];
static struct mcumgr_image_data image_info[2];
static uint8_t image_dummy[1024];

static const char os_echo_test[] = "TestString";
static struct smp_client_object smp_client;
static struct img_mgmt_client img_client;
static struct os_mgmt_client os_client;

ZTEST(mcumgr_client, test_img_upload)
{
	int rc;
	struct mcumgr_image_upload response;

	smp_stub_set_rx_data_verify(NULL);
	img_upload_stub_init();

	img_mgmt_client_init(&img_client, &smp_client, 2, image_info);

	rc = img_mgmt_client_upload_init(&img_client, TEST_IMAGE_SIZE, TEST_IMAGE_NUM, image_hash);
	zassert_equal(MGMT_ERR_EOK, rc, "Expected to receive %d response %d", MGMT_ERR_EOK, rc);
	/* Start upload  and test Timeout */
	rc = img_mgmt_client_upload(&img_client, image_dummy, 1024, &response);
	zassert_equal(MGMT_ERR_ETIMEOUT, rc, "Expected to receive %d response %d",
		      MGMT_ERR_ETIMEOUT, rc);
	zassert_equal(MGMT_ERR_ETIMEOUT, response.status, "Expected to receive %d response %d\n",
		      MGMT_ERR_ETIMEOUT, response.status);
	rc = img_mgmt_client_upload_init(&img_client, TEST_IMAGE_SIZE, TEST_IMAGE_NUM, image_hash);
	zassert_equal(MGMT_ERR_EOK, rc, "Expected to receive %d response %d", MGMT_ERR_EOK, rc);
	rc = img_mgmt_client_upload_init(&img_client, TEST_IMAGE_SIZE, TEST_IMAGE_NUM, image_hash);
	zassert_equal(MGMT_ERR_EOK, rc, "Expected to receive %d response %d", MGMT_ERR_EOK, rc);
	/* Start upload  and test Timeout */
	rc = img_mgmt_client_upload(&img_client, image_dummy, 1024, &response);
	zassert_equal(MGMT_ERR_ETIMEOUT, rc, "Expected to receive %d response %d",
		      MGMT_ERR_ETIMEOUT, rc);
	zassert_equal(MGMT_ERR_ETIMEOUT, response.status, "Expected to receive %d response %d",
		      MGMT_ERR_ETIMEOUT, response.status);

	smp_client_send_status_stub(MGMT_ERR_EOK);

	/* Allocate response buf */
	img_upload_response(0, MGMT_ERR_EINVAL);
	rc = img_mgmt_client_upload(&img_client, image_dummy, 1024, &response);
	zassert_equal(MGMT_ERR_EINVAL, rc, "Expected to receive %d response %d", MGMT_ERR_EINVAL,
		      rc);
	zassert_equal(MGMT_ERR_EINVAL, response.status, "Expected to receive %d response %d",
		      MGMT_ERR_EINVAL, response.status);
	rc = img_mgmt_client_upload_init(&img_client, TEST_IMAGE_SIZE, TEST_IMAGE_NUM, image_hash);
	zassert_equal(MGMT_ERR_EOK, rc, "Expected to receive %d response %d\n", MGMT_ERR_EOK, rc);
	img_upload_response(1024, MGMT_ERR_EOK);

	smp_stub_set_rx_data_verify(img_upload_init_verify);
	img_upload_stub_init();
	rc = img_mgmt_client_upload(&img_client, image_dummy, 1024, &response);
	zassert_equal(MGMT_ERR_EOK, rc, "Expected to receive %d response %d", MGMT_ERR_EOK, rc);
	zassert_equal(MGMT_ERR_EOK, response.status, "Expected to receive %d response %d",
		      MGMT_ERR_EOK, response.status);
	zassert_equal(1024, response.image_upload_offset,
		      "Expected to receive offset %d response %d", 1024,
		      response.image_upload_offset);
	/* Send last frame from image */
	rc = img_mgmt_client_upload(&img_client, image_dummy, 1024, &response);
	zassert_equal(MGMT_ERR_EOK, rc, "Expected to receive %d response %d", MGMT_ERR_EOK, rc);
	zassert_equal(MGMT_ERR_EOK, response.status, "Expected to receive %d response %d",
		      MGMT_ERR_EOK, response.status);
	zassert_equal(TEST_IMAGE_SIZE, response.image_upload_offset,
		      "Expected to receive offset %d response %d", TEST_IMAGE_SIZE,
		      response.image_upload_offset);

	/* Test without hash */
	rc = img_mgmt_client_upload_init(&img_client, TEST_IMAGE_SIZE, TEST_IMAGE_NUM, NULL);
	zassert_equal(MGMT_ERR_EOK, rc, "Expected to receive %d response %d", MGMT_ERR_EOK, rc);
	img_upload_stub_init();
	rc = img_mgmt_client_upload(&img_client, image_dummy, 1024, &response);
	zassert_equal(MGMT_ERR_EOK, rc, "Expected to receive %d response %d", MGMT_ERR_EOK, rc);
	zassert_equal(MGMT_ERR_EOK, response.status, "Expected to receive %d response %d",
		      MGMT_ERR_EOK, response.status);
	zassert_equal(1024, response.image_upload_offset,
		      "Expected to receive offset %d response %d", 1024,
		      response.image_upload_offset);
	/* Send last frame from image */
	rc = img_mgmt_client_upload(&img_client, image_dummy, 1024, &response);
	zassert_equal(MGMT_ERR_EOK, rc, "Expected to receive %d response %d", MGMT_ERR_EOK, rc);
	zassert_equal(MGMT_ERR_EOK, response.status, "Expected to receive %d response %d",
		      MGMT_ERR_EOK, response.status);
	zassert_equal(TEST_IMAGE_SIZE, response.image_upload_offset,
		      "Expected to receive offset %d response %d", TEST_IMAGE_SIZE,
		      response.image_upload_offset);
}

ZTEST(mcumgr_client, test_img_erase)
{
	int rc;

	smp_client_send_status_stub(MGMT_ERR_EOK);

	/* Test timeout */
	rc = img_mgmt_client_erase(&img_client, TEST_SLOT_NUMBER);
	zassert_equal(MGMT_ERR_ETIMEOUT, rc, "Expected to receive %d response %d",
		      MGMT_ERR_ETIMEOUT, rc);

	/* Test erase fail */
	img_erase_response(MGMT_ERR_EINVAL);
	rc = img_mgmt_client_erase(&img_client, TEST_SLOT_NUMBER);
	zassert_equal(MGMT_ERR_EINVAL, rc, "Expected to receive %d response %d", MGMT_ERR_EINVAL,
		      rc);
	/* Tesk ok */
	img_erase_response(MGMT_ERR_EOK);
	rc = img_mgmt_client_erase(&img_client, TEST_SLOT_NUMBER);
	zassert_equal(MGMT_ERR_EOK, rc, "Expected to receive %d response %d", MGMT_ERR_EOK, rc);
}

ZTEST(mcumgr_client, test_image_state_read)
{
	int rc;
	struct mcumgr_image_state res_buf;

	smp_client_send_status_stub(MGMT_ERR_EOK);
	/* Test timeout */
	rc = img_mgmt_client_state_read(&img_client, &res_buf);
	zassert_equal(MGMT_ERR_ETIMEOUT, rc, "Expected to receive %d response %d",
		      MGMT_ERR_ETIMEOUT, rc);
	/* Testing read successfully 1 image info and print that */
	img_read_response(1);
	rc = img_mgmt_client_state_read(&img_client, &res_buf);
	zassert_equal(MGMT_ERR_EOK, rc, "Expected to receive %d response %d", MGMT_ERR_EOK, rc);
	zassert_equal(1, res_buf.image_list_length, "Expected to receive %d response %d", 1,
		      res_buf.image_list_length);
	img_read_response(2);
	rc = img_mgmt_client_state_read(&img_client, &res_buf);
	zassert_equal(MGMT_ERR_EOK, rc, "Expected to receive %d response %d", MGMT_ERR_EOK, rc);
	zassert_equal(2, res_buf.image_list_length, "Expected to receive %d response %d", 2,
		      res_buf.image_list_length);
}

ZTEST(mcumgr_client, test_image_state_set)
{
	int rc;
	char hash[32];
	struct mcumgr_image_state res_buf;

	smp_client_response_buf_clean();
	smp_stub_set_rx_data_verify(NULL);
	smp_client_send_status_stub(MGMT_ERR_EOK);
	/* Test timeout */
	rc = img_mgmt_client_state_write(&img_client, NULL, false, &res_buf);
	zassert_equal(MGMT_ERR_ETIMEOUT, rc, "Expected to receive %d response %d",
		      MGMT_ERR_ETIMEOUT, rc);

	printf("Timeout OK\r\n");
	/* Read secondary image hash for testing */
	img_read_response(2);
	rc = img_mgmt_client_state_read(&img_client, &res_buf);
	zassert_equal(MGMT_ERR_EOK, rc, "Expected to receive %d response %d", MGMT_ERR_EOK, rc);
	zassert_equal(2, res_buf.image_list_length, "Expected to receive %d response %d", 2,
		      res_buf.image_list_length);
	zassert_equal(false, image_info[1].flags.pending, "Expected to receive %d response %d",
		      false, image_info[1].flags.pending);
	/* Copy hash for set pending flag */
	memcpy(hash, image_info[1].hash, 32);
	printf("Read OK\r\n");

	/* Read secondary image hash for testing */
	smp_stub_set_rx_data_verify(img_state_write_verify);
	rc = img_mgmt_client_state_write(&img_client, hash, false, &res_buf);
	zassert_equal(MGMT_ERR_EOK, rc, "Expected to receive %d response %d", MGMT_ERR_EOK, rc);
	zassert_equal(2, res_buf.image_list_length, "Expected to receive %d response %d", 2,
		      res_buf.image_list_length);
	zassert_equal(true, image_info[1].flags.pending, "Expected to receive %d response %d",
		      true, image_info[1].flags.pending);
	/* Test to set confirmed bit  */
	image_info[0].flags.confirmed = false;
	smp_stub_set_rx_data_verify(img_state_write_verify);
	rc = img_mgmt_client_state_write(&img_client, NULL, true, &res_buf);
	zassert_equal(MGMT_ERR_EOK, rc, "Expected to receive %d response %d", MGMT_ERR_EOK, rc);
	zassert_equal(2, res_buf.image_list_length, "Expected to receive %d response %d", 2,
		      res_buf.image_list_length);
	zassert_equal(true, image_info[0].flags.confirmed, "Expected to receive %d response %d",
		      true, image_info[0].flags.confirmed);
}

ZTEST(mcumgr_client, test_os_reset)
{
	int rc;

	smp_client_response_buf_clean();
	smp_stub_set_rx_data_verify(NULL);

	smp_client_send_status_stub(MGMT_ERR_EOK);
	/* Test timeout */
	rc = os_mgmt_client_reset(&os_client);
	zassert_equal(MGMT_ERR_ETIMEOUT, rc, "Expected to receive %d response %d",
		      MGMT_ERR_ETIMEOUT, rc);
	/* Testing reset successfully handling */
	os_reset_response();
	rc = os_mgmt_client_reset(&os_client);
	zassert_equal(MGMT_ERR_EOK, rc, "Expected to receive %d response %d", MGMT_ERR_EOK, rc);
}

ZTEST(mcumgr_client, test_os_echo)
{
	int rc;

	smp_client_response_buf_clean();
	smp_stub_set_rx_data_verify(NULL);
	smp_client_send_status_stub(MGMT_ERR_EOK);
	/* Test timeout */
	rc = os_mgmt_client_echo(&os_client, os_echo_test, sizeof(os_echo_test));
	zassert_equal(MGMT_ERR_ETIMEOUT, rc, "Expected to receive %d response %d",
		      MGMT_ERR_ETIMEOUT, rc);
	/* Test successfully operation */
	smp_stub_set_rx_data_verify(os_echo_verify);
	rc = os_mgmt_client_echo(&os_client, os_echo_test, sizeof(os_echo_test));
	zassert_equal(MGMT_ERR_EOK, rc, "Expected to receive %d response %d", MGMT_ERR_EOK, rc);
}

static void *setup_custom_os(void)
{
	stub_smp_client_transport_register();
	smp_client_object_init(&smp_client, SMP_SERIAL_TRANSPORT);
	os_mgmt_client_init(&os_client, &smp_client);
	img_mgmt_client_init(&img_client, &smp_client, 2, image_info);

	img_gr_stub_data_init(image_hash);
	os_stub_init(os_echo_test);
	return NULL;
}

static void cleanup_test(void *p)
{
	smp_client_response_buf_clean();
	smp_stub_set_rx_data_verify(NULL);
}

/* Main test set */
ZTEST_SUITE(mcumgr_client, NULL, setup_custom_os, NULL, cleanup_test, NULL);
```

## src/img_gr_stub.c
```c
/*
 * Copyright (c) 2023 Nordic Semiconductor ASA
 *
 * SPDX-License-Identifier: Apache-2.0
 */

#include <zephyr/net/buf.h>
#include <string.h>
#include <stdio.h>
#include <zephyr/mgmt/mcumgr/smp/smp_client.h>
#include <zephyr/mgmt/mcumgr/mgmt/mgmt.h>
#include <zephyr/mgmt/mcumgr/grp/img_mgmt/img_mgmt_client.h>
#include <zephyr/sys/byteorder.h>

#include <zcbor_common.h>
#include <zcbor_encode.h>
#include <zcbor_decode.h>
#include <mgmt/mcumgr/util/zcbor_bulk.h>
#include <mgmt/mcumgr/transport/smp_internal.h>
#include "smp_stub.h"
#include "img_gr_stub.h"

static struct mcumgr_image_data image_dummy_info[2];
static size_t test_offset;
static uint8_t *image_hash_ptr;

#ifdef CONFIG_MCUMGR_GRP_IMG_UPDATABLE_IMAGE_NUMBER
#define IMG_UPDATABLE_IMAGE_COUNT CONFIG_MCUMGR_GRP_IMG_UPDATABLE_IMAGE_NUMBER
#else
#define IMG_UPDATABLE_IMAGE_COUNT 1
#endif

#define ZCBOR_ENCODE_FLAG(zse, label, value)                                                       \
	(zcbor_tstr_put_lit(zse, label) && zcbor_bool_put(zse, value))

void img_upload_stub_init(void)
{
	test_offset = 0;
}

void img_upload_response(size_t offset, int status)
{
	struct net_buf *nb;
	zcbor_state_t zse[CONFIG_MCUMGR_SMP_CBOR_MAX_DECODING_LEVELS + 2];
	bool ok;

	nb = smp_response_buf_allocation();

	if (!nb) {
		return;
	}

	zcbor_new_encode_state(zse, ARRAY_SIZE(zse), nb->data, net_buf_tailroom(nb), 0);

	/* Init map start and write image info and data */
	if (status) {
		ok = zcbor_map_start_encode(zse, 4) && zcbor_tstr_put_lit(zse, "rc") &&
	     zcbor_int32_put(zse, status) && zcbor_tstr_put_lit(zse, "off") &&
	     zcbor_size_put(zse, offset) && zcbor_map_end_encode(zse, 4);
	} else {
		/* Drop Status away from response */
		ok = zcbor_map_start_encode(zse, 2) && zcbor_tstr_put_lit(zse, "off") &&
	     zcbor_size_put(zse, offset) && zcbor_map_end_encode(zse, 4);
	}


	if (!ok) {
		smp_client_response_buf_clean();
	} else {
		nb->len = zse->payload - nb->data;
	}
}

void img_fail_response(int status)
{
	struct net_buf *nb;
	zcbor_state_t zse[CONFIG_MCUMGR_SMP_CBOR_MAX_DECODING_LEVELS + 2];
	bool ok;

	nb = smp_response_buf_allocation();

	if (!nb) {
		return;
	}

	zcbor_new_encode_state(zse, ARRAY_SIZE(zse), nb->data, net_buf_tailroom(nb), 0);

	/* Init map start and write image info and data */
	ok = zcbor_map_start_encode(zse, 2) && zcbor_tstr_put_lit(zse, "rc") &&
	     zcbor_int32_put(zse, status) && zcbor_map_end_encode(zse, 2);
	if (!ok) {
		smp_client_response_buf_clean();
	} else {
		nb->len = zse->payload - nb->data;
	}
}

void img_read_response(int count)
{
	struct net_buf *nb;
	zcbor_state_t zse[CONFIG_MCUMGR_SMP_CBOR_MAX_DECODING_LEVELS + 2];
	bool ok;

	nb = smp_response_buf_allocation();

	if (!nb) {
		return;
	}

	zcbor_new_encode_state(zse, ARRAY_SIZE(zse), nb->data, net_buf_tailroom(nb), 0);

	ok = zcbor_map_start_encode(zse, 15) && zcbor_tstr_put_lit(zse, "images") &&
	     zcbor_list_start_encode(zse, 2);

	for (int i = 0; ok && i < count; i++) {

		ok = zcbor_map_start_encode(zse, 15) &&
		     ((zcbor_tstr_put_lit(zse, "image") &&
		       zcbor_uint32_put(zse, image_dummy_info[i].img_num))) &&
		     zcbor_tstr_put_lit(zse, "slot") &&
		     zcbor_uint32_put(zse, image_dummy_info[i].slot_num) &&
		     zcbor_tstr_put_lit(zse, "version") &&
		     zcbor_tstr_put_term(zse, image_dummy_info[i].version,
					sizeof(image_dummy_info[i].version)) &&

		     zcbor_tstr_put_lit(zse, "hash") &&
		     zcbor_bstr_encode_ptr(zse, image_dummy_info[i].hash, IMG_MGMT_DATA_SHA_LEN) &&
		     ZCBOR_ENCODE_FLAG(zse, "bootable", image_dummy_info[i].flags.bootable) &&
		     ZCBOR_ENCODE_FLAG(zse, "pending", image_dummy_info[i].flags.pending) &&
		     ZCBOR_ENCODE_FLAG(zse, "confirmed", image_dummy_info[i].flags.confirmed) &&
		     ZCBOR_ENCODE_FLAG(zse, "active", image_dummy_info[i].flags.active) &&
		     ZCBOR_ENCODE_FLAG(zse, "permanent", image_dummy_info[i].flags.permanent) &&
		     zcbor_map_end_encode(zse, 15);
	}

	ok = ok && zcbor_list_end_encode(zse, 2 * IMG_UPDATABLE_IMAGE_COUNT);

	ok = ok && zcbor_map_end_encode(zse, 15);

	if (!ok) {
		smp_client_response_buf_clean();
	} else {
		nb->len = zse->payload - nb->data;
	}
}

void img_erase_response(int status)
{
	struct net_buf *nb;
	zcbor_state_t zse[CONFIG_MCUMGR_SMP_CBOR_MAX_DECODING_LEVELS + 2];
	bool ok;

	nb = smp_response_buf_allocation();

	if (!nb) {
		return;
	}

	zcbor_new_encode_state(zse, ARRAY_SIZE(zse), nb->data, net_buf_tailroom(nb), 0);

	/* Init map start and write image info and data */
	ok = zcbor_map_start_encode(zse, 2) && zcbor_tstr_put_lit(zse, "rc") &&
	     zcbor_int32_put(zse, status) && zcbor_map_end_encode(zse, 2);
	if (!ok) {
		smp_client_response_buf_clean();
	} else {
		nb->len = zse->payload - nb->data;
	}
}

void img_state_write_verify(struct net_buf *nb)
{
	/* Parse CBOR data: hash and confirm */
	zcbor_state_t zsd[CONFIG_MCUMGR_SMP_CBOR_MAX_DECODING_LEVELS + 2];
	int rc;
	struct zcbor_string hash;
	bool confirm;
	size_t decoded;
	struct zcbor_map_decode_key_val list_res_decode[] = {
		ZCBOR_MAP_DECODE_KEY_DECODER("confirm", zcbor_bool_decode, &confirm),
		ZCBOR_MAP_DECODE_KEY_DECODER("hash", zcbor_bstr_decode, &hash)
		};

	zcbor_new_decode_state(zsd, ARRAY_SIZE(zsd), nb->data + sizeof(struct smp_hdr), nb->len, 1,
				NULL, 0);

	decoded = 0;
	/* Init buffer values */
	confirm = false;
	hash.len = 0;

	rc = zcbor_map_decode_bulk(zsd, list_res_decode, ARRAY_SIZE(list_res_decode), &decoded);
	if (rc) {
		printf("Corrupted data %d\r\n", rc);
		img_fail_response(MGMT_ERR_EINVAL);
		return;
	}
	if (hash.len) {
		printf("HASH %d", hash.len);
		if (memcmp(hash.value, image_dummy_info[1].hash, 32) == 0) {
			if (confirm) {
				/* Set Permanent bit */
				image_dummy_info[1].flags.permanent = true;
			} else {
				/* Set pending */
				image_dummy_info[1].flags.pending = true;
			}
			img_read_response(2);
		} else {
			img_fail_response(MGMT_ERR_EINVAL);
		}
	} else {
		if (confirm) {
			image_dummy_info[0].flags.confirmed = true;
		}
		img_read_response(2);
	}
}

void img_upload_init_verify(struct net_buf *nb)
{
	/* Parse CBOR data: hash and confirm */
	zcbor_state_t zsd[CONFIG_MCUMGR_SMP_CBOR_MAX_DECODING_LEVELS + 2];
	int rc;
	uint32_t image;
	struct zcbor_string sha, data;
	size_t decoded, length, offset;
	struct zcbor_map_decode_key_val list_res_decode[] = {
		ZCBOR_MAP_DECODE_KEY_DECODER("image", zcbor_uint32_decode, &image),
		ZCBOR_MAP_DECODE_KEY_DECODER("data", zcbor_bstr_decode, &data),
		ZCBOR_MAP_DECODE_KEY_DECODER("len", zcbor_size_decode, &length),
		ZCBOR_MAP_DECODE_KEY_DECODER("off", zcbor_size_decode, &offset),
		ZCBOR_MAP_DECODE_KEY_DECODER("sha", zcbor_bstr_decode, &sha)
		};

	zcbor_new_decode_state(zsd, ARRAY_SIZE(zsd), nb->data + sizeof(struct smp_hdr), nb->len, 1,
				NULL, 0);

	decoded = 0;
	/* Init buffer values */
	sha.len = 0;
	data.len = 0;
	length = SIZE_MAX;
	offset = SIZE_MAX;
	image = UINT32_MAX;

	rc = zcbor_map_decode_bulk(zsd, list_res_decode, ARRAY_SIZE(list_res_decode), &decoded);
	if (rc || data.len == 0 || offset == SIZE_MAX || image != TEST_IMAGE_NUM) {
		printf("Corrupted data %d or %d data len\r\n", rc, data.len);
		img_upload_response(0, MGMT_ERR_EINVAL);
		return;
	}

	if (sha.len) {
		if (memcmp(sha.value, image_hash_ptr, 32)) {
			printf("Hash not same\r\n");
			img_upload_response(0, MGMT_ERR_EINVAL);
			return;
		}
	}

	if (offset != test_offset) {
		printf("Offset not exepected %d vs received %d\r\n", test_offset, offset);
	}

	if (offset == 0) {
		if (length != TEST_IMAGE_SIZE) {
			img_upload_response(0, MGMT_ERR_EINVAL);
		}
	}

	test_offset += data.len;
	printf("Upload offset %d\r\n", test_offset);
	if (test_offset <= TEST_IMAGE_SIZE) {
		img_upload_response(test_offset, MGMT_ERR_EOK);
	} else {
		img_upload_response(0, MGMT_ERR_EINVAL);
	}
}

void img_gr_stub_data_init(uint8_t *hash_ptr)
{
	image_hash_ptr = hash_ptr;
	for (int i = 0; i < 32; i++) {
		image_hash_ptr[i] = i;
		image_dummy_info[0].hash[i] = i + 32;
		image_dummy_info[1].hash[i] = i + 64;
	}
	/* Set dummy image list data */
	for (int i = 0; i < 2; i++) {
		image_dummy_info[i].img_num = i;
		image_dummy_info[i].slot_num = i;
		/* Write version */
		snprintf(image_dummy_info[i].version, IMG_MGMT_VER_MAX_STR_LEN, "1.1.%u", i);
		image_dummy_info[i].version[sizeof(image_dummy_info[i].version) - 1] = '\0';
		image_dummy_info[i].flags.bootable = true;
		image_dummy_info[i].flags.pending = false;
		if (i) {
			image_dummy_info[i].flags.confirmed = false;
			image_dummy_info[i].flags.active = false;
		} else {
			image_dummy_info[i].flags.confirmed = true;
			image_dummy_info[i].flags.active = true;
		}
		image_dummy_info[i].flags.permanent = false;
	}
}
```

## src/img_gr_stub.h
```c
/*
 * Copyright (c) 2023 Nordic Semiconductor ASA
 *
 * SPDX-License-Identifier: Apache-2.0
 */
#ifndef H_IMG_GR_STUB_
#define H_IMG_GR_STUB_

#include <inttypes.h>
#include <zephyr/net/buf.h>


#ifdef __cplusplus
extern "C" {
#endif

#define TEST_IMAGE_NUM 1
#define TEST_IMAGE_SIZE 2048
#define TEST_SLOT_NUMBER 2

void img_upload_stub_init(void);
void img_upload_response(size_t offset, int status);
void img_fail_response(int status);
void img_read_response(int count);
void img_erase_response(int status);
void img_upload_init_verify(struct net_buf *nb);
void img_state_write_verify(struct net_buf *nb);
void img_gr_stub_data_init(uint8_t *hash_ptr);

#ifdef __cplusplus
}
#endif

#endif /* H_IMG_GR_STUB_ */
```

## src/os_gr_stub.c
```c
/*
 * Copyright (c) 2023 Nordic Semiconductor ASA
 *
 * SPDX-License-Identifier: Apache-2.0
 */

#include <zephyr/net/buf.h>
#include <string.h>
#include <stdio.h>
#include <zephyr/mgmt/mcumgr/smp/smp_client.h>
#include <zephyr/mgmt/mcumgr/mgmt/mgmt.h>
#include <zephyr/mgmt/mcumgr/grp/os_mgmt/os_mgmt.h>
#include <zephyr/mgmt/mcumgr/grp/os_mgmt/os_mgmt_client.h>
#include <zephyr/sys/byteorder.h>

#include <zcbor_common.h>
#include <zcbor_encode.h>
#include <zcbor_decode.h>
#include <mgmt/mcumgr/util/zcbor_bulk.h>
#include <mgmt/mcumgr/transport/smp_internal.h>
#include "smp_stub.h"

static const char *echo_ptr;

void os_stub_init(const char *echo_str)
{
	echo_ptr = echo_str;
}

void os_reset_response(void)
{
	struct net_buf *nb;

	nb = smp_response_buf_allocation();
	if (nb) {
		nb->len = 0;
	}
}

static void os_echo_response(int status, struct zcbor_string *echo_data)
{
	struct net_buf *nb;
	zcbor_state_t zse[3 + 2];
	bool ok;

	nb = smp_response_buf_allocation();

	if (!nb) {
		return;
	}

	zcbor_new_encode_state(zse, ARRAY_SIZE(zse), nb->data, net_buf_tailroom(nb), 0);

	if (status) {
		/* Init map start and write image info and data */
		ok = zcbor_map_start_encode(zse, 2) && zcbor_tstr_put_lit(zse, "rc") &&
		     zcbor_int32_put(zse, status) && zcbor_map_end_encode(zse, 2);
	} else {
		/* Init map start and write image info and data */
		ok = zcbor_map_start_encode(zse, 2) && zcbor_tstr_put_lit(zse, "r") &&
		     zcbor_tstr_encode_ptr(zse, echo_data->value, echo_data->len) &&
		     zcbor_map_end_encode(zse, 2);
	}

	if (!ok) {
		smp_client_response_buf_clean();
	} else {
		nb->len = zse->payload - nb->data;
	}
}

void os_echo_verify(struct net_buf *nb)
{
	/* Parse CBOR data: hash and confirm */
	zcbor_state_t zsd[3 + 2];
	int rc;
	int response_status;
	struct zcbor_string echo_data;
	size_t decoded;
	struct zcbor_map_decode_key_val list_res_decode[] = {
		ZCBOR_MAP_DECODE_KEY_DECODER("d", zcbor_tstr_decode, &echo_data)
		};

	zcbor_new_decode_state(zsd, ARRAY_SIZE(zsd), nb->data + sizeof(struct smp_hdr), nb->len, 1,
				NULL, 0);
	echo_data.len = 0;

	rc = zcbor_map_decode_bulk(zsd, list_res_decode, ARRAY_SIZE(list_res_decode), &decoded);
	if (rc || !echo_data.len) {
		printf("Corrupted data %d or no echo data %d\r\n", rc, echo_data.len);
		response_status = MGMT_ERR_EINVAL;
	} else if (memcmp(echo_data.value, echo_ptr, echo_data.len)) {
		response_status = MGMT_ERR_EINVAL;
	} else {
		response_status = MGMT_ERR_EOK;
	}

	os_echo_response(response_status, &echo_data);
}
```

## src/os_gr_stub.h
```c
/*
 * Copyright (c) 2023 Nordic Semiconductor ASA
 *
 * SPDX-License-Identifier: Apache-2.0
 */
#ifndef H_OS_GR_STUB_
#define H_OS_GR_STUB_

#include <inttypes.h>
#include <zephyr/net/buf.h>

#ifdef __cplusplus
extern "C" {
#endif

void os_stub_init(const char *echo_str);
void os_reset_response(void);
void os_echo_verify(struct net_buf *nb);

#ifdef __cplusplus
}
#endif

#endif /* H_OS_GR_STUB_ */
```

## src/smp_stub.c
```c
/*
 * Copyright (c) 2023 Nordic Semiconductor ASA
 *
 * SPDX-License-Identifier: Apache-2.0
 */

#include <zephyr/net/buf.h>
#include <zephyr/kernel.h>
#include <string.h>
#include <zephyr/mgmt/mcumgr/smp/smp_client.h>
#include <zephyr/mgmt/mcumgr/mgmt/mgmt.h>
#include <zephyr/sys/byteorder.h>
#include <mgmt/mcumgr/transport/smp_internal.h>
#include "smp_stub.h"

K_THREAD_STACK_DEFINE(smp_stub_work_queue_stack, CONFIG_MCUMGR_TRANSPORT_WORKQUEUE_STACK_SIZE);

static mcmgr_client_data_check_fn rx_verify_cb;
static int send_client_failure;
static struct net_buf *response_buf;
static struct smp_hdr res_hdr;
static struct smp_transport smpt_test;
static struct smp_client_transport_entry smp_client_transport;
static struct k_work_q smp_work_queue;
static struct k_work stub_work;

static const struct k_work_queue_config smp_work_queue_config = {
	.name = "mcumgr smp"
};

void smp_stub_set_rx_data_verify(mcmgr_client_data_check_fn cb)
{
	rx_verify_cb = cb;
}

void smp_client_send_status_stub(int status)
{
	send_client_failure = status;
}

struct net_buf *smp_response_buf_allocation(void)
{
	smp_client_response_buf_clean();

	response_buf = smp_packet_alloc();

	return response_buf;
}

void smp_client_response_buf_clean(void)
{
	if (response_buf) {
		smp_client_buf_free(response_buf);
		response_buf = NULL;
	}
}

void smp_transport_read_hdr(const struct net_buf *nb, struct smp_hdr *dst_hdr)
{
	memcpy(dst_hdr, nb->data, sizeof(*dst_hdr));
	dst_hdr->nh_len = sys_be16_to_cpu(dst_hdr->nh_len);
	dst_hdr->nh_group = sys_be16_to_cpu(dst_hdr->nh_group);
}


static uint16_t smp_uart_get_mtu(const struct net_buf *nb)
{
	return 256;
}

static int smp_uart_tx_pkt(struct net_buf *nb)
{
	if (send_client_failure) {
		/* Test Send cmd fail */
		return send_client_failure;
	}

	memcpy(&res_hdr, nb->data, sizeof(res_hdr));
	res_hdr.nh_len = sys_be16_to_cpu(res_hdr.nh_len);
	res_hdr.nh_group = sys_be16_to_cpu(res_hdr.nh_group);
	res_hdr.nh_op += 1; /* Request to response */

	/* Validate Input data if callback is configured */
	if (rx_verify_cb) {
		rx_verify_cb(nb);
	}

	/* Free tx buf */
	net_buf_unref(nb);

	if (response_buf) {
		k_work_submit_to_queue(&smp_work_queue, &stub_work);
	}

	return 0;
}

static void smp_client_handle_reqs(struct k_work *work)
{
	if (response_buf) {
		smp_client_single_response(response_buf, &res_hdr);
	}
}

void stub_smp_client_transport_register(void)
{

	smpt_test.functions.output = smp_uart_tx_pkt;
	smpt_test.functions.get_mtu = smp_uart_get_mtu;

	smp_transport_init(&smpt_test);
	smp_client_transport.smpt = &smpt_test;
	smp_client_transport.smpt_type = SMP_SERIAL_TRANSPORT;
	smp_client_transport_register(&smp_client_transport);


	k_work_queue_init(&smp_work_queue);

	k_work_queue_start(&smp_work_queue, smp_stub_work_queue_stack,
			   K_THREAD_STACK_SIZEOF(smp_stub_work_queue_stack),
			   CONFIG_MCUMGR_TRANSPORT_WORKQUEUE_THREAD_PRIO, &smp_work_queue_config);

	k_work_init(&stub_work, smp_client_handle_reqs);
}
```

## src/smp_stub.h
```c
/*
 * Copyright (c) 2023 Nordic Semiconductor ASA
 *
 * SPDX-License-Identifier: Apache-2.0
 */
#ifndef H_SMP_STUB_
#define H_SMP_STUB_

#include <inttypes.h>
#include <zephyr/net/buf.h>
#include <zephyr/mgmt/mcumgr/grp/img_mgmt/img_mgmt.h>


#ifdef __cplusplus
extern "C" {
#endif

typedef void (*mcmgr_client_data_check_fn)(struct net_buf *nb);

void smp_stub_set_rx_data_verify(mcmgr_client_data_check_fn cb);
void smp_client_send_status_stub(int status);
void smp_client_response_buf_clean(void);
struct net_buf *smp_response_buf_allocation(void);
void stub_smp_client_transport_register(void);

#ifdef __cplusplus
}
#endif

#endif /* H_SMP_STUB_ */
```
