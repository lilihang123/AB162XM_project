## CMakeLists.txt
```
# SPDX-License-Identifier: Apache-2.0

cmake_minimum_required(VERSION 3.20.0)
find_package(Zephyr REQUIRED HINTS $ENV{ZEPHYR_BASE})
project(posix_headers)

FILE(GLOB app_sources src/*.c)
target_sources(app PRIVATE ${app_sources})
target_compile_options(app PRIVATE -U_POSIX_C_SOURCE -D_POSIX_C_SOURCE=200809L)
```

## prj.conf
```kconfig
CONFIG_POSIX_API=y
CONFIG_ZTEST=y

# for POSIX_FILESYSTEM
CONFIG_POSIX_FILE_SYSTEM=y

# for networking things to work
CONFIG_NETWORKING=y
CONFIG_POSIX_NETWORKING=y
CONFIG_NET_TEST=y
CONFIG_TEST_RANDOM_GENERATOR=y

# For e.g. sched_get_priority_max()
CONFIG_POSIX_PRIORITY_SCHEDULING=y

# For putmsg(), etc
CONFIG_XOPEN_STREAMS=y

# for when CONFIG_POSIX_API is not selected
CONFIG_POSIX_THREADS=y
CONFIG_POSIX_TIMERS=y
CONFIG_POSIX_MESSAGE_PASSING=y
CONFIG_EVENTFD=y
CONFIG_POSIX_C_LIB_EXT=y
```

## boards/mimxrt1015_evk.overlay
```dts
/*
 * Copyright 2023 NXP
 *
 * SPDX-License-Identifier: Apache-2.0
 */

/ {
	chosen {
		zephyr,sram = &ocram;
	};
};
```

## src/_common.h
```c
/*
 * Copyright (c) 2022 Meta
 *
 * SPDX-License-Identifier: Apache-2.0
 */

#pragma once

#include <limits.h>
#include <stddef.h>
#include <stdint.h>

#include <zephyr/ztest.h>
```

## src/_main.c
```c
/*
 * Copyright (c) 2022 Meta
 *
 * SPDX-License-Identifier: Apache-2.0
 */

#include "_common.h"

ZTEST_SUITE(posix_headers, NULL, NULL, NULL, NULL, NULL);
```

## src/aio_h.c
```c
/*
 * Copyright (c) 2024 Tenstorrent AI ULC
 *
 * SPDX-License-Identifier: Apache-2.0
 */

#include "_common.h"

#ifdef CONFIG_POSIX_API
#include <aio.h>
#else
#include <zephyr/posix/aio.h>
#endif

ZTEST(posix_headers, test_aio_h)
{
	zassert_not_equal(offsetof(struct aiocb, aio_fildes), -1);
	zassert_not_equal(offsetof(struct aiocb, aio_offset), -1);
	zassert_not_equal(offsetof(struct aiocb, aio_buf), -1);
	zassert_not_equal(offsetof(struct aiocb, aio_nbytes), -1);
	zassert_not_equal(offsetof(struct aiocb, aio_reqprio), -1);
	zassert_not_equal(offsetof(struct aiocb, aio_sigevent), -1);
	zassert_not_equal(offsetof(struct aiocb, aio_lio_opcode), -1);

	if (IS_ENABLED(CONFIG_POSIX_API)) {
		zassert_not_null(aio_cancel);
		zassert_not_null(aio_error);
		zassert_not_null(aio_fsync);
		zassert_not_null(aio_read);
		zassert_not_null(aio_return);
		zassert_not_null(aio_suspend);
		zassert_not_null(aio_write);
		zassert_not_null(lio_listio);
	}
}
```

## src/arpa_inet_h.c
```c
/*
 * Copyright (c) 2022 Meta
 *
 * SPDX-License-Identifier: Apache-2.0
 */

#include "_common.h"

#ifdef CONFIG_POSIX_API
#include <arpa/inet.h>
#else
#include <zephyr/posix/arpa/inet.h>
#endif

/**
 * @brief existence test for `<arpa/inet.h>`
 *
 * @see <a href="https://pubs.opengroup.org/onlinepubs/9699919799/basedefs/arpa_inet.h.html">arpa/inet.h</a>
 */
ZTEST(posix_headers, test_arpa_inet_h)
{
	zassert_not_equal(-1, htonl(0));
	zassert_not_equal(-1, htons(0));
	zassert_not_equal(-1, ntohl(0));
	zassert_not_equal(-1, ntohs(0));

	if (IS_ENABLED(CONFIG_POSIX_NETWORKING)) {
		/* zassert_not_null(inet_addr); */ /* not implemented */
		/* zassert_not_null(inet_ntoa); */ /* not implemented */
		zassert_not_null(inet_ntop);
		zassert_not_null(inet_pton);
	}
}
```

## src/dirent_h.c
```c
/*
 * Copyright (c) 2022 Meta
 *
 * SPDX-License-Identifier: Apache-2.0
 */

#include "_common.h"

#ifdef CONFIG_POSIX_API
#include <dirent.h>
#else
#include <zephyr/posix/dirent.h>
#endif

/**
 * @brief existence test for `<dirent.h>`
 *
 * @see <a href="https://pubs.opengroup.org/onlinepubs/9699919799/basedefs/dirent.h.html">dirent.h</a>
 */
ZTEST(posix_headers, test_dirent_h)
{
#ifdef CONFIG_POSIX_API
	zassert_not_equal((DIR *)-1, (DIR *)NULL);

	zassert_not_equal(-1, offsetof(struct dirent, d_ino));
	zassert_not_equal(-1, offsetof(struct dirent, d_name));

	/* zassert_not_null(alphasort); */ /* not implemented */
	zassert_not_null(closedir);
	/* zassert_not_null(dirfd); */     /* not implemented */
	/* zassert_not_null(fdopendir); */ /* not implemented */
	zassert_not_null(opendir);
	zassert_not_null(readdir);
	/* zassert_not_null(readdir_r); */ /* not implemented */
	/* zassert_not_null(rewinddir); */ /* not implemented */
	/* zassert_not_null(scandir); */   /* not implemented */
	/* zassert_not_null(seekdir); */   /* not implemented */
	/* zassert_not_null(telldir); */   /* not implemented */
#endif
}
```

## src/mqueue_h.c
```c
/*
 * Copyright (c) 2022 Meta
 *
 * SPDX-License-Identifier: Apache-2.0
 */

#include "_common.h"

#ifdef CONFIG_POSIX_API
#include <mqueue.h>
#else
#include <zephyr/posix/mqueue.h>
#endif

/**
 * @brief existence test for `<mqueue.h>`
 *
 * @see <a href="https://pubs.opengroup.org/onlinepubs/9699919799/basedefs/mqueue.h.html">mqueue.h</a>
 */
ZTEST(posix_headers, test_mqueue_h)
{
	zassert_not_equal((mqd_t)-1, (mqd_t)NULL);

	zassert_not_equal(-1, offsetof(struct mq_attr, mq_flags));
	zassert_not_equal(-1, offsetof(struct mq_attr, mq_maxmsg));
	zassert_not_equal(-1, offsetof(struct mq_attr, mq_msgsize));
	zassert_not_equal(-1, offsetof(struct mq_attr, mq_curmsgs));

	if (IS_ENABLED(CONFIG_POSIX_API)) {
		zassert_not_null(mq_close);
		zassert_not_null(mq_getattr);
		zassert_not_null(mq_notify);
		zassert_not_null(mq_open);
		zassert_not_null(mq_receive);
		zassert_not_null(mq_send);
		zassert_not_null(mq_setattr);
		zassert_not_null(mq_timedreceive);
		zassert_not_null(mq_timedsend);
		zassert_not_null(mq_unlink);
	}
}
```

## src/net_if_h.c
```c
/*
 * Copyright (c) 2022 Meta
 *
 * SPDX-License-Identifier: Apache-2.0
 */

#include "_common.h"

#ifdef CONFIG_POSIX_API
#include <net/if.h>
#else
#include <zephyr/posix/net/if.h>
#endif

/**
 * @brief existence test for `<net/if.h>`
 *
 * @see <a href="https://pubs.opengroup.org/onlinepubs/9699919799/basedefs/net_if.h.html">net/if.h</a>
 */
ZTEST(posix_headers, test_net_if_h)
{
	zassert_not_equal(-1, offsetof(struct if_nameindex, if_index));
	zassert_not_equal(-1, offsetof(struct if_nameindex, if_name));

	zassert_not_equal(-1, IF_NAMESIZE);

	if (IS_ENABLED(CONFIG_POSIX_NETWORKING)) {
		zassert_not_null(if_freenameindex);
		zassert_not_null(if_indextoname);
		zassert_not_null(if_nameindex);
		zassert_not_null(if_nametoindex);
	}
}
```

## src/netdb_h.c
```c
/*
 * Copyright (c) 2022 Meta
 *
 * SPDX-License-Identifier: Apache-2.0
 */

#include "_common.h"

#ifdef CONFIG_POSIX_API
#include <netdb.h>
#else
#include <zephyr/posix/netdb.h>
#endif

/**
 * @brief existence test for `<netdb.h>`
 *
 * @see <a href="https://pubs.opengroup.org/onlinepubs/9699919799/basedefs/netdb.h.html>netdb.h</a>
 */
ZTEST(posix_headers, test_netdb_h)
{
	zassert_not_equal(-1, offsetof(struct hostent, h_name));
	zassert_not_equal(-1, offsetof(struct hostent, h_aliases));
	zassert_not_equal(-1, offsetof(struct hostent, h_addrtype));
	zassert_not_equal(-1, offsetof(struct hostent, h_length));
	zassert_not_equal(-1, offsetof(struct hostent, h_addr_list));

	zassert_not_equal(-1, offsetof(struct netent, n_name));
	zassert_not_equal(-1, offsetof(struct netent, n_aliases));
	zassert_not_equal(-1, offsetof(struct netent, n_addrtype));
	zassert_not_equal(-1, offsetof(struct netent, n_net));

	zassert_not_equal(-1, offsetof(struct protoent, p_name));
	zassert_not_equal(-1, offsetof(struct protoent, p_aliases));
	zassert_not_equal(-1, offsetof(struct protoent, p_proto));

	zassert_not_equal(-1, offsetof(struct servent, s_name));
	zassert_not_equal(-1, offsetof(struct servent, s_aliases));
	zassert_not_equal(-1, offsetof(struct servent, s_port));
	zassert_not_equal(-1, offsetof(struct servent, s_proto));

	/* zassert_equal(IPPORT_RESERVED, UINT16_MAX); */ /* not implemented */

	zassert_not_equal(-1, offsetof(struct addrinfo, ai_flags));
	zassert_not_equal(-1, offsetof(struct addrinfo, ai_family));
	zassert_not_equal(-1, offsetof(struct addrinfo, ai_socktype));
	zassert_not_equal(-1, offsetof(struct addrinfo, ai_protocol));
	zassert_not_equal(-1, offsetof(struct addrinfo, ai_addrlen));
	zassert_not_equal(-1, offsetof(struct addrinfo, ai_addr));
	zassert_not_equal(-1, offsetof(struct addrinfo, ai_canonname));
	zassert_not_equal(-1, offsetof(struct addrinfo, ai_next));

	zassert_not_equal(-1, AI_PASSIVE);
	zassert_not_equal(-1, AI_CANONNAME);
	zassert_not_equal(-1, AI_NUMERICHOST);
	zassert_not_equal(-1, AI_NUMERICSERV);
	zassert_not_equal(-1, AI_V4MAPPED);
	zassert_not_equal(-1, AI_ALL);
	zassert_not_equal(-1, AI_ADDRCONFIG);

	zassert_not_equal(-1, NI_NOFQDN);
	zassert_not_equal(-1, NI_NUMERICHOST);
	zassert_not_equal(-1, NI_NAMEREQD);
	zassert_not_equal(-1, NI_NUMERICSERV);
	/* zassert_not_equal(-1, NI_NUMERICSCOPE); */ /* not implemented */
	zassert_not_equal(-1, NI_DGRAM);

	zassert_not_equal(-1, EAI_AGAIN);
	zassert_equal(-1, EAI_BADFLAGS);
	zassert_not_equal(-1, EAI_FAIL);
	zassert_not_equal(-1, EAI_FAMILY);
	zassert_not_equal(-1, EAI_MEMORY);
	zassert_not_equal(-1, EAI_NONAME);
	zassert_not_equal(-1, EAI_SERVICE);
	zassert_not_equal(-1, EAI_SOCKTYPE);
	zassert_not_equal(-1, EAI_SYSTEM);
	zassert_not_equal(-1, EAI_OVERFLOW);

	if (IS_ENABLED(CONFIG_POSIX_NETWORKING)) {
		zassert_not_null(endhostent);
		zassert_not_null(endnetent);
		zassert_not_null(endprotoent);
		zassert_not_null(endservent);
		zassert_not_null(freeaddrinfo);
		zassert_not_null(gai_strerror);
		zassert_not_null(getaddrinfo);
		zassert_not_null(gethostent);
		zassert_not_null(getnameinfo);
		zassert_not_null(getnetbyaddr);
		zassert_not_null(getnetbyname);
		zassert_not_null(getnetent);
		zassert_not_null(getprotobyname);
		zassert_not_null(getprotobynumber);
		zassert_not_null(getprotoent);
		zassert_not_null(getservbyname);
		zassert_not_null(getservbyport);
		zassert_not_null(getservent);
		zassert_not_null(sethostent);
		zassert_not_null(setnetent);
		zassert_not_null(setprotoent);
		zassert_not_null(setservent);
	}
}
```

## src/netinet_in_h.c
```c
/*
 * Copyright (c) 2022 Meta
 *
 * SPDX-License-Identifier: Apache-2.0
 */

#include "_common.h"

#ifdef CONFIG_POSIX_API
#include <netinet/in.h>
#else
#include <zephyr/posix/netinet/in.h>
#endif

#pragma GCC diagnostic push
#pragma GCC diagnostic ignored "-Wunused-variable"
/**
 * @brief existence test for `<netinet/in.h>`
 *
 * @see <a href="https://pubs.opengroup.org/onlinepubs/9699919799/basedefs/netinet_in.h.html">netinet/in.h</a>
 */
ZTEST(posix_headers, test_netinet_in_h)
{
	zassert_equal(sizeof(in_port_t), sizeof(uint16_t));
	zassert_equal(sizeof(in_addr_t), sizeof(uint32_t));

	zassert_not_equal(-1, offsetof(struct in_addr, s_addr));

	zassert_not_equal(-1, offsetof(struct sockaddr_in, sin_family));
	zassert_not_equal(-1, offsetof(struct sockaddr_in, sin_port));
	zassert_not_equal(-1, offsetof(struct sockaddr_in, sin_addr));

	zassert_not_equal(-1, offsetof(struct in6_addr, s6_addr));
	zassert_equal(sizeof(((struct in6_addr *)NULL)->s6_addr), 16 * sizeof(uint8_t));

	zassert_not_equal(-1, offsetof(struct sockaddr_in6, sin6_family));
	zassert_not_equal(-1, offsetof(struct sockaddr_in6, sin6_port));
	/* not implemented */
	/* zassert_not_equal(-1, offsetof(struct sockaddr_in6, sin6_flowinfo)); */
	zassert_not_equal(-1, offsetof(struct sockaddr_in6, sin6_addr));
	/* not implemented */
	/* zassert_not_equal(-1, offsetof(struct sockaddr_in6, scope_id)); */

	zassert_not_null(&in6addr_loopback);
	struct in6_addr any6 = IN6ADDR_ANY_INIT;
	struct in6_addr lo6 = IN6ADDR_LOOPBACK_INIT;

	/* not implemented */
	/* zassert_not_equal(-1, offsetof(struct ipv6_mreq, ipv6mr_multiaddr)); */
	/* not implemented */
	/* zassert_not_equal(-1, offsetof(struct ipv6_mreq, ipv6mr_interface)); */

	zassert_not_equal(-1, IPPROTO_IP);
	zassert_not_equal(-1, IPPROTO_IPV6);
	zassert_not_equal(-1, IPPROTO_ICMP);
	zassert_not_equal(-1, IPPROTO_RAW);
	zassert_not_equal(-1, IPPROTO_TCP);
	zassert_not_equal(-1, IPPROTO_UDP);

	zassert_not_equal(-1, INADDR_ANY);
	/* zassert_not_equal(-1, INADDR_BROADCAST); */ /* not implemented */

	zassert_equal(INET_ADDRSTRLEN, 16);
	zassert_equal(INET6_ADDRSTRLEN, 46);

	/* zassert_not_equal(-1, IPV6_JOIN_GROUP); */ /* not implemented */
	/* zassert_not_equal(-1, IPV6_LEAVE_GROUP); */ /* not implemented */
	/* zassert_not_equal(-1, IPV6_MULTICAST_HOPS); */ /* not implemented */
	/* zassert_not_equal(-1, IPV6_MULTICAST_IF); */ /* not implemented */
	/* zassert_not_equal(-1, IPV6_MULTICAST_LOOP); */ /* not implemented */
	/* zassert_not_equal(-1, IPV6_UNICAST_HOPS); */ /* not implemented */
	zassert_not_equal(-1, IPV6_V6ONLY);

	/* IN6_IS_ADDR_UNSPECIFIED(&any6); */ /* not implemented */
	/* IN6_IS_ADDR_LOOPBACK(&lo6); */ /* not implemented */

	/* IN6_IS_ADDR_MULTICAST(&lo6); */ /* not implemented */
	/* IN6_IS_ADDR_LINKLOCAL(&lo6); */ /* not implemented */
	/* IN6_IS_ADDR_SITELOCAL(&lo6); */ /* not implemented */
	/* IN6_IS_ADDR_V4MAPPED(&lo6); */ /* not implemented */
	/* IN6_IS_ADDR_V4COMPAT(&lo6); */ /* not implemented */
	/* IN6_IS_ADDR_MC_NODELOCAL(&lo6); */ /* not implemented */
	/* IN6_IS_ADDR_MC_LINKLOCAL(&lo6); */ /* not implemented */
	/* IN6_IS_ADDR_MC_SITELOCAL(&lo6); */ /* not implemented */
	/* IN6_IS_ADDR_MC_ORGLOCAL(&lo6); */ /* not implemented */
	/* IN6_IS_ADDR_MC_GLOBAL(&lo6); */ /* not implemented */
}
#pragma GCC diagnostic pop
```

## src/netinet_tcp_h.c
```c
/*
 * Copyright (c) 2022 Meta
 *
 * SPDX-License-Identifier: Apache-2.0
 */

#include "_common.h"

#ifdef CONFIG_POSIX_API
#include <netinet/tcp.h>
#else
#include <zephyr/posix/netinet/tcp.h>
#endif

/**
 * @brief existence test for `<netinet/tcp.h>`
 *
 * @see <a href="https://pubs.opengroup.org/onlinepubs/9699919799/basedefs/netinet_tcp.h.html">netinet/tcp.h</a>
 */
ZTEST(posix_headers, test_netinet_tcp_h)
{
	zassert_not_equal(-1, TCP_NODELAY);
}
```

## src/poll_h.c
```c
/*
 * Copyright (c) 2022 Meta
 *
 * SPDX-License-Identifier: Apache-2.0
 */

#include "_common.h"

#ifdef CONFIG_POSIX_API
#include <poll.h>
#else
#include <zephyr/posix/poll.h>
#endif

/**
 * @brief existence test for `<poll.h>`
 *
 * @see <a href="https://pubs.opengroup.org/onlinepubs/9699919799/basedefs/poll.h.html">poll.h</a>
 */
ZTEST(posix_headers, test_poll_h)
{
	zassert_not_equal(-1, offsetof(struct pollfd, fd));
	zassert_not_equal(-1, offsetof(struct pollfd, events));
	zassert_not_equal(-1, offsetof(struct pollfd, revents));

	/* zassert_true(sizeof(nfds_t) <= sizeof(long)); */ /* not implemented */

	zassert_not_equal(-1, POLLIN);
	/* zassert_not_equal(-1, POLLRDNORM); */ /* not implemented */
	/* zassert_not_equal(-1, POLLRDBAND); */ /* not implemented */
	/* zassert_not_equal(-1, POLLPRI); */ /* not implemented */
	zassert_not_equal(-1, POLLOUT);
	/* zassert_not_equal(-1, POLLWRNORM); */ /* not implemented */
	/* zassert_not_equal(-1, POLLWRBAND); */ /* not implemented */
	zassert_not_equal(-1, POLLERR);
	zassert_not_equal(-1, POLLHUP);
	zassert_not_equal(-1, POLLNVAL);

	if (IS_ENABLED(CONFIG_POSIX_DEVICE_IO)) {
		zassert_not_null(poll);
	}
}
```

## src/pthread_h.c
```c
/*
 * Copyright (c) 2022 Meta
 *
 * SPDX-License-Identifier: Apache-2.0
 */

#include "_common.h"

#ifdef CONFIG_POSIX_API
#include <pthread.h>
#else
#include <zephyr/posix/pthread.h>
#endif

#pragma GCC diagnostic push
#pragma GCC diagnostic ignored "-Wunused-variable"
/**
 * @brief existence test for `<pthread.h>`
 *
 * @see <a href="https://pubs.opengroup.org/onlinepubs/9699919799/basedefs/pthread.h.html">pthread.h</a>
 */
ZTEST(posix_headers, test_pthread_h)
{
#ifdef CONFIG_POSIX_API
	zassert_not_equal(-1, PTHREAD_BARRIER_SERIAL_THREAD);

	zassert_not_equal(-1, PTHREAD_CANCEL_ASYNCHRONOUS);
	zassert_not_equal(-1, PTHREAD_CANCEL_DEFERRED);

	zassert_not_equal(-1, PTHREAD_CANCEL_ENABLE);
	zassert_not_equal(-1, PTHREAD_CANCEL_DISABLE);

	zassert_not_equal((void *)-42, PTHREAD_CANCELED);

	zassert_not_equal(-1, PTHREAD_CREATE_DETACHED);
	zassert_not_equal(-1, PTHREAD_CREATE_JOINABLE);

	zassert_not_equal(-1, PTHREAD_EXPLICIT_SCHED);
	zassert_not_equal(-1, PTHREAD_INHERIT_SCHED);

	zassert_not_equal(-1, PTHREAD_MUTEX_DEFAULT);
	zassert_not_equal(-1, PTHREAD_MUTEX_ERRORCHECK);
	zassert_not_equal(-1, PTHREAD_MUTEX_ERRORCHECK);
	zassert_not_equal(-1, PTHREAD_MUTEX_RECURSIVE);
	/* zassert_not_equal(-1, PTHREAD_MUTEX_ROBUST); */  /* not implemented */
	/* zassert_not_equal(-1, PTHREAD_MUTEX_STALLED); */ /* not implemented */

	pthread_once_t once = PTHREAD_ONCE_INIT;

	/* zassert_not_equal(-1, PTHREAD_PRIO_INHERIT); */ /* not implemented */
	zassert_not_equal(-1, PTHREAD_PRIO_NONE);
	/* zassert_not_equal(-1, PTHREAD_PRIO_PROTECT); */ /* not implemented */

	zassert_not_equal(-1, PTHREAD_PROCESS_SHARED);
	zassert_not_equal(-1, PTHREAD_PROCESS_PRIVATE);

	zassert_not_equal(-1, PTHREAD_SCOPE_PROCESS);
	zassert_not_equal(-1, PTHREAD_SCOPE_SYSTEM);

	pthread_cond_t cond = PTHREAD_COND_INITIALIZER;
	pthread_mutex_t mu = PTHREAD_MUTEX_INITIALIZER;
	/* pthread_rwlock_t lock = POSIX_READER_WRITER_LOCKS_INITIALIZER; */ /* not implemented */

	zassert_not_null(pthread_atfork);
	zassert_not_null(pthread_attr_destroy);
	zassert_not_null(pthread_attr_getdetachstate);
	zassert_not_null(pthread_attr_getguardsize);
	zassert_not_null(pthread_attr_getinheritsched);
	zassert_not_null(pthread_attr_getschedparam);
	zassert_not_null(pthread_attr_getschedpolicy);
	zassert_not_null(pthread_attr_getscope);
	zassert_not_null(pthread_attr_getstack);
	zassert_not_null(pthread_attr_getstacksize);
	zassert_not_null(pthread_attr_init);
	zassert_not_null(pthread_attr_setdetachstate);
	zassert_not_null(pthread_attr_setguardsize);
	zassert_not_null(pthread_attr_setinheritsched);
	zassert_not_null(pthread_attr_setschedparam);
	zassert_not_null(pthread_attr_setschedpolicy);
	zassert_not_null(pthread_attr_setscope);
	zassert_not_null(pthread_attr_setstack);
	zassert_not_null(pthread_attr_setstacksize);
	zassert_not_null(pthread_barrier_destroy);
	zassert_not_null(pthread_barrier_init);
	zassert_not_null(pthread_barrier_wait);
	zassert_not_null(pthread_barrierattr_destroy);
	/* zassert_not_null(pthread_barrierattr_getpshared); */ /* not implemented */
	zassert_not_null(pthread_barrierattr_init);
	/* zassert_not_null(pthread_barrierattr_setpshared); */ /* not implemented */
	zassert_not_null(pthread_cancel);
	zassert_not_null(pthread_cond_broadcast);
	zassert_not_null(pthread_cond_destroy);
	zassert_not_null(pthread_cond_init);
	zassert_not_null(pthread_cond_signal);
	zassert_not_null(pthread_cond_timedwait);
	zassert_not_null(pthread_cond_wait);
	zassert_not_null(pthread_condattr_destroy);
	zassert_not_null(pthread_condattr_getclock);
	/* zassert_not_null(pthread_condattr_getpshared); */ /* not implemented */
	zassert_not_null(pthread_condattr_init);
	zassert_not_null(pthread_condattr_setclock);
	/* zassert_not_null(pthread_condattr_setpshared); */ /* not implemented */
	zassert_not_null(pthread_create);
	zassert_not_null(pthread_detach);
	zassert_not_null(pthread_equal);
	zassert_not_null(pthread_exit);
	zassert_not_null(pthread_getconcurrency);
	/* zassert_not_null(pthread_getcpuclockid); */ /* not implemented */
	zassert_not_null(pthread_getschedparam);
	zassert_not_null(pthread_getspecific);
	zassert_not_null(pthread_join);
	zassert_not_null(pthread_key_create);
	zassert_not_null(pthread_key_delete);
	/* zassert_not_null(pthread_mutex_consistent); */ /* not implemented */
	zassert_not_null(pthread_mutex_destroy);
	/* zassert_not_null(pthread_mutex_getprioceiling); */ /* not implemented */
	zassert_not_null(pthread_mutex_init);
	zassert_not_null(pthread_mutex_lock);
	/* zassert_not_null(pthread_mutex_setprioceiling); */ /* not implemented */
	zassert_not_null(pthread_mutex_timedlock);
	zassert_not_null(pthread_mutex_trylock);
	zassert_not_null(pthread_mutex_unlock);
	zassert_not_null(pthread_mutexattr_destroy);
	/* zassert_not_null(pthread_mutexattr_getprioceiling); */ /* not implemented */
	zassert_not_null(pthread_mutexattr_getprotocol);
	/* zassert_not_null(pthread_mutexattr_getpshared); */ /* not implemented */
	/* zassert_not_null(pthread_mutexattr_getrobust); */  /* not implemented */
	zassert_not_null(pthread_mutexattr_gettype);
	zassert_not_null(pthread_mutexattr_init);
	/* zassert_not_null(pthread_mutexattr_setprioceiling); */ /* not implemented */
	/* zassert_not_null(pthread_mutexattr_setprotocol); */    /* not implemented */
	/* zassert_not_null(pthread_mutexattr_setpshared); */     /* not implemented */
	/* zassert_not_null(pthread_mutexattr_setrobust); */      /* not implemented */
	zassert_not_null(pthread_mutexattr_settype);
	zassert_not_null(pthread_once);
	zassert_not_null(pthread_rwlock_destroy);
	zassert_not_null(pthread_rwlock_init);
	zassert_not_null(pthread_rwlock_rdlock);
	zassert_not_null(pthread_rwlock_timedrdlock);
	zassert_not_null(pthread_rwlock_timedwrlock);
	zassert_not_null(pthread_rwlock_tryrdlock);
	zassert_not_null(pthread_rwlock_trywrlock);
	zassert_not_null(pthread_rwlock_unlock);
	zassert_not_null(pthread_rwlock_wrlock);
	zassert_not_null(pthread_rwlockattr_destroy);
	zassert_not_null(pthread_rwlockattr_getpshared);
	zassert_not_null(pthread_rwlockattr_init);
	zassert_not_null(pthread_rwlockattr_setpshared);
	zassert_not_null(pthread_self);
	zassert_not_null(pthread_setcancelstate);
	zassert_not_null(pthread_setcanceltype);
	zassert_not_null(pthread_setconcurrency);
	zassert_not_null(pthread_setschedparam);
	zassert_not_null(pthread_setschedprio);
	zassert_not_null(pthread_setspecific);
	zassert_not_null(pthread_spin_destroy);
	zassert_not_null(pthread_spin_init);
	zassert_not_null(pthread_spin_lock);
	zassert_not_null(pthread_spin_trylock);
	zassert_not_null(pthread_spin_unlock);
	zassert_not_null(pthread_testcancel);
#endif
}
#pragma GCC diagnostic pop
```
