## CMakeLists.txt
```
# SPDX-License-Identifier: Apache-2.0

cmake_minimum_required(VERSION 3.20.0)
find_package(Zephyr REQUIRED HINTS $ENV{ZEPHYR_BASE})
project(posix_net)

FILE(GLOB app_sources src/*.c)

target_sources(app PRIVATE ${app_sources})
```

## prj.conf
```kconfig
CONFIG_ZTEST=y
CONFIG_NET_TEST=y
CONFIG_TEST_RANDOM_GENERATOR=y

CONFIG_POSIX_API=y
CONFIG_POSIX_NETWORKING=y
CONFIG_NETWORKING=y
```

## src/main.c
```c
/*
 * Copyright (c) 2024, Friedt Professional Engineering Services, Inc
 *
 * SPDX-License-Identifier: Apache-2.0
 */

#include <zephyr/ztest.h>

ZTEST_SUITE(net, NULL, NULL, NULL, NULL, NULL);
```

## src/if.c
```c
/*
 * Copyright (c) 2024, Friedt Professional Engineering Services, Inc
 *
 * SPDX-License-Identifier: Apache-2.0
 */

#include <zephyr/logging/log.h>
#include <zephyr/net/net_if.h>
#include <zephyr/posix/net/if.h>
#include <zephyr/sys/util.h>
#include <zephyr/ztest.h>

ZTEST(net, test_if_indextoname)
{
	char *name;
	size_t n = 0;
	struct net_if *iface;
	char a[IF_NAMESIZE];
	char b[IF_NAMESIZE];

	NET_IFACE_COUNT(&n);
	TC_PRINT("%zu interfaces\n", n);
	for (size_t i = 0; i < n; i++) {
		memset(a, 0, sizeof(a));
		memset(b, 0, sizeof(b));
		name = if_indextoname(i + 1, a);
		zassert_equal(name, a);
		TC_PRINT("interface %zu: %s\n", i + 1, name);
		iface = net_if_get_by_index(i + 1);
		zassert_not_null(iface);
		zassert_true(net_if_get_name(iface, b, IF_NAMESIZE) >= 0);
		zassert_mem_equal(a, b, IF_NAMESIZE);
	}
}

ZTEST(net, test_if_freenameindex)
{
	if_freenameindex(NULL);
	if_freenameindex(if_nameindex());
}

ZTEST(net, test_if_nameindex)
{
	size_t n = 0;
	struct if_nameindex *ni;

	NET_IFACE_COUNT(&n);
	TC_PRINT("%zu interfaces\n", n);

	ni = if_nameindex();
	if (ni == NULL) {
		zassert_equal(errno, ENOBUFS);
		return;
	}

	for (size_t i = 0; i < n; i++) {
		zassert_equal(i + 1, ni[i].if_index);
		zassert_not_null(ni[i].if_name);
		TC_PRINT("interface %zu: %s\n", i + 1, ni[i].if_name);
		zassert_equal(0, ni[n].if_index);
		zassert_is_null(ni[n].if_name);
	}

	if_freenameindex(ni);
}

ZTEST(net, test_if_nametoindex)
{
	size_t n = 0;
	char buf[IF_NAMESIZE];

	NET_IFACE_COUNT(&n);
	TC_PRINT("%zu interfaces\n", n);
	for (size_t i = 0; i < n; i++) {
		memset(buf, 0, sizeof(buf));
		zassert_not_null(if_indextoname(i + 1, buf));
		TC_PRINT("interface %zu: %s\n", i + 1, buf);
		zassert_equal(i + 1, if_nametoindex(buf));
	}
}
```

## src/inet_addr.c
```c
/*
 * Copyright (c) 2024, Friedt Professional Engineering Services, Inc
 *
 * SPDX-License-Identifier: Apache-2.0
 */

#include <stdint.h>

#include <zephyr/posix/arpa/inet.h>
#include <zephyr/posix/netinet/in.h>
#include <zephyr/sys/util.h>
#include <zephyr/ztest.h>

ZTEST(net, test_inet_addr)
{
	in_addr_t ret;
	static const struct parm {
		const char *in;
		int out;
	} parms[] = {
	/* expect failure */
#ifndef CONFIG_ARCH_POSIX
		{NULL, (uint32_t)-1}, /* this value will segfault using the host libc */
#endif
		{".", (uint32_t)-1},
		{"..", (uint32_t)-1},
		{"...", (uint32_t)-1},
		{"-1.-2.-3.-4", (uint32_t)-1},
		{"256.65536.4294967296.18446744073709551616", (uint32_t)-1},
		{"a.b.c.d", (uint32_t)-1},
		{"0.0.0.1234", (uint32_t)-1},
		{"0.0.0.12a", (uint32_t)-1},
		{" 1.2.3.4", (uint32_t)-1},

		/* expect success */
		{"0.0.0.0", htonl(0)},
		{"000.00.0.0", htonl(0)},
		{"127.0.0.1", htonl(0x7f000001)},
		{"1.2.3.4", htonl(0x01020304)},
		{"1.2.3.4    ", htonl(0x01020304)},
		{"0.0.0.123 a", htonl(0x0000007b)},
		{"255.255.255.255", htonl(0xffffffff)},
	};

	ARRAY_FOR_EACH_PTR(parms, p) {
		ret = inet_addr(p->in);
		zexpect_equal(ret, p->out, "inet_addr(%s) failed. expect: %d actual: %d", p->in,
			      p->out, ret);
	}
}
```

## src/inet_ntoa.c
```c
/*
 * Copyright (c) 2024, Friedt Professional Engineering Services, Inc
 *
 * SPDX-License-Identifier: Apache-2.0
 */

#include <zephyr/posix/arpa/inet.h>
#include <zephyr/posix/netinet/in.h>

#include <zephyr/ztest.h>

ZTEST(net, test_inet_ntoa)
{
	struct in_addr in;

	in.s_addr = htonl(0x7f000001);
	zassert_mem_equal(inet_ntoa(in), "127.0.0.1", strlen("127.0.0.1") + 1);

	in.s_addr = htonl(0);
	zassert_mem_equal(inet_ntoa(in), "0.0.0.0", strlen("0.0.0.0") + 1);

	in.s_addr = htonl(0xffffffff);
	zassert_mem_equal(inet_ntoa(in), "255.255.255.255", strlen("255.255.255.255") + 1);
}
```
