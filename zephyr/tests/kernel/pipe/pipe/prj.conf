## CMakeLists.txt
```
# SPDX-License-Identifier: Apache-2.0

cmake_minimum_required(VERSION 3.20.0)
find_package(Zephyr REQUIRED HINTS $ENV{ZEPHYR_BASE})
project(pipe)

FILE(GLOB app_sources src/*.c)
target_sources(app PRIVATE ${app_sources})
```

## prj.conf
```kconfig
CONFIG_ZTEST=y
CONFIG_TEST_USERSPACE=y
CONFIG_MP_MAX_NUM_CPUS=1
CONFIG_PIPES=y
```

## src/main.c
```c
/*
 * Copyright (c) 2016 Intel Corporation
 *
 * SPDX-License-Identifier: Apache-2.0
 */

#include <zephyr/ztest.h>

extern struct k_pipe test_pipe;
extern struct k_pipe small_pipe;
extern struct k_sem put_sem, get_sem, sync_sem, multiple_send_sem;
extern struct k_stack stack_1;
extern struct k_thread get_single_tid;

static void *pipe_setup(void)
{
	k_thread_access_grant(k_current_get(),
			      &test_pipe, &small_pipe, &put_sem, &get_sem,
			      &sync_sem, &multiple_send_sem,
			      &get_single_tid, &stack_1);

	return NULL;
}

ZTEST_SUITE(pipe, NULL, pipe_setup, NULL, NULL, NULL);
```
