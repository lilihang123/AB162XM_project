## CMakeLists.txt
```
# SPDX-License-Identifier: Apache-2.0

cmake_minimum_required(VERSION 3.20.0)
find_package(Zephyr REQUIRED HINTS $ENV{ZEPHYR_BASE})
project(pipe_api)

FILE(GLOB app_sources src/*.c)
target_sources(app PRIVATE ${app_sources})
```

## prj.conf
```kconfig
CONFIG_ZTEST=y
CONFIG_IRQ_OFFLOAD=y
CONFIG_TEST_USERSPACE=y
CONFIG_DYNAMIC_OBJECTS=y
CONFIG_MP_MAX_NUM_CPUS=1
CONFIG_ZTEST_FATAL_HOOK=y
CONFIG_PIPES=y
```

## src/main.c
```c
/*
 * Copyright (c) 2016 Intel Corporation
 *
 * SPDX-License-Identifier: Apache-2.0
 */

/**
 * @defgroup kernel_pipe_tests PIPEs
 * @ingroup all_tests
 * @{
 * @}
 */

#include <zephyr/ztest.h>

/* k objects */
extern struct k_pipe pipe, kpipe, khalfpipe, put_get_pipe;
extern struct k_sem end_sema;
extern struct k_stack tstack;
extern struct k_thread tdata;
extern struct k_heap test_pool;

static void *pipe_api_setup(void)
{
	k_thread_access_grant(k_current_get(), &pipe,
			      &kpipe, &end_sema, &tdata, &tstack,
			      &khalfpipe, &put_get_pipe);

	k_thread_heap_assign(k_current_get(), &test_pool);

	return NULL;
}

ZTEST_SUITE(pipe_api, NULL, pipe_api_setup, NULL, NULL, NULL);

ZTEST_SUITE(pipe_api_1cpu, NULL, pipe_api_setup,
		ztest_simple_1cpu_before, ztest_simple_1cpu_after, NULL);
```

## src/test_pipe_avail.c
```c
/*
 * Copyright (c) 2020 Friedt Professional Engineering Services, Inc
 *
 * SPDX-License-Identifier: Apache-2.0
 */

/**
 * @brief Tests for the Pipe read / write availability
 * @ingroup kernel_pipe_tests
 * @{
 */

#include <zephyr/ztest.h>

static ZTEST_DMEM unsigned char __aligned(4) data[] = "abcdefgh";
static struct k_pipe pipe = {
	.buffer = data,
	.size = sizeof(data) - 1 /* '\0' */,
};

static struct k_pipe bufferless;

static struct k_pipe bufferless1 = {
	.buffer = data,
	.size = 0,
};

/**
 * @brief Pipes with no buffer or size 0 should return 0 bytes available
 *
 * Pipes can be created to be bufferless (i.e. @ref k_pipe.buffer is `NULL`
 * or @ref k_pipe.size is 0).
 *
 * If either of those conditions is true, then @ref k_pipe_read_avail and
 * @ref k_pipe_write_avail should return 0.
 *
 * @note
 * A distinction can be made between buffered and bufferless pipes in that
 * @ref k_pipe_read_avail and @ref k_pipe_write_avail will never
 * simultaneously return 0 for a buffered pipe, but they will both return 0
 * for an unbuffered pipe.
 */
ZTEST(pipe_api, test_pipe_avail_no_buffer)
{
	size_t r_avail;
	size_t w_avail;

	r_avail = k_pipe_read_avail(&bufferless);
	zassert_equal(r_avail, 0, "read: expected: 0 actual: %u", r_avail);

	w_avail = k_pipe_write_avail(&bufferless);
	zassert_equal(w_avail, 0, "write: expected: 0 actual: %u", w_avail);

	r_avail = k_pipe_read_avail(&bufferless1);
	zassert_equal(r_avail, 0, "read: expected: 0 actual: %u", r_avail);

	w_avail = k_pipe_write_avail(&bufferless1);
	zassert_equal(w_avail, 0, "write: expected: 0 actual: %u", w_avail);
}

/**
 * @brief Test available read / write space for r < w
 *
 * This test case is for buffered @ref k_pipe objects and covers the case
 * where @ref k_pipe.read_index is less than @ref k_pipe.write_index.
 *
 * In this case, @ref k_pipe.bytes_used is not relevant.
 *
 *      r     w
 *     |a|b|c|d|e|f|g|h|
 *     |0|1|2|3|4|5|6|7|
 *
 * As shown above, the pipe will be able to read 3 bytes without blocking
 * and write 5 bytes without blocking.
 *
 * Thus
 *     r_avail = w - r = 3
 *     would read: a b c d
 *
 *     w_avail = N - (w - r) = 5
 *     would overwrite: e f g h
 */
ZTEST(pipe_api, test_pipe_avail_r_lt_w)
{
	size_t r_avail;
	size_t w_avail;

	pipe.read_index = 0;
	pipe.write_index = 3;
	/* pipe.bytes_used is irrelevant */

	r_avail = k_pipe_read_avail(&pipe);
	zassert_equal(r_avail, 3, "read: expected: 3 actual: %u", r_avail);

	w_avail = k_pipe_write_avail(&pipe);
	zassert_equal(w_avail, 5, "write: expected: 5 actual: %u", w_avail);
}

/**
 * @brief Test available read / write space for w < r
 *
 * This test case is for buffered @ref k_pipe objects and covers the case
 * where @ref k_pipe.write_index is less than @ref k_pipe.read_index.
 *
 * In this case, @ref k_pipe.bytes_used is not relevant.
 *
 *      w     r
 *     |a|b|c|d|e|f|g|h|
 *     |0|1|2|3|4|5|6|7|
 *
 *
 * As shown above, the pipe will fbe able to read 5 bytes without blocking
 * and write 3 bytes without blocking.
 *
 * Thus
 *     r_avail = N - (r - w) = 5
 *     would read: e f g h
 *
 *     w_avail = r - w = 3
 *     would overwrite: a b c d
 */
ZTEST(pipe_api, test_pipe_avail_w_lt_r)
{
	size_t r_avail;
	size_t w_avail;

	pipe.read_index = 3;
	pipe.write_index = 0;
	/* pipe.bytes_used is irrelevant */

	r_avail = k_pipe_read_avail(&pipe);
	zassert_equal(r_avail, 5, "read: expected: 4 actual: %u", r_avail);

	w_avail = k_pipe_write_avail(&pipe);
	zassert_equal(w_avail, 3, "write: expected: 4 actual: %u", w_avail);
}

/**
 * @brief Test available read / write space for `r == w` and an empty buffer
 *
 * This test case is for buffered @ref k_pipe objects and covers the case
 * where @ref k_pipe.read_index is equal to @ref k_pipe.write_index and
 * @ref k_pipe.bytes_used is zero.
 *
 * In this case, @ref k_pipe.bytes_used is relevant because the read and
 * write indices are equal.
 *
 *            r
 *            w
 *     |a|b|c|d|e|f|g|h|
 *     |0|1|2|3|4|5|6|7|
 *
 * Regardless of whether the buffer is full or empty, the following holds:
 *
 *     r_avail = bytes_used
 *     w_avail = N - bytes_used
 *
 * Thus:
 *     r_avail = 0
 *     would read:
 *
 *     w_avail = N - 0 = 8
 *     would overwrite: e f g h a b c d
 */
ZTEST(pipe_api, test_pipe_avail_r_eq_w_empty)
{
	size_t r_avail;
	size_t w_avail;

	pipe.read_index = 4;
	pipe.write_index = 4;
	pipe.bytes_used = 0;

	r_avail = k_pipe_read_avail(&pipe);
	zassert_equal(r_avail, 0, "read: expected: 0 actual: %u", r_avail);

	w_avail = k_pipe_write_avail(&pipe);
	zassert_equal(w_avail, 8, "write: expected: 8 actual: %u", w_avail);
}

/**
 * @brief Test available read / write space for `r == w` and a full buffer
 *
 * This test case is for buffered @ref k_pipe objects and covers the case
 * where @ref k_pipe.read_index is equal to @ref k_pipe.write_index and
 * @ref k_pipe.bytes_used is equal to @ref k_pipe.size.
 *
 * In this case, @ref k_pipe.bytes_used is relevant because the read and
 * write indices are equal.
 *
 *            r
 *            w
 *     |a|b|c|d|e|f|g|h|
 *     |0|1|2|3|4|5|6|7|
 *
 * Regardless of whether the buffer is full or empty, the following holds:
 *
 *     r_avail = bytes_used
 *     w_avail = N - bytes_used
 *
 * Thus
 *     r_avail = N = 8
 *     would read: e f g h a b c d
 *
 *     w_avail = N - 8 = 0
 *     would overwrite:
 */
ZTEST(pipe_api, test_pipe_avail_r_eq_w_full)
{
	size_t r_avail;
	size_t w_avail;

	pipe.read_index = 4;
	pipe.write_index = 4;
	pipe.bytes_used = pipe.size;

	r_avail = k_pipe_read_avail(&pipe);
	zassert_equal(r_avail, 8, "read: expected: 8 actual: %u", r_avail);

	w_avail = k_pipe_write_avail(&pipe);
	zassert_equal(w_avail, 0, "write: expected: 0 actual: %u", w_avail);
}

/**
 * @}
 */
```

## src/test_pipe_contexts.c
```c
/*
 * Copyright (c) 2016 Intel Corporation
 *
 * SPDX-License-Identifier: Apache-2.0
 */

#include <zephyr/ztest.h>

#define STACK_SIZE	(1024 + CONFIG_TEST_EXTRA_STACK_SIZE)
#define PIPE_LEN	(4 * 16)
#define BYTES_TO_WRITE	16
#define BYTES_TO_READ BYTES_TO_WRITE

K_HEAP_DEFINE(mpool, PIPE_LEN * 1);

static ZTEST_DMEM unsigned char __aligned(4) data[] =
"abcd1234$%^&PIPEefgh5678!/?*EPIPijkl9012[]<>PEPImnop3456{}()IPEP";
BUILD_ASSERT(sizeof(data) >= PIPE_LEN);

/**TESTPOINT: init via K_PIPE_DEFINE*/
K_PIPE_DEFINE(kpipe, PIPE_LEN, 4);
K_PIPE_DEFINE(khalfpipe, (PIPE_LEN / 2), 4);
K_PIPE_DEFINE(kpipe1, PIPE_LEN, 4);
K_PIPE_DEFINE(pipe_test_alloc, PIPE_LEN, 4);
K_PIPE_DEFINE(ksmallpipe, 10, 2);
struct k_pipe pipe, pipe1;

K_THREAD_STACK_DEFINE(tstack, STACK_SIZE);
K_THREAD_STACK_DEFINE(tstack1, STACK_SIZE);
K_THREAD_STACK_DEFINE(tstack2, STACK_SIZE);
struct k_thread tdata;
struct k_thread tdata1;
struct k_thread tdata2;
K_SEM_DEFINE(end_sema, 0, 1);

#ifdef CONFIG_64BIT
#define SZ 256
#else
#define SZ 128
#endif
K_HEAP_DEFINE(test_pool, SZ * 4);

struct mem_block {
	void *data;
};

static void tpipe_put(struct k_pipe *ppipe, k_timeout_t timeout)
{
	size_t to_wt, wt_byte = 0;

	for (int i = 0; i < PIPE_LEN; i += wt_byte) {
		/**TESTPOINT: pipe put*/
		to_wt = (PIPE_LEN - i) >= BYTES_TO_WRITE ?
			BYTES_TO_WRITE : (PIPE_LEN - i);
		zassert_false(k_pipe_put(ppipe, &data[i], to_wt,
					 &wt_byte, 1, timeout), NULL);
		zassert_true(wt_byte == to_wt || wt_byte == 1);
	}
}

static void tpipe_get(struct k_pipe *ppipe, k_timeout_t timeout)
{
	unsigned char rx_data[PIPE_LEN];
	size_t to_rd, rd_byte = 0;

	/*get pipe data from "pipe_put"*/
	for (int i = 0; i < PIPE_LEN; i += rd_byte) {
		/**TESTPOINT: pipe get*/
		to_rd = (PIPE_LEN - i) >= BYTES_TO_READ ?
			BYTES_TO_READ : (PIPE_LEN - i);
		zassert_false(k_pipe_get(ppipe, &rx_data[i], to_rd,
					 &rd_byte, 1, timeout), NULL);
		zassert_true(rd_byte == to_rd || rd_byte == 1);
	}
	for (int i = 0; i < PIPE_LEN; i++) {
		zassert_equal(rx_data[i], data[i]);
	}
}

static void tThread_entry(void *p1, void *p2, void *p3)
{
	tpipe_get((struct k_pipe *)p1, K_FOREVER);
	k_sem_give(&end_sema);

	tpipe_put((struct k_pipe *)p1, K_NO_WAIT);
	k_sem_give(&end_sema);
}

static void tpipe_thread_thread(struct k_pipe *ppipe)
{
	/**TESTPOINT: thread-thread data passing via pipe*/
	k_tid_t tid = k_thread_create(&tdata, tstack, STACK_SIZE,
				      tThread_entry, ppipe, NULL, NULL,
				      K_PRIO_PREEMPT(0),
				      K_INHERIT_PERMS | K_USER, K_NO_WAIT);

	tpipe_put(ppipe, K_NO_WAIT);
	k_sem_take(&end_sema, K_FOREVER);

	k_sem_take(&end_sema, K_FOREVER);
	tpipe_get(ppipe, K_FOREVER);

	/* clear the spawned thread avoid side effect */
	k_thread_abort(tid);
}

static void tpipe_kthread_to_kthread(struct k_pipe *ppipe)
{
	/**TESTPOINT: thread-thread data passing via pipe*/
	k_tid_t tid = k_thread_create(&tdata, tstack, STACK_SIZE,
				      tThread_entry, ppipe, NULL, NULL,
				      K_PRIO_PREEMPT(0), 0, K_NO_WAIT);

	tpipe_put(ppipe, K_NO_WAIT);
	k_sem_take(&end_sema, K_FOREVER);

	k_sem_take(&end_sema, K_FOREVER);
	tpipe_get(ppipe, K_FOREVER);

	/* clear the spawned thread avoid side effect */
	k_thread_abort(tid);
}

static void tpipe_put_no_wait(struct k_pipe *ppipe)
{
	size_t to_wt, wt_byte = 0;

	for (int i = 0; i < PIPE_LEN; i += wt_byte) {
	/**TESTPOINT: pipe put*/
		to_wt = (PIPE_LEN - i) >= BYTES_TO_WRITE ?
			BYTES_TO_WRITE : (PIPE_LEN - i);
		zassert_false(k_pipe_put(ppipe, &data[i], to_wt,
					&wt_byte, 1, K_NO_WAIT), NULL);
		zassert_true(wt_byte == to_wt || wt_byte == 1);
	}
}

static void tpipe_put_small_size(struct k_pipe *ppipe, k_timeout_t timeout)
{
	size_t to_wt, wt_byte = 0;

	for (int i = 0; i < PIPE_LEN; i += wt_byte) {
		/**TESTPOINT: pipe put*/
		to_wt = 15;
		zassert_false(k_pipe_put(ppipe, &data[i], to_wt, &wt_byte,
		1, timeout) != 0, NULL);

	}
}

static void tpipe_get_small_size(struct k_pipe *ppipe, k_timeout_t timeout)
{
	unsigned char rx_data[PIPE_LEN];
	size_t to_rd, rd_byte = 0;

	/*get pipe data from "pipe_put"*/
	for (int i = 0; i < PIPE_LEN; i += rd_byte) {
		/**TESTPOINT: pipe get*/
		to_rd = 15;
		zassert_false(k_pipe_get(ppipe, &rx_data[i], to_rd,
					 &rd_byte, 1, timeout), NULL);
	}
}


static void tpipe_get_large_size(struct k_pipe *ppipe, k_timeout_t timeout)
{
	unsigned char rx_data[PIPE_LEN];
	size_t to_rd, rd_byte = 0;

	/*get pipe data from "pipe_put"*/
	for (int i = 0; i < PIPE_LEN; i += rd_byte) {
		/**TESTPOINT: pipe get*/
		to_rd = (PIPE_LEN - i) >= 128 ?
			128 : (PIPE_LEN - i);
		zassert_false(k_pipe_get(ppipe, &rx_data[i], to_rd,
					 &rd_byte, 1, timeout), NULL);
	}
}


/**
 * @brief Test Initialization and buffer allocation of pipe,
 * with various parameters
 * @see k_pipe_alloc_init(), k_pipe_cleanup()
 */
ZTEST(pipe_api_1cpu, test_pipe_alloc)
{
	int ret;

	zassert_false(k_pipe_alloc_init(&pipe_test_alloc, PIPE_LEN));

	tpipe_kthread_to_kthread(&pipe_test_alloc);
	k_pipe_cleanup(&pipe_test_alloc);

	zassert_false(k_pipe_alloc_init(&pipe_test_alloc, 0));
	k_pipe_cleanup(&pipe_test_alloc);

	ret = k_pipe_alloc_init(&pipe_test_alloc, 2048);
	zassert_true(ret == -ENOMEM,
		"resource pool max block size is not smaller then requested buffer");
}

static void thread_for_get_forever(void *p1, void *p2, void *p3)
{
	tpipe_get((struct k_pipe *)p1, K_FOREVER);
}

ZTEST(pipe_api, test_pipe_cleanup)
{
	int ret;

	zassert_false(k_pipe_alloc_init(&pipe_test_alloc, PIPE_LEN));

	/**TESTPOINT: test if a dynamically allocated buffer can be freed*/
	ret = k_pipe_cleanup(&pipe_test_alloc);
	zassert_true((ret == 0) && (pipe_test_alloc.buffer == NULL),
			"Failed to free buffer with k_pipe_cleanup().");

	/**TESTPOINT: nothing to do with k_pipe_cleanup() for static buffer in pipe*/
	ret = k_pipe_cleanup(&kpipe);
	zassert_true((ret == 0) && (kpipe.buffer != NULL),
			"Static buffer should not be freed.");

	zassert_false(k_pipe_alloc_init(&pipe_test_alloc, PIPE_LEN));

	k_tid_t tid = k_thread_create(&tdata, tstack, STACK_SIZE,
			thread_for_get_forever, &pipe_test_alloc, NULL,
			NULL, K_PRIO_PREEMPT(0), 0, K_NO_WAIT);
	k_sleep(K_MSEC(100));

	ret = k_pipe_cleanup(&pipe_test_alloc);
	zassert_true(ret == -EAGAIN, "k_pipe_cleanup() should not return with 0.");
	k_thread_abort(tid);
}

static void thread_handler(void *p1, void *p2, void *p3)
{
	tpipe_put_no_wait((struct k_pipe *)p1);
	k_sem_give(&end_sema);
}

/**
 * @addtogroup kernel_pipe_tests
 * @{
 */

/**
 * @brief Test pipe data passing between threads
 *
 * @ingroup kernel_pipe_tests
 *
 * @details
 * Test Objective:
 * - Verify data passing with "pipe put/get" APIs between
 * threads
 *
 * Testing techniques:
 * - function and block box testing,Interface testing,
 * Dynamic analysis and testing.
 *
 * Prerequisite Conditions:
 * - CONFIG_TEST_USERSPACE.
 *
 * Input Specifications:
 * - N/A
 *
 * Test Procedure:
 * -# Initialize a pipe, which is defined at run time.
 * -# Create a thread (A).
 * -# In A thread, check if it can get data, which is sent
 * by main thread via the pipe.
 * -# In A thread, send data to main thread via the pipe.
 * -# In main thread, send data to A thread  via the pipe.
 * -# In main thread, check if it can get data, which is sent
 * by A thread.
 * -# Do the same testing with a pipe, which is defined at compile
 * time
 *
 * Expected Test Result:
 * - Data can be sent/received between threads.
 *
 * Pass/Fail Criteria:
 * - Successful if check points in test procedure are all passed, otherwise failure.
 *
 * Assumptions and Constraints:
 * - N/A
 *
 * @see k_pipe_init(), k_pipe_put(), #K_PIPE_DEFINE(x)
 */

ZTEST(pipe_api_1cpu, test_pipe_thread2thread)
{
	/**TESTPOINT: test k_pipe_init pipe*/
	k_pipe_init(&pipe, data, PIPE_LEN);
	tpipe_thread_thread(&pipe);

	/**TESTPOINT: test K_PIPE_DEFINE pipe*/
	tpipe_thread_thread(&kpipe);
}

#ifdef CONFIG_USERSPACE
/**
 * @brief Test data passing using pipes between user threads
 * @see k_pipe_init(), k_pipe_put(), #K_PIPE_DEFINE(x)
 */
ZTEST_USER(pipe_api_1cpu, test_pipe_user_thread2thread)
{
	/**TESTPOINT: test k_object_alloc pipe*/
	struct k_pipe *p = k_object_alloc(K_OBJ_PIPE);

	zassert_true(p != NULL);

	/**TESTPOINT: test k_pipe_alloc_init*/
	zassert_false(k_pipe_alloc_init(p, PIPE_LEN));
	tpipe_thread_thread(p);

}
#endif

/**
 * @brief Test resource pool free
 * @see k_heap_alloc()
 */
#ifdef CONFIG_USERSPACE
ZTEST(pipe_api, test_resource_pool_auto_free)
{
	/* Pool has 2 blocks, both should succeed if kernel object and pipe
	 * buffer are auto-freed when the allocating threads exit
	 */
	zassert_true(k_heap_alloc(&test_pool, 64, K_NO_WAIT) != NULL);
	zassert_true(k_heap_alloc(&test_pool, 64, K_NO_WAIT) != NULL);
}
#endif

static void tThread_half_pipe_put(void *p1, void *p2, void *p3)
{
	tpipe_put((struct k_pipe *)p1, K_FOREVER);
}

static void tThread_half_pipe_get(void *p1, void *p2, void *p3)
{
	tpipe_get((struct k_pipe *)p1, K_FOREVER);
}

/**
 * @brief Test put/get with smaller pipe buffer
 * @see k_pipe_put(), k_pipe_get()
 */
ZTEST(pipe_api, test_half_pipe_put_get)
{
	unsigned char rx_data[PIPE_LEN];
	size_t rd_byte = 0;
	int ret;

	memset(rx_data, 0, sizeof(rx_data));

	/* TESTPOINT: min_xfer > bytes_to_read */
	ret = k_pipe_put(&kpipe, &rx_data[0], 1, &rd_byte, 24, K_NO_WAIT);
	zassert_true(ret == -EINVAL);
	ret = k_pipe_put(&kpipe, &rx_data[0], 24, NULL, 1, K_NO_WAIT);
	zassert_true(ret == -EINVAL);

	/**TESTPOINT: thread-thread data passing via pipe*/
	k_tid_t tid1 = k_thread_create(&tdata1, tstack1, STACK_SIZE,
				      tThread_half_pipe_get, &khalfpipe,
				      NULL, NULL, K_PRIO_PREEMPT(0),
				      K_INHERIT_PERMS | K_USER, K_NO_WAIT);

	k_tid_t tid2 = k_thread_create(&tdata2, tstack2, STACK_SIZE,
				      tThread_half_pipe_get, &khalfpipe,
				      NULL, NULL, K_PRIO_PREEMPT(0),
				      K_INHERIT_PERMS | K_USER, K_NO_WAIT);

	k_sleep(K_MSEC(100));
	tpipe_put_small_size(&khalfpipe, K_NO_WAIT);

	/* clear the spawned thread avoid side effect */
	k_thread_abort(tid1);
	k_thread_abort(tid2);
}

ZTEST(pipe_api, test_pipe_get_put)
{
	unsigned char rx_data[PIPE_LEN];
	size_t rd_byte = 0;
	int ret;

	/* TESTPOINT: min_xfer > bytes_to_read */
	ret = k_pipe_get(&kpipe, &rx_data[0], 1, &rd_byte, 24, K_NO_WAIT);
	zassert_true(ret == -EINVAL);
	ret = k_pipe_get(&kpipe, &rx_data[0], 24, NULL, 1, K_NO_WAIT);
	zassert_true(ret == -EINVAL);

	/**TESTPOINT: thread-thread data passing via pipe*/
	k_tid_t tid1 = k_thread_create(&tdata1, tstack1, STACK_SIZE,
				      tThread_half_pipe_put, &khalfpipe,
				      NULL, NULL, K_PRIO_PREEMPT(0),
				      K_INHERIT_PERMS | K_USER, K_NO_WAIT);

	k_tid_t tid2 = k_thread_create(&tdata2, tstack2, STACK_SIZE,
				      tThread_half_pipe_put, &khalfpipe,
				      NULL, NULL, K_PRIO_PREEMPT(0),
				      K_INHERIT_PERMS | K_USER, K_NO_WAIT);

	k_sleep(K_MSEC(100));
	tpipe_get_small_size(&khalfpipe, K_NO_WAIT);

	/* clear the spawned thread avoid side effect */
	k_thread_abort(tid1);
	k_thread_abort(tid2);
}

ZTEST(pipe_api, test_pipe_get_large)
{
	/**TESTPOINT: thread-thread data passing via pipe*/
	k_tid_t tid1 = k_thread_create(&tdata1, tstack1, STACK_SIZE,
				      tThread_half_pipe_put, &khalfpipe,
				      NULL, NULL, K_PRIO_PREEMPT(0),
				      K_INHERIT_PERMS | K_USER, K_NO_WAIT);

	k_tid_t tid2 = k_thread_create(&tdata2, tstack2, STACK_SIZE,
				      tThread_half_pipe_put, &khalfpipe,
				      NULL, NULL, K_PRIO_PREEMPT(0),
				      K_INHERIT_PERMS | K_USER, K_NO_WAIT);

	k_sleep(K_MSEC(100));
	tpipe_get_large_size(&khalfpipe, K_NO_WAIT);

	/* clear the spawned thread avoid side effect */
	k_thread_abort(tid1);
	k_thread_abort(tid2);
}


/**
 * @brief Test pending reader in pipe
 * @see k_pipe_put(), k_pipe_get()
 */
ZTEST(pipe_api, test_pipe_reader_wait)
{
	k_tid_t tid = k_thread_create(&tdata, tstack, STACK_SIZE,
					thread_handler, &kpipe1, NULL, NULL,
					K_PRIO_PREEMPT(0), 0, K_NO_WAIT);

	tpipe_get(&kpipe1, K_FOREVER);
	k_sem_take(&end_sema, K_FOREVER);
	k_thread_abort(tid);
}

/**
 * @}
 */
```

## src/test_pipe_fail.c
```c
/*
 * Copyright (c) 2016 Intel Corporation
 *
 * SPDX-License-Identifier: Apache-2.0
 */


#include <zephyr/ztest.h>
#include <zephyr/ztest_error_hook.h>

#define TIMEOUT K_MSEC(100)
#define PIPE_LEN 8

static ZTEST_DMEM unsigned char __aligned(4) data[] = "abcd1234";
struct k_pipe put_get_pipe;

static void put_fail(struct k_pipe *p)
{
	size_t wt_byte = 0;

	zassert_false(k_pipe_put(p, data, PIPE_LEN, &wt_byte,
				 1, K_FOREVER), NULL);
	/**TESTPOINT: pipe put returns -EIO*/
	zassert_equal(k_pipe_put(p, data, PIPE_LEN, &wt_byte,
				 1, K_NO_WAIT), -EIO, NULL);
	zassert_false(wt_byte);
	/**TESTPOINT: pipe put returns -EAGAIN*/
	zassert_equal(k_pipe_put(p, data, PIPE_LEN, &wt_byte,
				 1, TIMEOUT), -EAGAIN, NULL);
	zassert_true(wt_byte < 1);
	zassert_equal(k_pipe_put(p, data, PIPE_LEN, &wt_byte,
				 PIPE_LEN + 1, TIMEOUT), -EINVAL, NULL);

}

/**
 * @brief Test pipe put failure scenario
 * @ingroup kernel_pipe_tests
 * @see k_pipe_init(), k_pipe_put()
 */
ZTEST(pipe_api_1cpu, test_pipe_put_fail)
{
	k_pipe_init(&put_get_pipe, data, PIPE_LEN);

	put_fail(&put_get_pipe);
}
/**
 * @brief Test pipe put by a user thread
 * @ingroup kernel_pipe_tests
 * @see k_pipe_put()
 */
#ifdef CONFIG_USERSPACE
ZTEST_USER(pipe_api_1cpu, test_pipe_user_put_fail)
{
	struct k_pipe *p = k_object_alloc(K_OBJ_PIPE);

	zassert_true(p != NULL);
	zassert_false(k_pipe_alloc_init(p, PIPE_LEN));
	/* check the number of bytes that may be read from pipe. */
	zassert_equal(k_pipe_read_avail(p), 0);
	/* check the number of bytes that may be written to pipe.*/
	zassert_equal(k_pipe_write_avail(p), PIPE_LEN);

	put_fail(p);
}
#endif

static void get_fail(struct k_pipe *p)
{
	unsigned char rx_data[PIPE_LEN];
	size_t rd_byte = 0;

	/**TESTPOINT: pipe put returns -EIO*/
	zassert_equal(k_pipe_get(p, rx_data, PIPE_LEN, &rd_byte, 1,
				 K_NO_WAIT), -EIO, NULL);
	zassert_false(rd_byte);
	/**TESTPOINT: pipe put returns -EAGAIN*/
	zassert_equal(k_pipe_get(p, rx_data, PIPE_LEN, &rd_byte, 1,
				 TIMEOUT), -EAGAIN, NULL);
	zassert_true(rd_byte < 1);
	zassert_equal(k_pipe_get(p, rx_data, PIPE_LEN, &rd_byte, 1,
				 TIMEOUT), -EAGAIN, NULL);
}

/**
 * @brief Test pipe get failure scenario
 * @ingroup kernel_pipe_tests
 * @see k_pipe_init(), k_pipe_get()
 */
ZTEST(pipe_api, test_pipe_get_fail)
{
	k_pipe_init(&put_get_pipe, data, PIPE_LEN);

	get_fail(&put_get_pipe);
}

#ifdef CONFIG_USERSPACE
static unsigned char user_unreach[PIPE_LEN];
static size_t unreach_byte;

/**
 * @brief Test pipe get by a user thread
 * @ingroup kernel_pipe_tests
 * @see k_pipe_alloc_init()
 */
ZTEST_USER(pipe_api, test_pipe_user_get_fail)
{
	struct k_pipe *p = k_object_alloc(K_OBJ_PIPE);

	zassert_true(p != NULL);
	zassert_false(k_pipe_alloc_init(p, PIPE_LEN));

	get_fail(p);
}

/**
 * @brief Test k_pipe_alloc_init() failure scenario
 *
 * @details See what will happen if an uninitialized
 * k_pipe is passed to k_pipe_alloc_init().
 *
 * @ingroup kernel_pipe_tests
 *
 * @see k_pipe_alloc_init()
 */
ZTEST_USER(pipe_api, test_pipe_alloc_not_init)
{
	struct k_pipe pipe;

	ztest_set_fault_valid(true);
	k_pipe_alloc_init(&pipe, PIPE_LEN);
}

/**
 * @brief Test k_pipe_get() failure scenario
 *
 * @details See what will happen if an uninitialized
 * k_pipe is passed to k_pipe_get().
 *
 * @ingroup kernel_pipe_tests
 *
 * @see k_pipe_get()
 */
ZTEST_USER(pipe_api, test_pipe_get_null)
{
	unsigned char rx_data[PIPE_LEN];
	size_t rd_byte = 0;

	ztest_set_fault_valid(true);
	k_pipe_get(NULL, rx_data, PIPE_LEN,
	&rd_byte, 1, TIMEOUT);
}

/**
 * @brief Test k_pipe_get() failure scenario
 *
 * @details See what will happen if the parameter
 * address is accessed deny to test k_pipe_get
 *
 * @ingroup kernel_pipe_tests
 *
 * @see k_pipe_get()
 */
ZTEST_USER(pipe_api, test_pipe_get_unreach_data)
{
	struct k_pipe *p = k_object_alloc(K_OBJ_PIPE);
	size_t rd_byte = 0;

	zassert_true(p != NULL);
	zassert_false(k_pipe_alloc_init(p, PIPE_LEN));

	ztest_set_fault_valid(true);
	k_pipe_get(p, user_unreach, PIPE_LEN,
	&rd_byte, 1, TIMEOUT);

}

/**
 * @brief Test k_pipe_get() failure scenario
 *
 * @details See what will happen if the parameter
 * address is accessed deny to test k_pipe_get
 *
 * @ingroup kernel_pipe_tests
 *
 * @see k_pipe_get()
 */
ZTEST_USER(pipe_api, test_pipe_get_unreach_size)
{
	struct k_pipe *p = k_object_alloc(K_OBJ_PIPE);
	unsigned char rx_data[PIPE_LEN];

	zassert_true(p != NULL);
	zassert_false(k_pipe_alloc_init(p, PIPE_LEN));

	ztest_set_fault_valid(true);
	k_pipe_get(p, rx_data, PIPE_LEN,
	&unreach_byte, 1, TIMEOUT);

}

/**
 * @brief Test k_pipe_put() failure scenario
 *
 * @details See what will happen if a null pointer
 * is passed into the k_pipe_put as a parameter
 *
 * @ingroup kernel_pipe_tests
 *
 * @see k_pipe_put()
 */
ZTEST_USER(pipe_api, test_pipe_put_null)
{
	unsigned char tx_data = 0xa;
	size_t to_wt = 0, wt_byte = 0;

	ztest_set_fault_valid(true);
	k_pipe_put(NULL, &tx_data, to_wt,
		&wt_byte, 1, TIMEOUT);
}

/**
 * @brief Test k_pipe_put() failure scenario
 *
 * @details See what will happen if the parameter
 * address is accessed deny to test k_pipe_put
 *
 * @ingroup kernel_pipe_tests
 *
 * @see k_pipe_put()
 */
ZTEST_USER(pipe_api, test_pipe_put_unreach_data)
{
	struct k_pipe *p = k_object_alloc(K_OBJ_PIPE);
	size_t to_wt = 0, wt_byte = 0;

	zassert_true(p != NULL);
	zassert_false(k_pipe_alloc_init(p, PIPE_LEN));

	ztest_set_fault_valid(true);
	k_pipe_put(p, &user_unreach[0], to_wt,
		&wt_byte, 1, TIMEOUT);

}

/**
 * @brief Test k_pipe_put() failure scenario
 *
 * @details See what will happen if the parameter
 * address is accessed deny to test k_pipe_put
 *
 * @ingroup kernel_pipe_tests
 *
 * @see k_pipe_put()
 */
ZTEST_USER(pipe_api, test_pipe_put_unreach_size)
{
	struct k_pipe *p = k_object_alloc(K_OBJ_PIPE);
	unsigned char tx_data = 0xa;
	size_t to_wt = 0;

	zassert_true(p != NULL);
	zassert_false(k_pipe_alloc_init(p, PIPE_LEN));

	ztest_set_fault_valid(true);
	k_pipe_put(p, &tx_data, to_wt,
		&unreach_byte, 1, TIMEOUT);
}

/**
 * @brief Test k_pipe_read_avail() failure scenario
 *
 * @details See what will happen if a null pointer
 * is passed into the k_pipe_read_avail as a parameter
 *
 * @ingroup kernel_pipe_tests
 *
 * @see k_pipe_read_avail()
 */
ZTEST_USER(pipe_api, test_pipe_read_avail_null)
{
	ztest_set_fault_valid(true);
	k_pipe_read_avail(NULL);
}

/**
 * @brief Test k_pipe_write_avail() failure scenario
 *
 * @details See what will happen if a null pointer
 * is passed into the k_pipe_write_avail as a parameter
 *
 * @ingroup kernel_pipe_tests
 *
 * @see k_pipe_write_avail()
 */
ZTEST_USER(pipe_api, test_pipe_write_avail_null)
{
	ztest_set_fault_valid(true);
	k_pipe_write_avail(NULL);
}
#endif
```
