## CMakeLists.txt
```
# SPDX-License-Identifier: Apache-2.0

cmake_minimum_required(VERSION 3.20.0)
find_package(Zephyr REQUIRED HINTS $ENV{ZEPHYR_BASE})
project(userspace)

FILE(GLOB app_sources src/*.c)
target_sources(app PRIVATE ${app_sources})
```

## prj.conf
```kconfig
CONFIG_STACK_CANARIES=n
CONFIG_ZTEST=y
CONFIG_INIT_STACKS=y
CONFIG_APPLICATION_DEFINED_SYSCALL=y
CONFIG_TEST_USERSPACE=y
CONFIG_PIPES=y
```

## boards/mimxrt685_evk_mimxrt685s_cm33.overlay
```dts
/*
 * Copyright 2023 NXP
 *
 * SPDX-License-Identifier: Apache-2.0
 */

/*
 * Disable USB SRAM node because this test does not
 * need USB but needs an extra MPU region which
 * otherwise would be taken up for the SRAM1 USB region.
 */
&sram1 {
	status = "disabled";
};
```

## boards/nucleo_f756zg.overlay
```dts
/*
 * Copyright 2024 STMicroelectronics
 *
 * SPDX-License-Identifier: Apache-2.0
 */

/*
 * Disable quadspi MPU region for testing
 * on this stm32f7 target.
 * Otherwise one region will be missing from the 8 MPU regions
 */

/delete-node/ &quadspi_memory;
```

## src/test_syscall.h
```c
/*
 * Copyright (c) 2019 Intel Corporation
 *
 * SPDX-License-Identifier: Apache-2.0
 */

#ifndef USERSPACE_TEST_SYSCALL_H
#define USERSPACE_TEST_SYSCALL_H

__syscall void missing_syscall(void);
__syscall void check_syscall_context(void);

#include <zephyr/syscalls/test_syscall.h>

#endif
```
