## CMakeLists.txt
```
# SPDX-License-Identifier: Apache-2.0

cmake_minimum_required(VERSION 3.20.0)

project(lib_acpi)
find_package(Zephyr COMPONENTS unittest REQUIRED HINTS $ENV{ZEPHYR_BASE})

# Assert library
add_library(mock_assert STATIC src/assert.c)
target_link_libraries(mock_assert PRIVATE test_interface)
target_compile_options(test_interface INTERFACE -include ztest.h)

target_include_directories(testbinary PRIVATE
  ${ZEPHYR_BASE}/../modules/lib
  ${ZEPHYR_BASE}/../modules/lib/acpica/source/include
  ${ZEPHYR_BASE}/../modules/lib/acpica/source/tools/acpiexec
  )

target_sources(testbinary PRIVATE
  src/main.c
  src/mock.c
  )

target_link_libraries(testbinary PRIVATE mock_assert)
```

## prj.conf
```kconfig
CONFIG_ZTEST=y
CONFIG_ASSERT=y
```

## src/main.c
```c
/*
 * Copyright (c) 2023 Intel Corporation
 *
 * SPDX-License-Identifier: Apache-2.0
 */

#include <zephyr/ztest.h>
#include <string.h>
#include <inttypes.h>

#include "mock.h"

#include <zephyr/acpi/acpi.h>
#include <lib/acpi/acpi.c>
#include "assert.h"

#include <zephyr/fff.h>
DEFINE_FFF_GLOBALS;

struct DMAR {
	ACPI_TABLE_DMAR header;

	/* Hardware Unit 0 */
	struct {
		ACPI_DMAR_HARDWARE_UNIT header;

		struct {
			ACPI_DMAR_DEVICE_SCOPE header;
			ACPI_DMAR_PCI_PATH path0;
		} ds0;

		struct {
			ACPI_DMAR_DEVICE_SCOPE header;
			ACPI_DMAR_PCI_PATH path0;
		} ds1;
	} unit0;

	/* Hardware Unit 1 */
	struct {
		ACPI_DMAR_HARDWARE_UNIT header;

		struct {
			ACPI_DMAR_DEVICE_SCOPE header;
			ACPI_DMAR_PCI_PATH path0;
		} ds0;

		struct {
			ACPI_DMAR_DEVICE_SCOPE header;
			ACPI_DMAR_PCI_PATH path0;
		} ds1;
	} unit1;
};

static struct DMAR dmar0;

static void dmar_initialize(struct DMAR *dmar)
{
	dmar->header.Header.Length = sizeof(struct DMAR);

	dmar->unit0.header.Header.Length = sizeof(dmar->unit0);
	dmar->unit0.ds0.header.Length = sizeof(dmar->unit0.ds0);
	dmar->unit0.ds1.header.Length = sizeof(dmar->unit0.ds1);

	dmar->unit1.header.Header.Length = sizeof(dmar->unit1);
	dmar->unit1.ds0.header.Length = sizeof(dmar->unit1.ds0);
	dmar->unit1.ds1.header.Length = sizeof(dmar->unit1.ds1);
}

ZTEST(lib_acpi, test_nop)
{
}

static void count_subtables(ACPI_DMAR_HEADER *subtable, void *arg)
{
	uint8_t *count = arg;

	(*count)++;
}

FAKE_VOID_FUNC(subtable_nop, ACPI_DMAR_HEADER *, void *);

ZTEST(lib_acpi, test_dmar_foreach_subtable)
{
	uint8_t count = 0;

	dmar_initialize(&dmar0);

	acpi_dmar_foreach_subtable((void *)&dmar0, count_subtables, &count);
	zassert_equal(count, 2);

	TC_PRINT("Counted %u hardware units\n", count);
}

ZTEST(lib_acpi, test_dmar_foreach_subtable_invalid_unit_size_zero)
{
	ACPI_DMAR_HARDWARE_UNIT *hu = &dmar0.unit1.header;

	dmar_initialize(&dmar0);

	/* Set invalid hardware unit size */
	hu->Header.Length = 0;

	expect_assert();

	/* Expect assert, use fake void function as a callback */
	acpi_dmar_foreach_subtable((void *)&dmar0, subtable_nop, NULL);

	zassert_unreachable("Missed assert catch");
}

ZTEST(lib_acpi, test_dmar_foreach_subtable_invalid_unit_size_big)
{
	ACPI_DMAR_HARDWARE_UNIT *hu = &dmar0.unit1.header;

	dmar_initialize(&dmar0);

	/* Set invalid hardware unit size */
	hu->Header.Length = sizeof(dmar0.unit1) + 1;

	expect_assert();

	/* Expect assert, use fake void function as a callback */
	acpi_dmar_foreach_subtable((void *)&dmar0, subtable_nop, NULL);

	zassert_unreachable("Missed assert catch");
}

static void count_devscopes(ACPI_DMAR_DEVICE_SCOPE *devscope, void *arg)
{
	uint8_t *count = arg;

	(*count)++;
}

FAKE_VOID_FUNC(devscope_nop, ACPI_DMAR_DEVICE_SCOPE *, void *);

ZTEST(lib_acpi, test_dmar_foreach_devscope)
{
	ACPI_DMAR_HARDWARE_UNIT *hu = &dmar0.unit0.header;
	uint8_t count = 0;

	dmar_initialize(&dmar0);

	acpi_dmar_foreach_devscope(hu, count_devscopes, &count);
	zassert_equal(count, 2);

	TC_PRINT("Counted %u device scopes\n", count);
}

ZTEST(lib_acpi, test_dmar_foreach_devscope_invalid_unit_size)
{
	ACPI_DMAR_HARDWARE_UNIT *hu = &dmar0.unit0.header;

	dmar_initialize(&dmar0);

	/* Set invalid hardware unit size */
	hu->Header.Length = 0;

	expect_assert();

	/* Expect assert, use fake void function as a callback */
	acpi_dmar_foreach_devscope(hu, devscope_nop, NULL);

	zassert_unreachable("Missed assert catch");
}

ZTEST(lib_acpi, test_dmar_foreach_devscope_invalid_devscope_size_zero)
{
	ACPI_DMAR_HARDWARE_UNIT *hu = &dmar0.unit0.header;
	ACPI_DMAR_DEVICE_SCOPE *devscope = &dmar0.unit0.ds0.header;

	dmar_initialize(&dmar0);

	/* Set invalid device scope size */
	devscope->Length = 0;

	expect_assert();

	/* Expect assert, use fake void function as a callback */
	acpi_dmar_foreach_devscope(hu, devscope_nop, NULL);

	zassert_unreachable("Missed assert catch");
}

ZTEST(lib_acpi, test_dmar_foreach_devscope_invalid_devscope_size_big)
{
	ACPI_DMAR_HARDWARE_UNIT *hu = &dmar0.unit1.header;
	ACPI_DMAR_DEVICE_SCOPE *devscope = &dmar0.unit1.ds1.header;

	dmar_initialize(&dmar0);

	/* Set invalid device scope size */
	devscope->Length = sizeof(dmar0.unit1.ds1) + 1;

	expect_assert();

	/* Expect assert, use fake void function as a callback */
	acpi_dmar_foreach_devscope(hu, devscope_nop, NULL);

	zassert_unreachable("Missed assert catch");
}

/**
 * Redefine AcpiGetTable to provide our static table
 */
DECLARE_FAKE_VALUE_FUNC(ACPI_STATUS, AcpiGetTable, char *, UINT32,
			struct acpi_table_header **);
static ACPI_STATUS dmar_custom_get_table(char *Signature, UINT32 Instance,
				  ACPI_TABLE_HEADER **OutTable)
{
	*OutTable = (ACPI_TABLE_HEADER *)&dmar0;

	return AE_OK;
}

ZTEST(lib_acpi, test_dmar_ioapic_get)
{
	union acpi_dmar_id fake_path = {
		.bits.bus = 0xab,
		.bits.device = 0xc,
		.bits.function = 0b101,
	};
	uint16_t ioapic;
	int ret;

	dmar_initialize(&dmar0);

	/* Set IOAPIC device scope */
	dmar0.unit1.ds1.header.EntryType = ACPI_DMAR_SCOPE_TYPE_IOAPIC;

	/* Set some arbitrary Bus and PCI path */
	dmar0.unit1.ds1.header.Bus = fake_path.bits.bus;
	dmar0.unit1.ds1.path0.Device = fake_path.bits.device;
	dmar0.unit1.ds1.path0.Function = fake_path.bits.function;

	/* Return our dmar0 table */
	AcpiGetTable_fake.custom_fake = dmar_custom_get_table;

	zassert_equal(AcpiGetTable_fake.call_count, 0);

	ret = acpi_dmar_ioapic_get(&ioapic);
	zassert_ok(ret, "Failed getting ioapic");

	/* Verify AcpiGetTable called */
	zassert_equal(AcpiGetTable_fake.call_count, 1);

	zassert_equal(ioapic, fake_path.raw, "Got wrong ioapic");

	TC_PRINT("Found ioapic id 0x%x\n", ioapic);
}

static void test_before(void *data)
{
	ASSERT_FFF_FAKES_LIST(RESET_FAKE);
}

ZTEST_SUITE(lib_acpi, NULL, NULL, test_before, NULL, NULL);
```

## src/assert.c
```c
/*
 * Copyright (c) 2022 Nordic Semiconductor ASA
 *
 * SPDX-License-Identifier: Apache-2.0
 */

#include "assert.h"

DEFINE_FAKE_VALUE_FUNC(bool, mock_check_if_assert_expected);

void assert_print(const char *fmt, ...)
{
	va_list ap;

	va_start(ap, fmt);
	vprintk(fmt, ap);
	va_end(ap);
}

void assert_post_action(const char *file, unsigned int line)
{
	/* ztest_test_pass()/ztest_test_fail() are used to stop the execution
	 * If this is an unexpected assert (i.e. not following expect_assert())
	 * calling mock_check_if_assert_expected() will return 'false' as
	 * a default return value
	 */
	if (mock_check_if_assert_expected() == true) {
		printk("Assertion expected as part of a test case.\n");
		/* Mark the test as passed and stop execution:
		 * Needed in the passing scenario to prevent undefined behavior after hitting the
		 * assert. In real builds (non-UT), the system will be halted by the assert.
		 */
		ztest_test_pass();
	} else {
		/* Mark the test as failed and stop execution */
		ztest_test_fail();
	}
}
```

## src/assert.h
```c
/*
 * Copyright (c) 2022 Nordic Semiconductor ASA
 *
 * SPDX-License-Identifier: Apache-2.0
 */

#include <zephyr/fff.h>
#include <stdint.h>
#include <stdbool.h>

#include <zephyr/kernel.h>

/* List of fakes used by this unit tester */
#define ASSERT_FFF_FAKES_LIST(FAKE)                                             \
	FAKE(mock_check_if_assert_expected)                                     \

DECLARE_FAKE_VALUE_FUNC(bool, mock_check_if_assert_expected);

#define expect_assert()     (mock_check_if_assert_expected_fake.return_val = 1)
```

## src/mock.c
```c
/*
 * Copyright (c) 2023 Intel Corporation
 *
 * SPDX-License-Identifier: Apache-2.0
 */

#include "mock.h"

#include <zephyr/acpi/acpi.h>
#include <acpi.h>
#include <accommon.h>

#include <zephyr/fff.h>

FAKE_VOID_FUNC_VARARG(AcpiInfo, const char *, ...);

FAKE_VALUE_FUNC(ACPI_STATUS, AcpiInstallNotifyHandler, ACPI_HANDLE,
		UINT32, ACPI_NOTIFY_HANDLER, void *);

FAKE_VOID_FUNC_VARARG(AcpiException, const char	*, UINT32, ACPI_STATUS,
		      const char *, ...);

FAKE_VALUE_FUNC(ACPI_STATUS, AcpiInitializeSubsystem);

FAKE_VALUE_FUNC(ACPI_STATUS, AcpiInitializeTables, ACPI_TABLE_DESC *, UINT32,
		BOOLEAN);
FAKE_VALUE_FUNC(ACPI_STATUS, AcpiEnableSubsystem, UINT32);

FAKE_VALUE_FUNC(ACPI_STATUS, AcpiInitializeObjects, UINT32);

FAKE_VALUE_FUNC(ACPI_STATUS, AcpiLoadTables);

FAKE_VALUE_FUNC(ACPI_STATUS, AcpiNsInternalizeName, const char *, char **);

FAKE_VALUE_FUNC(ACPI_STATUS, AcpiNsLookup, ACPI_GENERIC_STATE *, char *,
		ACPI_OBJECT_TYPE, ACPI_INTERPRETER_MODE, UINT32,
		ACPI_WALK_STATE *, struct acpi_namespace_node **);

FAKE_VOID_FUNC(AcpiOsFree, void *);

FAKE_VALUE_FUNC(ACPI_STATUS, AcpiGetHandle, ACPI_HANDLE, const char *,
		ACPI_HANDLE *);

FAKE_VALUE_FUNC(ACPI_STATUS, AcpiEvaluateObject, ACPI_HANDLE, ACPI_STRING,
		ACPI_OBJECT_LIST *, ACPI_BUFFER *);

FAKE_VALUE_FUNC(ACPI_STATUS, AcpiGetObjectInfo, ACPI_HANDLE,
		struct acpi_device_info **);

FAKE_VALUE_FUNC(char *, AcpiNsGetNormalizedPathname, ACPI_NAMESPACE_NODE *,
		BOOLEAN);

FAKE_VALUE_FUNC(ACPI_STATUS, AcpiGetCurrentResources, ACPI_HANDLE, ACPI_BUFFER *);

FAKE_VALUE_FUNC(ACPI_STATUS, AcpiWalkNamespace, ACPI_OBJECT_TYPE, ACPI_HANDLE,
		UINT32, ACPI_WALK_CALLBACK, ACPI_WALK_CALLBACK, void *, void **);

FAKE_VALUE_FUNC(ACPI_STATUS, AcpiGetPossibleResources, ACPI_HANDLE, ACPI_BUFFER *);

FAKE_VALUE_FUNC(ACPI_STATUS, AcpiGetTable, char *, UINT32,
		struct acpi_table_header **);

FAKE_VALUE_FUNC(uint32_t, arch_acpi_encode_irq_flags, uint8_t, uint8_t);
```

## src/mock.h
```c
/*
 * Copyright (c) 2023 Intel Corporation
 *
 * SPDX-License-Identifier: Apache-2.0
 */

#include <inttypes.h>

/* Exclude PCIE header */
#define ZEPHYR_INCLUDE_DRIVERS_PCIE_PCIE_H_

/* Exclude Logging macrobatic */
#define ZEPHYR_INCLUDE_LOGGING_LOG_H_
#define LOG_MODULE_REGISTER(...)
#define LOG_DBG(...)
#define LOG_ERR(...)
#define LOG_WRN(...)

#define CONFIG_ACPI_IRQ_VECTOR_MAX 32
#define CONFIG_ACPI_MMIO_ENTRIES_MAX 32

typedef uint32_t pcie_bdf_t;

#define CONFIG_ACPI_DEV_MAX 1
#define _AcpiModuleName ""
```
