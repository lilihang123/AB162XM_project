## CMakeLists.txt
```
# SPDX-License-Identifier: Apache-2.0

cmake_minimum_required(VERSION 3.20.0)
find_package(Zephyr REQUIRED HINTS $ENV{ZEPHYR_BASE})
project(uoscore)

FILE(GLOB
     app_sources
     src/*.c
     src/oscore_testvector_tests/*.c
)

target_sources(app PRIVATE ${app_sources})
target_include_directories(app PRIVATE
  src/oscore_testvector_tests
)
```

## prj.conf
```kconfig
CONFIG_ZTEST=y
CONFIG_ZTEST_STACK_SIZE=16384
CONFIG_MAIN_STACK_SIZE=4096

CONFIG_ENTROPY_GENERATOR=y
CONFIG_TEST_RANDOM_GENERATOR=y

CONFIG_ZCBOR=y
CONFIG_ZCBOR_CANONICAL=y
CONFIG_UOSCORE=y

CONFIG_MBEDTLS=y
CONFIG_MBEDTLS_ENABLE_HEAP=y
CONFIG_MBEDTLS_HEAP_SIZE=2048
CONFIG_MBEDTLS_ZEPHYR_ENTROPY=y

# PSA Crypto options

CONFIG_PSA_WANT_ALG_CCM=y
CONFIG_PSA_WANT_ALG_HMAC=y

CONFIG_PSA_WANT_KEY_TYPE_HMAC=y
CONFIG_PSA_WANT_KEY_TYPE_AES=y
CONFIG_PSA_WANT_KEY_TYPE_ECC_PUBLIC_KEY=y
CONFIG_PSA_WANT_KEY_TYPE_RSA_PUBLIC_KEY=y
```

## src/main.c
```c
/*
 * Copyright (c) 2021 Fraunhofer AISEC.
 *
 * SPDX-License-Identifier: Apache-2.0
 */

#include <zephyr/kernel.h>
#include <zephyr/ztest.h>

/* OSCORE testvector tests */
ZTEST_SUITE(oscore_tests, NULL, NULL, NULL, NULL, NULL);
```
