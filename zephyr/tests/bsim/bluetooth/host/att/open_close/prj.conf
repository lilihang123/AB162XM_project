## CMakeLists.txt
```
# SPDX-License-Identifier: Apache-2.0

cmake_minimum_required(VERSION 3.20.0)

find_package(Zephyr HINTS $ENV{ZEPHYR_BASE})
project(app)

add_subdirectory(${ZEPHYR_BASE}/tests/bluetooth/common/testlib testlib)

target_sources(app PRIVATE
  src/bs_main.c
  src/bs_sync.c
  src/main.c
)

zephyr_include_directories(
  ${BSIM_COMPONENTS_PATH}/libPhyComv1/src/
  ${BSIM_COMPONENTS_PATH}/libUtilv1/src/
)

target_link_libraries(app PRIVATE
  testlib
)
```

## prj.conf
```kconfig
CONFIG_ASSERT=y
CONFIG_BOOT_BANNER=n
CONFIG_BT_BUF_ACL_RX_SIZE=204
CONFIG_BT_CENTRAL=y
CONFIG_BT_DEVICE_NAME_DYNAMIC=y
CONFIG_BT_EATT=y
CONFIG_BT_EXT_ADV=y
CONFIG_BT_GATT_CLIENT=y
CONFIG_BT_GATT_DYNAMIC_DB=y
CONFIG_BT_L2CAP_DYNAMIC_CHANNEL=y
CONFIG_BT_L2CAP_ECRED=y
CONFIG_BT_L2CAP_TX_MTU=200
CONFIG_BT_MAX_CONN=3
CONFIG_BT_MAX_PAIRED=2
CONFIG_BT_PERIPHERAL=y
CONFIG_BT_PRIVACY=n
CONFIG_BT_SMP=y
CONFIG_BT_TESTING=y
CONFIG_BT=y
CONFIG_FLASH_MAP=y
CONFIG_FLASH=y
CONFIG_LOG_BACKEND_FORMAT_TIMESTAMP=n
CONFIG_LOG_RUNTIME_FILTERING=y
CONFIG_LOG_TAG_MAX_LEN=20
CONFIG_LOG=y

CONFIG_BT_BUF_ACL_TX_COUNT=3
```

## src/main.c
```c
/* Copyright (c) 2023 Nordic Semiconductor ASA
 * SPDX-License-Identifier: Apache-2.0
 */

#include <argparse.h>
#include <zephyr/bluetooth/gatt.h>
#include <zephyr/logging/log.h>
#include <zephyr/sys/__assert.h>
#include <zephyr/settings/settings.h>
#include <zephyr/sys/byteorder.h>
#include <zephyr/bluetooth/bluetooth.h>

#include "testlib/adv.h"
#include "testlib/att_read.h"
#include "testlib/att_write.h"
#include "bs_macro.h"
#include "bs_sync.h"
#include <testlib/conn.h>
#include "testlib/log_utils.h"
#include "testlib/scan.h"
#include "testlib/security.h"

/* This test uses system asserts to fail tests. */
BUILD_ASSERT(__ASSERT_ON);

#define CENTRAL_DEVICE_NBR    0
#define PERIPHERAL_DEVICE_NBR 1

LOG_MODULE_REGISTER(main, LOG_LEVEL_DBG);

#define UUID_1                                                                                     \
	BT_UUID_DECLARE_128(0xdb, 0x1f, 0xe2, 0x52, 0xf3, 0xc6, 0x43, 0x66, 0xb3, 0x92, 0x5d,      \
			    0xc6, 0xe7, 0xc9, 0x59, 0x9d)

#define UUID_2                                                                                     \
	BT_UUID_DECLARE_128(0x3f, 0xa4, 0x7f, 0x44, 0x2e, 0x2a, 0x43, 0x05, 0xab, 0x38, 0x07,      \
			    0x8d, 0x16, 0xbf, 0x99, 0xf1)

static ssize_t read_mtu_validation_chrc(struct bt_conn *conn, const struct bt_gatt_attr *attr,
					void *buf, uint16_t buf_len, uint16_t offset)
{

	LOG_DBG("Server side buf_len %u", buf_len);

	k_msleep(100);

	LOG_DBG("============================> trigger disconnect");
	bt_conn_disconnect(conn, BT_HCI_ERR_REMOTE_POWER_OFF);

	/* We ain't read nothin' */
	return 0;
}

static struct bt_gatt_attr attrs[] = {
	BT_GATT_PRIMARY_SERVICE(UUID_1),
	BT_GATT_CHARACTERISTIC(UUID_2, BT_GATT_CHRC_READ, BT_GATT_PERM_READ,
			       read_mtu_validation_chrc, NULL, NULL),
};

static struct bt_gatt_service svc = {
	.attrs = attrs,
	.attr_count = ARRAY_SIZE(attrs),
};

static void find_the_chrc(struct bt_conn *conn, uint16_t *chrc_value_handle)
{
	uint16_t svc_handle;
	uint16_t svc_end_handle;
	uint16_t chrc_end_handle;

	EXPECT_ZERO(bt_testlib_gatt_discover_primary(&svc_handle, &svc_end_handle, conn, UUID_1, 1,
						     0xffff));

	LOG_DBG("svc_handle: %u, svc_end_handle: %u", svc_handle, svc_end_handle);

	EXPECT_ZERO(bt_testlib_gatt_discover_characteristic(chrc_value_handle, &chrc_end_handle,
							    NULL, conn, UUID_2, (svc_handle + 1),
							    svc_end_handle));

	LOG_DBG("chrc_value_handle: %u, chrc_end_handle: %u", *chrc_value_handle, chrc_end_handle);
}

static void bs_sync_all_log(char *log_msg)
{
	/* Everyone meets here. */
	bt_testlib_bs_sync_all();

	if (get_device_nbr() == 0) {
		LOG_WRN("Sync point: %s", log_msg);
	}

	/* Everyone waits for d0 to finish logging. */
	bt_testlib_bs_sync_all();
}

static inline void bt_enable_quiet(void)
{
	bt_testlib_log_level_set("bt_hci_core", LOG_LEVEL_ERR);
	bt_testlib_log_level_set("bt_id", LOG_LEVEL_ERR);

	EXPECT_ZERO(bt_enable(NULL));

	bt_testlib_log_level_set("bt_hci_core", LOG_LEVEL_INF);
	bt_testlib_log_level_set("bt_id", LOG_LEVEL_INF);
}

#define ITERATIONS 20
#define READ_PARAMS_COUNT 20
static struct bt_gatt_read_params closet[READ_PARAMS_COUNT];

static volatile int outstanding;

static uint8_t gatt_read_cb(struct bt_conn *conn, uint8_t err,
			    struct bt_gatt_read_params *params, const void *data,
			    uint16_t length)
{
	LOG_DBG("<------------------------- read done: err %d", err);

	outstanding--;

	return 0;
}

void a_test_iteration(int i)
{
	bool central = (get_device_nbr() == CENTRAL_DEVICE_NBR);
	bool peripheral = (get_device_nbr() == PERIPHERAL_DEVICE_NBR);
	bt_addr_le_t adva;
	uint16_t chrc_value_handle = 0;
	struct bt_conn *conn = NULL;
	int err;

	LOG_DBG("############################## start iteration %d", i);

	bs_sync_all_log("Start iteration");

	if (peripheral) {
		EXPECT_ZERO(bt_set_name("peripheral"));
		EXPECT_ZERO(bt_testlib_adv_conn(&conn, BT_ID_DEFAULT, bt_get_name()));
	}

	if (central) {
		EXPECT_ZERO(bt_testlib_scan_find_name(&adva, "peripheral"));
		EXPECT_ZERO(bt_testlib_connect(&adva, &conn));

		/* Establish EATT bearers. */
		EXPECT_ZERO(bt_testlib_secure(conn, BT_SECURITY_L2));

		while (bt_eatt_count(conn) == 0) {
			k_msleep(100);
		};
	}

	bs_sync_all_log("Connected");

	/* Perform discovery. */
	if (central) {
		find_the_chrc(conn, &chrc_value_handle);
	} else {
		/* Peripheral will use handle 0.
		 *
		 * This will return a permission denied from the central's
		 * server. It doesn't matter as the only thing we want as the
		 * peripheral is to also be trying to fill the TX queue with ATT
		 * PDUs.
		 */
	}

	/* Test purpose: verify no allocated resource leaks when disconnecting
	 * abruptly with non-empty queues.
	 *
	 * Test procedure (in a nutshell):
	 * - open channels
	 * - queue up lots of ATT bufs from both sides
	 * - disconnect ACL
	 * - see if anything stalls or leaks
	 *
	 * Run this procedure more times than there are said resources.
	 */
	for (int p = 0; p < ARRAY_SIZE(closet); p++) {
		memset(&closet[p], 0, sizeof(struct bt_gatt_read_params));

		closet[p].handle_count = 1;
		closet[p].single.handle = chrc_value_handle;
		closet[p].func = gatt_read_cb;

		/* A disconnected channel (or ACL conn) can end up with
		 * gatt_read returning -ENOMEM instead of -ENOTCONN. sometimes.
		 */
		LOG_DBG("-------------------------> gatt_read %d", p);
		err = bt_gatt_read(conn, &closet[p]);
		switch (err) {
		case -ENOMEM:
		case -ENOTCONN:
			LOG_DBG("not connected");
			break;
		case 0:
			outstanding++;
			break;
		default:
			FAIL("unexpected error: %d\n", err);
			break;
		}
	}

	bt_testlib_wait_disconnected(conn);
	bt_testlib_conn_unref(&conn);

	k_msleep(1000);		/* beauty rest */
	EXPECT_ZERO(outstanding);

	LOG_DBG("ended iteration %d", i);
}

void the_test(void)
{
	bool peripheral = (get_device_nbr() == PERIPHERAL_DEVICE_NBR);

	if (peripheral) {
		EXPECT_ZERO(bt_gatt_service_register(&svc));
	}

	bt_enable_quiet();

	for (int i = 0; i < ITERATIONS; i++) {
		a_test_iteration(i);
	}

	bs_sync_all_log("Test Complete");

	PASS("Test complete\n");
}
```

## src/bs_macro.h
```c
/* Copyright (c) 2023 Nordic Semiconductor ASA
 * SPDX-License-Identifier: Apache-2.0
 */

#include <bs_tracing.h>
#include <bstests.h>

#define PASS(...)                                                                                  \
	do {                                                                                       \
		extern enum bst_result_t bst_result;                                               \
		bst_result = Passed;                                                               \
		bs_trace_info_time(1, __VA_ARGS__);                                                \
	} while (0)

static inline void bt_testlib_expect_zero(int err, char *where_file, int where_line)
{
	if (err) {
		bs_trace_print(BS_TRACE_ERROR, where_file, where_line, 0, BS_TRACE_AUTOTIME, 0,
			       "err %d\n", err);
	}
}

#define FAIL(...)                                                                                  \
	bs_trace_print(BS_TRACE_ERROR, __FILE__, __LINE__, 0, BS_TRACE_AUTOTIME, 0, __VA_ARGS__);

#define EXPECT_ZERO(expr) bt_testlib_expect_zero((expr), __FILE__, __LINE__)
```

## src/bs_sync.c
```c
/* Copyright (c) 2023 Nordic Semiconductor ASA
 * SPDX-License-Identifier: Apache-2.0
 */

#include <stdint.h>
#include <argparse.h>
#include <posix_native_task.h>
#include <bs_pc_backchannel.h>

#include <zephyr/logging/log.h>
#include <zephyr/sys/byteorder.h>
#include <bs_tracing.h>
#include <zephyr/kernel.h>
LOG_MODULE_REGISTER(bs_sync, LOG_LEVEL_INF);

static int n_devs;

static void register_more_cmd_args(void)
{
	static bs_args_struct_t args_struct_toadd[] = {
		{
			.option = "D",
			.name = "number_devices",
			.type = 'i',
			.dest = (void *)&n_devs,
			.descript = "Number of devices which will connect in this phy",
			.is_mandatory = true,
		},
		ARG_TABLE_ENDMARKER,
	};

	bs_add_extra_dynargs(args_struct_toadd);
}
NATIVE_TASK(register_more_cmd_args, PRE_BOOT_1, 100);

static uint *backchannels;
static void setup_backchannels(void)
{
	__ASSERT_NO_MSG(n_devs > 0);
	uint self = get_device_nbr();
	uint device_nbrs[n_devs];
	uint channel_numbers[n_devs];

	for (int i = 0; i < n_devs; i++) {
		device_nbrs[i] = i;
		channel_numbers[i] = 0;
	}

	backchannels =
		bs_open_back_channel(self, device_nbrs, channel_numbers, ARRAY_SIZE(device_nbrs));
	__ASSERT_NO_MSG(backchannels != NULL);
}
NATIVE_TASK(setup_backchannels, PRE_BOOT_3, 100);

void bs_bc_receive_msg_sync(uint ch, size_t size, uint8_t *data)
{
	while (bs_bc_is_msg_received(ch) < size) {
		k_msleep(1);
	}
	bs_bc_receive_msg(ch, data, size);
}

void bs_bc_send_uint(uint ch, uint64_t data)
{
	uint8_t data_bytes[sizeof(data)];

	sys_put_le64(data, data_bytes);
	bs_bc_send_msg(ch, data_bytes, sizeof(data_bytes));
}

uint64_t bs_bc_recv_uint(uint ch)
{
	uint8_t data[sizeof(uint64_t)];

	bs_bc_receive_msg_sync(ch, sizeof(data), data);
	return sys_get_le64(data);
}

void bt_testlib_bs_sync_all(void)
{
	static uint64_t counter;

	LOG_DBG("%llu d%u enter", counter, get_device_nbr());

	/* Device 0 acts as hub. */
	if (get_device_nbr() == 0) {
		for (int i = 1; i < n_devs; i++) {
			uint64_t counter_cfm;

			counter_cfm = bs_bc_recv_uint(backchannels[i]);
			__ASSERT(counter_cfm == counter, "%luu %luu", counter_cfm, counter);
		}
		for (int i = 1; i < n_devs; i++) {
			bs_bc_send_uint(backchannels[i], counter);
		}
	} else {
		uint64_t counter_cfm;

		bs_bc_send_uint(backchannels[0], counter);
		counter_cfm = bs_bc_recv_uint(backchannels[0]);
		__ASSERT(counter_cfm == counter, "%luu %luu", counter_cfm, counter);
	}

	LOG_DBG("%llu d%u exit", counter, get_device_nbr());

	counter++;
}
```
