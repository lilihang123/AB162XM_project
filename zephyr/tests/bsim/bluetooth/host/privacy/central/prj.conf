## CMakeLists.txt
```
# SPDX-License-Identifier: Apache-2.0

cmake_minimum_required(VERSION 3.20.0)

find_package(Zephyr REQUIRED HINTS $ENV{ZEPHYR_BASE})
project(bsim_test_rpa_central)

add_subdirectory(${ZEPHYR_BASE}/tests/bluetooth/common/testlib testlib)
target_link_libraries(app PRIVATE testlib)

add_subdirectory(${ZEPHYR_BASE}/tests/bsim/babblekit babblekit)
target_link_libraries(app PRIVATE babblekit)

target_sources(app PRIVATE
	src/bs_bt_utils.c
	src/tester.c
	src/main.c
	src/dut.c
)

zephyr_include_directories(
  ${BSIM_COMPONENTS_PATH}/libUtilv1/src/
  ${BSIM_COMPONENTS_PATH}/libPhyComv1/src/
  )
```

## prj.conf
```kconfig
CONFIG_BT=y
CONFIG_BT_PERIPHERAL=y
CONFIG_BT_CENTRAL=y
CONFIG_BT_SMP=y
CONFIG_ASSERT=y

CONFIG_BT_EXT_ADV=y
CONFIG_BT_PRIVACY=y
CONFIG_BT_RPA_TIMEOUT=10

CONFIG_BT_CTLR_ADV_SET=2
CONFIG_BT_CTLR_SCAN_REQ_NOTIFY=y
CONFIG_BT_SCAN_WITH_IDENTITY=y

# Enable the possibility to set the RPA such that the RPA
# refreshes before the connection attempt has completed
CONFIG_BT_RPA_TIMEOUT_DYNAMIC=y
CONFIG_BT_CREATE_CONN_TIMEOUT=10
```

## src/main.c
```c
/*
 * Copyright (c) 2023 Nordic Semiconductor ASA
 *
 * SPDX-License-Identifier: Apache-2.0
 */

#include "bs_bt_utils.h"
#include "bstests.h"

void tester_procedure(void);
void tester_procedure_periph_delayed_start_of_conn_adv(void);
void dut_procedure(void);
void dut_procedure_connect_short_rpa_timeout(void);
void dut_procedure_connect_timeout(void);

static const struct bst_test_instance test_to_add[] = {
	{
		.test_id = "central",
		.test_descr = "Central performs active scanning using RPA",
		.test_pre_init_f = test_init,
		.test_tick_f = test_tick,
		.test_main_f = dut_procedure,
	},
	{
		.test_id = "central_connect_short_rpa_timeout",
		.test_descr = "Central connects to a peripheral using a short RPA timeout",
		.test_pre_init_f = test_init,
		.test_tick_f = test_tick,
		.test_main_f = dut_procedure_connect_short_rpa_timeout,
	},
	{
		.test_id = "central_connect_fails_with_short_rpa_timeout",
		.test_descr = "Central connects to a peripheral using a short RPA timeout"
			      " but expects connection establishment to time out.",
		.test_pre_init_f = test_init,
		.test_tick_f = test_tick,
		.test_main_f = dut_procedure_connect_timeout,
	},
	{
		.test_id = "peripheral",
		.test_descr = "Performs scannable advertising, validates that the scanner"
			      " RPA address refreshes",
		.test_pre_init_f = test_init,
		.test_tick_f = test_tick,
		.test_main_f = tester_procedure,
	},
	{
		.test_id = "periph_delayed_start_of_conn_adv",
		.test_descr = "Performs connectable advertising. "
			      "The advertiser is stopped for 10 seconds when instructed by the DUT"
			      " to allow it to run the initiator for longer than its RPA timeout.",
		.test_post_init_f = test_init,
		.test_tick_f = test_tick,
		.test_main_f = tester_procedure_periph_delayed_start_of_conn_adv,
	},
	BSTEST_END_MARKER,
};

static struct bst_test_list *install(struct bst_test_list *tests)
{
	return bst_add_tests(tests, test_to_add);
};

bst_test_install_t test_installers[] = {install, NULL};

int main(void)
{
	bst_main();
	return 0;
}
```

## src/bs_bt_utils.c
```c
/*
 * Copyright (c) 2023 Nordic Semiconductor ASA
 *
 * SPDX-License-Identifier: Apache-2.0
 */

#include "bs_bt_utils.h"
#include "bs_pc_backchannel.h"
#include "argparse.h"

#define BS_SECONDS(dur_sec)    ((bs_time_t)dur_sec * 1000000)
#define TEST_TIMEOUT_SIMULATED BS_SECONDS(60)
#define CHANNEL_ID	       0
#define MSG_SIZE	       1

void test_tick(bs_time_t HW_device_time)
{
	bs_trace_debug_time(0, "Simulation ends now.\n");
	if (bst_result != Passed) {
		bst_result = Failed;
		bs_trace_error("Test did not pass before simulation ended.\n");
	}
}

void test_init(void)
{
	bst_ticker_set_next_tick_absolute(TEST_TIMEOUT_SIMULATED);
	bst_result = In_progress;
}

void backchannel_init(uint peer)
{
	uint device_number = get_device_nbr();
	uint device_numbers[] = {peer};
	uint channel_numbers[] = {CHANNEL_ID};
	uint *ch;

	ch = bs_open_back_channel(device_number, device_numbers, channel_numbers,
				  ARRAY_SIZE(channel_numbers));
	if (!ch) {
		FAIL("Unable to open backchannel\n");
	}
}

void backchannel_sync_send(void)
{
	uint8_t sync_msg[MSG_SIZE] = {get_device_nbr()};

	bs_bc_send_msg(CHANNEL_ID, sync_msg, ARRAY_SIZE(sync_msg));
}

void backchannel_sync_wait(void)
{
	uint8_t sync_msg[MSG_SIZE];

	while (true) {
		if (bs_bc_is_msg_received(CHANNEL_ID) > 0) {
			bs_bc_receive_msg(CHANNEL_ID, sync_msg, ARRAY_SIZE(sync_msg));
			if (sync_msg[0] != get_device_nbr()) {
				/* Received a message from another device, exit */
				break;
			}
		}

		k_sleep(K_MSEC(1));
	}
}

void print_address(bt_addr_le_t *addr)
{
	char array[BT_ADDR_LE_STR_LEN];

	bt_addr_le_to_str(addr, array, sizeof(array));
	printk("Address : %s\n", array);
}
```

## src/bs_bt_utils.h
```c
/**
 * Common functions and helpers for BSIM ADV tests
 *
 * Copyright (c) 2023 Nordic Semiconductor ASA
 *
 * SPDX-License-Identifier: Apache-2.0
 */

#include "bs_tracing.h"
#include "bs_types.h"
#include "bstests.h"
#include "time_machine.h"

#include <errno.h>

#include <zephyr/sys/__assert.h>
#include <zephyr/bluetooth/bluetooth.h>
#include <zephyr/bluetooth/conn.h>
#include <zephyr/bluetooth/gatt.h>
#include <zephyr/bluetooth/hci.h>
#include <zephyr/bluetooth/uuid.h>
#include <zephyr/kernel.h>
#include <zephyr/types.h>

extern enum bst_result_t bst_result;

#define DECLARE_FLAG(flag) extern atomic_t flag
#define DEFINE_FLAG(flag)  atomic_t flag = (atomic_t) false
#define SET_FLAG(flag)	   (void)atomic_set(&flag, (atomic_t) true)
#define UNSET_FLAG(flag)   (void)atomic_set(&flag, (atomic_t) false)
#define WAIT_FOR_FLAG(flag)                                                                        \
	while (!(bool)atomic_get(&flag)) {                                                         \
		(void)k_sleep(K_MSEC(1));                                                          \
	}
#define WAIT_FOR_FLAG_UNSET(flag)                                                                  \
	while ((bool)atomic_get(&flag)) {                                                          \
		(void)k_sleep(K_MSEC(1));                                                          \
	}
#define TAKE_FLAG(flag)                                                                            \
	while (!(bool)atomic_cas(&flag, true, false)) {                                            \
		(void)k_sleep(K_MSEC(1));                                                          \
	}

#define ASSERT(expr, ...)                                                                          \
	do {                                                                                       \
		if (!(expr)) {                                                                     \
			FAIL(__VA_ARGS__);                                                         \
		}                                                                                  \
	} while (0)

#define FAIL(...)                                                                                  \
	do {                                                                                       \
		bst_result = Failed;                                                               \
		bs_trace_error_time_line(__VA_ARGS__);                                             \
	} while (0)

#define PASS(...)                                                                                  \
	do {                                                                                       \
		bst_result = Passed;                                                               \
		bs_trace_info_time(1, __VA_ARGS__);                                                \
	} while (0)

#define DUT_CENTRAL_ID	     0
#define TESTER_PERIPHERAL_ID 1

void test_tick(bs_time_t HW_device_time);
void test_init(void);
void backchannel_init(uint peer);
void backchannel_sync_send(void);
void backchannel_sync_wait(void);

void print_address(bt_addr_le_t *addr);
```

## src/dut.c
```c
/*
 * Copyright (c) 2023 Nordic Semiconductor ASA
 *
 * SPDX-License-Identifier: Apache-2.0
 */

#include "bs_bt_utils.h"

#include <stdint.h>

#include <zephyr/bluetooth/addr.h>
#include <zephyr/bluetooth/conn.h>
#include <zephyr/bluetooth/bluetooth.h>

#include <babblekit/testcase.h>
#include <testlib/conn.h>
#include <testlib/scan.h>

void start_scanning(void)
{
	int err;
	struct bt_le_scan_param param;

	/* Enable bluetooth */
	err = bt_enable(NULL);
	if (err) {
		FAIL("Failed to enable bluetooth (err %d\n)", err);
	}

	/* Start active scanning */
	param.type = BT_LE_SCAN_TYPE_ACTIVE;
	param.options = BT_LE_SCAN_OPT_FILTER_DUPLICATE;
	param.interval = BT_GAP_SCAN_FAST_INTERVAL;
	param.window = BT_GAP_SCAN_FAST_WINDOW;
	param.timeout = 0;
	param.interval_coded = 0;
	param.window_coded = 0;

	err = bt_le_scan_start(&param, NULL);
	if (err) {
		FAIL("Failed to start scanning");
	}
}

void dut_procedure(void)
{
	start_scanning();

	/* Nothing to do */

	PASS("PASS\n");
}

void dut_procedure_connect_short_rpa_timeout(void)
{
	backchannel_init(1);

	const uint16_t rpa_timeout_s = 1;

	int err;
	bt_addr_le_t peer = {};
	struct bt_conn *conn = NULL;

	/* Enable bluetooth */
	err = bt_enable(NULL);
	TEST_ASSERT(!err, "Failed to enable bluetooth (err %d)");

	/* Central to use a short RPA timeout */
	err = bt_le_set_rpa_timeout(rpa_timeout_s);
	TEST_ASSERT(!err, "Failed to set RPA timeout (err %d)", err);

	err = bt_testlib_scan_find_name(&peer, CONFIG_BT_DEVICE_NAME);
	TEST_ASSERT(!err, "Failed to start scan (err %d)", err);

	/* Indicate to the peer device that we have found the advertiser. */
	backchannel_sync_send();

	/* Create a connection using that address */
	err = bt_testlib_connect(&peer, &conn);
	TEST_ASSERT(!err, "Failed to initiate connection (err %d)", err);

	PASS("PASS\n");
}

void dut_procedure_connect_timeout(void)
{
	const uint16_t rpa_timeout_s = 1;

	int err;
	bt_addr_le_t peer = {.type = BT_ADDR_LE_RANDOM, .a = {.val = {1, 2, 3, 4, 5, 6}}};
	struct bt_conn *conn = NULL;

	/* Enable bluetooth */
	err = bt_enable(NULL);
	TEST_ASSERT(!err, "Failed to enable bluetooth (err %d)", err);

	/* Central to use a short RPA timeout */
	err = bt_le_set_rpa_timeout(rpa_timeout_s);
	TEST_ASSERT(!err, "Failed to set RPA timeout (err %d)", err);

	int64_t old_time = k_uptime_get();

	/* Create a connection using that address */
	err = bt_testlib_connect(&peer, &conn);
	TEST_ASSERT(err == BT_HCI_ERR_UNKNOWN_CONN_ID,
		    "Expected connection establishment to time out (err %d)", err);

	int64_t new_time = k_uptime_get();
	int64_t time_diff_ms = new_time - old_time;
	int64_t expected_conn_timeout_ms = CONFIG_BT_CREATE_CONN_TIMEOUT * 1000;
	int64_t diff_to_expected_ms = abs(time_diff_ms - expected_conn_timeout_ms);

	printk("Connection creation timed out after %d ms\n", time_diff_ms);
	TEST_ASSERT(diff_to_expected_ms < 0.1 * expected_conn_timeout_ms,
		    "Connection timeout not within 10 \%% of expected timeout");

	PASS("PASS\n");
}
```

## src/tester.c
```c
/*
 * Copyright (c) 2023 Nordic Semiconductor ASA
 *
 * SPDX-License-Identifier: Apache-2.0
 */

#include "bs_bt_utils.h"

#include <stdint.h>
#include <string.h>

#include <zephyr/bluetooth/addr.h>
#include <zephyr/bluetooth/bluetooth.h>
#include <zephyr/bluetooth/conn.h>
#include <zephyr/toolchain.h>

#include <babblekit/testcase.h>

DEFINE_FLAG(flag_new_address);
DEFINE_FLAG(flag_connected);

void scanned_cb(struct bt_le_ext_adv *adv, struct bt_le_ext_adv_scanned_info *info)
{
	static bool init;
	static int64_t old_time;
	static bt_addr_le_t old_addr;
	bt_addr_le_t new_addr;

	if (bst_result == Passed) {
		return;
	}

	if (!init) {
		old_addr = *info->addr;
		old_time = k_uptime_get();
		init = true;
	}

	new_addr = *info->addr;

	/* Check if the scan request comes from a new address */
	if (bt_addr_le_cmp(&old_addr, &new_addr)) {
		int64_t new_time, diff, time_diff_ms, rpa_timeout_ms;

		printk("Scanned request from new ");
		print_address(info->addr);

		/* Ensure the RPA rotation occurs within +-10% of CONFIG_BT_RPA_TIMEOUT */
		new_time = k_uptime_get();
		time_diff_ms = new_time - old_time;
		rpa_timeout_ms = CONFIG_BT_RPA_TIMEOUT * MSEC_PER_SEC;

		if (time_diff_ms > rpa_timeout_ms) {
			diff = time_diff_ms - rpa_timeout_ms;
		} else {
			diff = rpa_timeout_ms - time_diff_ms;
		}

		if (diff > rpa_timeout_ms * 0.10) {
			FAIL("RPA rotation did not occur within +-10%% of CONFIG_BT_RPA_TIMEOUT");
		}
		old_time = new_time;

		SET_FLAG(flag_new_address);
	}

	old_addr = new_addr;
}

static void connected_cb(struct bt_le_ext_adv *adv, struct bt_le_ext_adv_connected_info *info)
{
	SET_FLAG(flag_connected);
}

static struct bt_le_ext_adv_cb adv_callbacks = {
	.scanned = scanned_cb,
	.connected = connected_cb
};

void start_advertising(void)
{
	int err;
	uint8_t mfg_data[] = {0xAB, 0xCD, 0xEF};
	const struct bt_data sd[] = {BT_DATA(BT_DATA_MANUFACTURER_DATA, mfg_data, 3)};
	struct bt_le_adv_param params;
	struct bt_le_ext_adv_start_param start_params;
	struct bt_le_ext_adv *adv;

	/* Enable bluetooth */
	err = bt_enable(NULL);
	if (err) {
		FAIL("Failed to enable bluetooth (err %d\n)", err);
	}

	/* Create advertising set */
	params.id = BT_ID_DEFAULT;
	params.sid = 0;
	params.secondary_max_skip = 0;
	params.options = BT_LE_ADV_OPT_EXT_ADV | BT_LE_ADV_OPT_SCANNABLE |
			 BT_LE_ADV_OPT_NOTIFY_SCAN_REQ;
	params.interval_min = BT_GAP_ADV_FAST_INT_MIN_1;
	params.interval_max = BT_GAP_ADV_FAST_INT_MAX_1;
	params.peer = NULL;

	err = bt_le_ext_adv_create(&params, &adv_callbacks, &adv);
	if (err) {
		FAIL("Failed to create advertising set (err %d)\n", err);
	}

	/* Set scan data */
	err = bt_le_ext_adv_set_data(adv, NULL, 0, sd, ARRAY_SIZE(sd));
	if (err) {
		FAIL("Failed to set advertising data (err %d)", err);
	}

	/* Start advertising */
	start_params.timeout = 0;
	start_params.num_events = 0;

	err = bt_le_ext_adv_start(adv, &start_params);
	if (err) {
		FAIL("Failed to start advertising (err %d)\n", err);
	}
}

void tester_procedure(void)
{
	start_advertising();

	for (int i = 0; i < 5; i++) {
		WAIT_FOR_FLAG(flag_new_address);
		UNSET_FLAG(flag_new_address);
	}

	PASS("PASS\n");
}

void tester_procedure_periph_delayed_start_of_conn_adv(void)
{
	backchannel_init(0);

	int err;
	struct bt_le_adv_param params =
		BT_LE_ADV_PARAM_INIT(BT_LE_ADV_OPT_CONNECTABLE | BT_LE_ADV_OPT_USE_IDENTITY,
				     BT_GAP_ADV_FAST_INT_MIN_2,
				     BT_GAP_ADV_FAST_INT_MAX_2, NULL);
	struct bt_data ad;
	struct bt_le_ext_adv *adv;

	/* Enable bluetooth */
	err = bt_enable(NULL);
	TEST_ASSERT(!err, "Failed to enable bluetooth (err %d)");

	/* Advertiser to use a long RPA timeout */
	err = bt_le_set_rpa_timeout(100);
	TEST_ASSERT(!err, "Failed to set RPA timeout (err %d)", err);

	err = bt_le_ext_adv_create(&params, &adv_callbacks, &adv);
	TEST_ASSERT(!err, "Failed to create advertising set (err %d)", err);

	ad.type = BT_DATA_NAME_COMPLETE;
	ad.data_len = strlen(CONFIG_BT_DEVICE_NAME);
	ad.data = (const uint8_t *)CONFIG_BT_DEVICE_NAME;

	err = bt_le_ext_adv_set_data(adv, &ad, 1, NULL, 0);
	TEST_ASSERT(!err, "Failed to set advertising data (err %d)", err);

	err = bt_le_ext_adv_start(adv, BT_LE_EXT_ADV_START_DEFAULT);
	TEST_ASSERT(!err, "Failed to start advertiser (err %d)", err);

	backchannel_sync_wait();

	err = bt_le_ext_adv_stop(adv);
	TEST_ASSERT(!err, "Failed to stop advertiser (err %d)", err);

	/* Wait a few RPA cycles before restaring the advertiser to force RPA timeout
	 * on the DUT.
	 */
	k_sleep(K_SECONDS(7));

	err = bt_le_ext_adv_start(adv, BT_LE_EXT_ADV_START_DEFAULT);
	TEST_ASSERT(!err, "Failed to restart advertiser (err %d)", err);

	WAIT_FOR_FLAG(flag_connected);

	PASS("PASS\n");
}
```
