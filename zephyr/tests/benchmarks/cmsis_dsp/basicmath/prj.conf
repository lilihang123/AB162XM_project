## CMakeLists.txt
```
# SPDX-License-Identifier: Apache-2.0

cmake_minimum_required(VERSION 3.20.0)
find_package(Zephyr REQUIRED HINTS $ENV{ZEPHYR_BASE})
project(cmsis_dsp_basicmath_benchmark)

FILE(GLOB app_sources src/*.c)
target_sources(app PRIVATE ${app_sources})
```

## prj.conf
```kconfig
CONFIG_ZTEST=y
CONFIG_REQUIRES_FULL_LIBC=y
CONFIG_CMSIS_DSP=y
CONFIG_CMSIS_DSP_BASICMATH=y
```

## src/f32.c
```c
/*
 * Copyright (c) 2020 Stephanos Ioannidis <root@stephanos.io>
 * Copyright (C) 2010-2020 ARM Limited or its affiliates. All rights reserved.
 *
 * SPDX-License-Identifier: Apache-2.0
 */

#include <zephyr/ztest.h>
#include <zephyr/kernel.h>
#include <stdlib.h>
#include <arm_math.h>
#include "../../common/benchmark_common.h"

#define PATTERN_LENGTH	(256)

static const uint32_t input1[256] = {
	0xbe7615dd, 0x3e0a5b1e, 0x3e9425e8, 0x3f433216,
	0x3e816b4e, 0xbe143e49, 0x3e877d60, 0xbd29de75,
	0xbebc69ec, 0x3e687466, 0xbe2e1b66, 0x3e0346d2,
	0xbe48345c, 0x3f2f2dc5, 0xbf229368, 0xbdd18caa,
	0xbae856c5, 0xbe779abe, 0xbe6e7711, 0x3caa302e,
	0x3e85375c, 0xbe15bd57, 0xbd92253b, 0xbed2cedf,
	0xbf2cbc1e, 0x3e2a4449, 0xbdd0693a, 0x3e16b249,
	0xbe256ea3, 0x3ed42777, 0x3e895be0, 0x3de3e095,
	0xbee09687, 0xbd84a2da, 0x3d966cc5, 0xbd97ea7a,
	0xbea4b437, 0xbd0cbb5d, 0x3df36637, 0xbe20fa46,
	0x3de5a59f, 0xbedc8418, 0x3ce7901e, 0x3e870ef3,
	0xbeeaed98, 0x3e69fc9d, 0x3bef5be4, 0xbe71aa2c,
	0x3dfc9df4, 0x3e14edd4, 0xbe90e704, 0x3df1ade8,
	0xbecb71a1, 0xbee60066, 0x3d8ed065, 0xbe66f074,
	0x3f1d1d4a, 0x3eb0ee33, 0x3e5b4d66, 0x3e80ac40,
	0xbea71b63, 0xbebfaf5c, 0x3eb7c5e8, 0x3c286fe6,
	0xbe4542ec, 0xbdf4c1cb, 0xbe8a2982, 0x3ebf99e4,
	0xbeb9b986, 0x3e91869e, 0x3e3126c8, 0x3e678642,
	0x3e83bfc5, 0x3e2fb9b5, 0xbe9f1f35, 0xbe412ac1,
	0x3ee470f5, 0xbf1ba9c4, 0x3e8ba6eb, 0x3daf6728,
	0x3e379687, 0x3db5db1c, 0xbe0454cc, 0x3e8ffa21,
	0xbed3eb22, 0xbd8c756b, 0xbd37f46f, 0x3f1acc52,
	0x3e6761ef, 0x3dc8f4c2, 0xbb86a0cb, 0xbed741fd,
	0x3ed334d2, 0x3e591fee, 0x3da630be, 0xbd465007,
	0xbe2e6781, 0x3e354ba2, 0x3ee78e9f, 0x3e38e1fc,
	0xbd5b45af, 0xbdc42924, 0xbe487972, 0x3d42fc8c,
	0x3d39ddea, 0xbf800000, 0x3e47bc81, 0xbe6d3ea6,
	0xbe346a5d, 0x3e4bc4aa, 0x3ece4e6a, 0x3ef730a6,
	0x3d323126, 0xbe1f69b2, 0xbf2c5298, 0x3e851dca,
	0x3dd99be4, 0x3ee352ed, 0x3e300faf, 0x3deb85b2,
	0xbef35a4d, 0xbea2e18e, 0x3e0c1422, 0x3ded684f,
	0xbd9d3a04, 0xbe748c80, 0xbd49d3fc, 0x3eae4b91,
	0xbdd13f56, 0x3ec00687, 0xbe9dd67b, 0xbee078e5,
	0xbea7ecd6, 0xbe31f0fb, 0x3c9fab4c, 0xbf5b1cab,
	0xbe3127e2, 0xbd89aa70, 0x3e7bd318, 0x3c387d43,
	0xbd84e04b, 0x3ecab9d8, 0x3edb926f, 0xbec88560,
	0xbe168183, 0x3e50ee4c, 0x3d15fc44, 0x3df7a4f6,
	0xbbeab7df, 0xbd89602e, 0xbe46f8cf, 0xbca78eee,
	0x3e95f997, 0xbeef9320, 0xbb719415, 0x3ed7afd5,
	0x3e00886c, 0xbd8e2cbe, 0x3da33a7c, 0x3da3200f,
	0xbebf7183, 0x3d365e99, 0xbe09538e, 0xbcf48bc6,
	0xbd51b1b8, 0x3d017f4c, 0x3e2b81bb, 0xbed81367,
	0xbe069cd5, 0x3e0c8740, 0xbd6860f3, 0x3dae7824,
	0x3ea05b45, 0x3ce7c1f1, 0x3ef90c86, 0x3cae676d,
	0xbeb633be, 0x3d91a2ac, 0x3d302b7f, 0x3e0439b3,
	0xbd9b621c, 0x3e988c26, 0xbdaba1d2, 0x3e3893fd,
	0x3ed57561, 0xbeaa3c3b, 0xbd0fd35d, 0xbe971a92,
	0x3f068098, 0x3e97eccf, 0x3d7fb7e7, 0x3eb0e749,
	0x3e861bd2, 0x3db8027d, 0x3e86a3ab, 0xbe9b4617,
	0xbc060bb8, 0x3c973710, 0xbc94e165, 0x3edcc8e4,
	0xbe856ffe, 0x3eae969f, 0x3dc64eb0, 0x3f0d4886,
	0xbb5951f3, 0xbd545f5a, 0x3c8020ec, 0xbec63ba0,
	0xbd226696, 0xbbf74b24, 0x3e789184, 0xbe779dfb,
	0x3e27d468, 0xbe8d34a6, 0xbe5a31aa, 0xbe9347f4,
	0x3ec9bf45, 0x3dec7be4, 0x3e8573e7, 0x3dac8f5e,
	0x3e133275, 0x3efabbd4, 0x3e144acb, 0xbf10beb2,
	0xbe8bc904, 0xbd9e491d, 0x3e83271c, 0xbf625b5d,
	0x3e918f0c, 0xbe09bf4b, 0xbe8f8404, 0xbec1dd10,
	0x3dcc691b, 0x3decd44e, 0x3e52ef40, 0x3dc53970,
	0x3e5e7918, 0xbde1a7f5, 0xbe902c3f, 0x3e185dff,
	0x3f053faf, 0x3de7951b, 0x3e431459, 0xbdfd5fd5,
	0xbf08176e, 0xbf068074, 0x3eb79e7a, 0xbd1d80ed,
	0xbe5a7559, 0x3eb3aa3f, 0xbe8db06c, 0xbd90187e,
	0xbf03caa7, 0xbd92238d, 0xbe7cdc64, 0xbe2ac8aa
	};

static const uint32_t input2[256] = {
	0x3efd7b68, 0xbf3396c6, 0x3ecf0d7f, 0xbce77d0c,
	0xbe8045d0, 0xbea8c5d4, 0x3e6a3aaa, 0xbeb9c2f5,
	0x3ce7f210, 0xbf0f4737, 0xbee71c87, 0xbdcd4ed3,
	0xbda07eb9, 0xbe22d09c, 0x3da60119, 0x3f2e0015,
	0x3cf9d138, 0x3ea7295d, 0x3e958f9e, 0x3ec76134,
	0x3caec34b, 0xbe0fc780, 0xbe34442b, 0x3ea30a9e,
	0xbd2f09ac, 0x3f0436b2, 0x3ea6974d, 0x3be04c86,
	0xbe67da27, 0x3f21e9d0, 0x3dc7b20f, 0x3f110e3f,
	0x3ee11ddc, 0x3ed16699, 0x3ecafd42, 0xbf4465ee,
	0x3e113928, 0xbea7fe43, 0xbf018159, 0xbba151c0,
	0xbd04ad55, 0xbeb940d9, 0x3d8f7268, 0xbe4b929e,
	0xbe3cb12a, 0x3edded21, 0x3ecb11e5, 0x3f24b3ab,
	0x3e5e8c42, 0xbe1606df, 0x3f0ea0db, 0xbe348348,
	0xbdea1459, 0x3e3dd968, 0x3eba6bd5, 0x3efca1b6,
	0x3e19c20c, 0x3ee2fa95, 0xbde65541, 0xbe9755e7,
	0x3d802e15, 0x3e1d2343, 0x3b1fc1ee, 0xbf067900,
	0x3c72e743, 0xbe95ee27, 0xbe8dffe3, 0xbec569ed,
	0xbecfe08d, 0x3e6d545e, 0x3e8b3467, 0x3eb5b621,
	0xbe1c1a0f, 0x3e071a92, 0xbe292f55, 0xbd841e3d,
	0x3eb4d636, 0x3e896277, 0x3f0d088e, 0x3e89c512,
	0xbe66e0d9, 0xbda5c7db, 0xbee26d88, 0xbf67e7cf,
	0x3e7b8eee, 0x3e878f80, 0xbe176f02, 0xbead74b7,
	0x3f40d7b0, 0x3e6684ec, 0xbdcf3d89, 0xbe2b185e,
	0x3ea0851a, 0x3e574528, 0xbf25ae3e, 0xbc1d8c89,
	0x3e563384, 0xbea6d40d, 0xbeac99c0, 0x3f229549,
	0x3e522113, 0xbf2c23b1, 0xbe9d1389, 0x3e4e85f4,
	0x3eb0eb91, 0xbf17b075, 0x3e9fa5d3, 0xbdc541ee,
	0xbe79ceb4, 0xbef0e805, 0x3d78e944, 0xbe84a108,
	0x3f04a4e5, 0xbe0d9ea0, 0xbe8ed7c7, 0xbe380a23,
	0xbde28369, 0x3f01dc75, 0xbef7f6f3, 0x3ea0f201,
	0xbf13519c, 0xbedb0feb, 0x3eac3cf7, 0xbe5f8009,
	0xbd57b158, 0x3e9d8a4e, 0xbe96c82e, 0x3f5bc10d,
	0x3cf6474c, 0x3e4364c3, 0xbeaa2ea4, 0xbd53f6ab,
	0xbf1fdc71, 0x3ee86194, 0xbf0132aa, 0xbee53cc6,
	0x3e82836b, 0xbe9a7a9a, 0xbe494f30, 0xbe24c1c6,
	0x3f76962b, 0x3e11f661, 0xbec6d557, 0xbdb3603e,
	0x3df40af7, 0x3f5229b9, 0x3e576be7, 0x3e5de873,
	0x3ecbb13e, 0x3d9d2b57, 0xbe58e633, 0xbe42c779,
	0x3ea4539f, 0xbec1326d, 0x3e9d7323, 0xbe05b725,
	0x3c814ef6, 0x3d1b483c, 0x3e036f96, 0x3e5d4cca,
	0xbf1511f1, 0x3dd2188e, 0x3e0c87b4, 0x3dd47a1e,
	0x3de1ed5e, 0xbf086942, 0x3f14ab85, 0xbed3a836,
	0x3db26a76, 0x3e7e0bf6, 0x3f59c9f4, 0xbee53819,
	0xbee72aeb, 0xbd08cc78, 0x3dc6bd55, 0x3e0d0cd2,
	0xbf00d3c6, 0x3ec9b7be, 0xbeef4f2a, 0xbe91f0f3,
	0x3e770521, 0xbd1015f5, 0x3f42a1bc, 0xbf31354a,
	0xbe277544, 0xbf21a07d, 0x3d16c40b, 0x3d9a5ef8,
	0xbd375473, 0xbe8a73e0, 0xbf04d275, 0x3e00e10c,
	0xbf04a1c1, 0x3e5ab3ef, 0xbe79fe0e, 0xbf0ff988,
	0xbea9a481, 0xbd7b414f, 0xbdc0561a, 0xbee876f9,
	0x3e96901f, 0xbf1922b3, 0xbe4696f0, 0xbec91e95,
	0xbcecd009, 0x3e27120e, 0x3d51f700, 0xbf724df3,
	0xbf16fe3f, 0xbe68fe8c, 0x3eec30d2, 0x3e8fd73f,
	0xbdb5a832, 0x3f3cb41d, 0xbf3582b0, 0xbe7d0a43,
	0x3e6e2b26, 0x3d924119, 0xbe64103c, 0x3e1094c3,
	0x3f130299, 0xbe9a77df, 0x3e62628d, 0xbf800000,
	0xbf1bc246, 0xbe9f54be, 0x3d9be53a, 0xbf1a9110,
	0x3c09e4b3, 0xbe43e5d1, 0x3dd67477, 0xbeebdf5a,
	0x3d445065, 0xbf24b81b, 0x3f442915, 0xbe439b36,
	0x3ebdb5d4, 0x3f3245c5, 0x3dde2d5d, 0x3dd499a6,
	0xbe16e5e8, 0xbda4dbc5, 0x3ea0851a, 0xbf187446,
	0xbf5e8c93, 0xbea10739, 0xbe22001f, 0xbe20c313,
	0xbeee242f, 0x3d076127, 0x3e7c303c, 0x3ed97950,
	0xbf6a57bf, 0xbe9b9d13, 0x3ddf83ce, 0xbec67d55
	};

ZTEST(basicmath_f32_benchmark, test_benchmark_vec_add_f32)
{
	uint32_t irq_key, timestamp, timespan;
	float32_t *output;

	/* Allocate output buffer */
	output = malloc(PATTERN_LENGTH * sizeof(float32_t));
	zassert_not_null(output, "output buffer allocation failed");

	/* Begin benchmark */
	benchmark_begin(&irq_key, &timestamp);

	/* Execute function */
	arm_add_f32(
		(float32_t *)input1, (float32_t *)input2, output,
		PATTERN_LENGTH);

	/* End benchmark */
	timespan = benchmark_end(irq_key, timestamp);

	/* Free output buffer */
	free(output);

	/* Print result */
	TC_PRINT(BENCHMARK_TYPE " = %u\n", timespan);
}

ZTEST(basicmath_f32_benchmark, test_benchmark_vec_sub_f32)
{
	uint32_t irq_key, timestamp, timespan;
	float32_t *output;

	/* Allocate output buffer */
	output = malloc(PATTERN_LENGTH * sizeof(float32_t));
	zassert_not_null(output, "output buffer allocation failed");

	/* Begin benchmark */
	benchmark_begin(&irq_key, &timestamp);

	/* Execute function */
	arm_sub_f32(
		(float32_t *)input1, (float32_t *)input2, output,
		PATTERN_LENGTH);

	/* End benchmark */
	timespan = benchmark_end(irq_key, timestamp);

	/* Free output buffer */
	free(output);

	/* Print result */
	TC_PRINT(BENCHMARK_TYPE " = %u\n", timespan);
}

ZTEST(basicmath_f32_benchmark, test_benchmark_vec_mult_f32)
{
	uint32_t irq_key, timestamp, timespan;
	float32_t *output;

	/* Allocate output buffer */
	output = malloc(PATTERN_LENGTH * sizeof(float32_t));
	zassert_not_null(output, "output buffer allocation failed");

	/* Begin benchmark */
	benchmark_begin(&irq_key, &timestamp);

	/* Execute function */
	arm_mult_f32(
		(float32_t *)input1, (float32_t *)input2, output,
		PATTERN_LENGTH);

	/* End benchmark */
	timespan = benchmark_end(irq_key, timestamp);

	/* Free output buffer */
	free(output);

	/* Print result */
	TC_PRINT(BENCHMARK_TYPE " = %u\n", timespan);
}

ZTEST(basicmath_f32_benchmark, test_benchmark_vec_abs_f32)
{
	uint32_t irq_key, timestamp, timespan;
	float32_t *output;

	/* Allocate output buffer */
	output = malloc(PATTERN_LENGTH * sizeof(float32_t));
	zassert_not_null(output, "output buffer allocation failed");

	/* Begin benchmark */
	benchmark_begin(&irq_key, &timestamp);

	/* Execute function */
	arm_abs_f32((float32_t *)input1, output, PATTERN_LENGTH);

	/* End benchmark */
	timespan = benchmark_end(irq_key, timestamp);

	/* Free output buffer */
	free(output);

	/* Print result */
	TC_PRINT(BENCHMARK_TYPE " = %u\n", timespan);
}

ZTEST(basicmath_f32_benchmark, test_benchmark_vec_negate_f32)
{
	uint32_t irq_key, timestamp, timespan;
	float32_t *output;

	/* Allocate output buffer */
	output = malloc(PATTERN_LENGTH * sizeof(float32_t));
	zassert_not_null(output, "output buffer allocation failed");

	/* Begin benchmark */
	benchmark_begin(&irq_key, &timestamp);

	/* Execute function */
	arm_negate_f32((float32_t *)input1, output, PATTERN_LENGTH);

	/* End benchmark */
	timespan = benchmark_end(irq_key, timestamp);

	/* Free output buffer */
	free(output);

	/* Print result */
	TC_PRINT(BENCHMARK_TYPE " = %u\n", timespan);
}

ZTEST(basicmath_f32_benchmark, test_benchmark_vec_offset_f32)
{
	uint32_t irq_key, timestamp, timespan;
	float32_t *output;

	/* Allocate output buffer */
	output = malloc(PATTERN_LENGTH * sizeof(float32_t));
	zassert_not_null(output, "output buffer allocation failed");

	/* Begin benchmark */
	benchmark_begin(&irq_key, &timestamp);

	/* Execute function */
	arm_offset_f32((float32_t *)input1, 1.0, output, PATTERN_LENGTH);

	/* End benchmark */
	timespan = benchmark_end(irq_key, timestamp);

	/* Free output buffer */
	free(output);

	/* Print result */
	TC_PRINT(BENCHMARK_TYPE " = %u\n", timespan);
}

ZTEST(basicmath_f32_benchmark, test_benchmark_vec_scale_f32)
{
	uint32_t irq_key, timestamp, timespan;
	float32_t *output;

	/* Allocate output buffer */
	output = malloc(PATTERN_LENGTH * sizeof(float32_t));
	zassert_not_null(output, "output buffer allocation failed");

	/* Begin benchmark */
	benchmark_begin(&irq_key, &timestamp);

	/* Execute function */
	arm_scale_f32((float32_t *)input1, 1.0, output, PATTERN_LENGTH);

	/* End benchmark */
	timespan = benchmark_end(irq_key, timestamp);

	/* Free output buffer */
	free(output);

	/* Print result */
	TC_PRINT(BENCHMARK_TYPE " = %u\n", timespan);
}

ZTEST(basicmath_f32_benchmark, test_benchmark_vec_dot_prod_f32)
{
	uint32_t irq_key, timestamp, timespan;
	float32_t output;

	/* Begin benchmark */
	benchmark_begin(&irq_key, &timestamp);

	/* Execute function */
	arm_dot_prod_f32(
		(float32_t *)input1, (float32_t *)input2, PATTERN_LENGTH,
		&output);

	/* End benchmark */
	timespan = benchmark_end(irq_key, timestamp);

	/* Print result */
	TC_PRINT(BENCHMARK_TYPE " = %u\n", timespan);
}

ZTEST_SUITE(basicmath_f32_benchmark, NULL, NULL, NULL, NULL, NULL);
```

## src/q15.c
```c
/*
 * Copyright (c) 2020 Stephanos Ioannidis <root@stephanos.io>
 * Copyright (C) 2010-2020 ARM Limited or its affiliates. All rights reserved.
 *
 * SPDX-License-Identifier: Apache-2.0
 */

#include <zephyr/ztest.h>
#include <zephyr/kernel.h>
#include <stdlib.h>
#include <arm_math.h>
#include "../../common/benchmark_common.h"

#define PATTERN_LENGTH	(256)

static const q15_t input1[256] = {
	0xE3D4, 0x52FC, 0x3145, 0x2BE1, 0xE819, 0xE0ED, 0x7FFF, 0xE3E1,
	0x5ABC, 0x05F6, 0xDDEF, 0xEDDD, 0x1E8B, 0xDF94, 0xF046, 0x0A36,
	0x0EE0, 0x009E, 0x26EB, 0xF319, 0x31C1, 0x10D4, 0xC9C4, 0x2262,
	0x4701, 0x34E1, 0xE40A, 0xDBA4, 0xEDB4, 0xE4A8, 0xE809, 0x0AF7,
	0x18D0, 0xE390, 0x069C, 0xF1F3, 0xFD87, 0x50E3, 0x11D9, 0xD170,
	0xF875, 0xEE6E, 0xFA82, 0x27E6, 0xC9ED, 0xF244, 0x1DAA, 0xD76C,
	0x3161, 0xF480, 0x2AD5, 0x3C94, 0xC6CD, 0x0E0F, 0xEED6, 0xF686,
	0x176B, 0xD1F1, 0x0376, 0x3383, 0x4A5E, 0x345F, 0xEF16, 0xF965,
	0x02F3, 0xFB76, 0xC971, 0xDE8C, 0x451B, 0xE544, 0x3DC0, 0xC6A4,
	0xE51E, 0xFE6F, 0x1611, 0x34E6, 0x62C7, 0xDB18, 0xE6D9, 0x704E,
	0xD2B6, 0xE9AF, 0xFBF6, 0xBB21, 0x238F, 0x41FB, 0xD4BF, 0xF8AC,
	0x56E5, 0xD443, 0x1110, 0x090F, 0xF2CB, 0x0EB2, 0xC3F9, 0xE172,
	0x023C, 0x1418, 0x2AB7, 0x2312, 0x0E1E, 0x12C8, 0xE18B, 0x295E,
	0x3406, 0x1CF5, 0x07C1, 0x1C2D, 0xE286, 0xBD73, 0xEC6A, 0x02D7,
	0xE723, 0x1CAF, 0x0AE6, 0x2981, 0x063E, 0x2C64, 0xE04F, 0xD244,
	0x1A70, 0xDE44, 0x01F4, 0x9045, 0x1FB1, 0x4211, 0x0C12, 0x06C6,
	0x9C63, 0x36BD, 0x245A, 0xA9E8, 0xC568, 0xC1AF, 0xC08E, 0x5486,
	0x351C, 0xA861, 0x0BA9, 0xD8BB, 0x156B, 0x1DF2, 0xDADC, 0xD697,
	0x41D4, 0x0577, 0xA57A, 0x0BC5, 0x207A, 0x65C6, 0xD39F, 0xCCE7,
	0xE5CB, 0xD27E, 0x1CA6, 0xBA07, 0xCE3E, 0xAD53, 0xF436, 0xFBCC,
	0x0A4C, 0x07F3, 0x076E, 0xA9F2, 0xFB3E, 0x0432, 0xF68E, 0x0F7E,
	0xBEFA, 0x46EB, 0xA4E9, 0x1A90, 0x1D3F, 0x16AD, 0x19B4, 0xD509,
	0x0471, 0x1D65, 0xDFAC, 0x25B5, 0x253B, 0xDA97, 0x0278, 0xFB9A,
	0xFDBF, 0x0E9B, 0xF860, 0x239C, 0xF297, 0x0E31, 0xF60B, 0x06C2,
	0xE21D, 0x281D, 0x368E, 0xBE38, 0x01CD, 0x8007, 0x327B, 0x1516,
	0x1B87, 0xEB37, 0xE7C9, 0x0B1F, 0xEB5C, 0x1351, 0xBE00, 0xE59B,
	0x11AD, 0xF790, 0xEA1C, 0x233D, 0xABAD, 0x1308, 0x1123, 0xCFC5,
	0xE2DE, 0xFB7E, 0x015C, 0x46B1, 0x39D4, 0xF461, 0xCF80, 0xFC2F,
	0xE0FD, 0xEB2F, 0xDFDF, 0xF6CE, 0x0E6B, 0xF37A, 0xDE3B, 0x0384,
	0xE41B, 0x0228, 0xEA1A, 0x0295, 0xE259, 0xF591, 0x1D80, 0xFE6D,
	0xE5D5, 0xF4BE, 0x59DE, 0x2A7C, 0xEDC1, 0xD15A, 0xD82E, 0xCF62,
	0xF37B, 0x208B, 0xBBBC, 0xE912, 0x2313, 0x343B, 0x04DB, 0xDAEA
	};

static const q15_t input2[256] = {
	0x1FA8, 0xB5C0, 0x0657, 0xF243, 0xF45A, 0xFC5F, 0xC797, 0xFB41,
	0xADA1, 0xD676, 0x19F3, 0xC719, 0xDCC1, 0xE58D, 0xA698, 0x07DE,
	0x1F5E, 0x38AA, 0x4DC9, 0xEADC, 0xF6F6, 0x0377, 0x0DA7, 0x04F9,
	0xC739, 0x468A, 0xBE92, 0xE168, 0xDAD3, 0x2AFB, 0xBF31, 0x2E55,
	0xC167, 0xE16F, 0x331D, 0x75C5, 0x9CEC, 0x0E00, 0x0FD6, 0x0FBD,
	0x66BF, 0x3D72, 0x210E, 0x4AF9, 0xE88E, 0x386F, 0x15B5, 0x3B1C,
	0xEEE1, 0xD8FA, 0xDEE1, 0x363B, 0xE247, 0x0675, 0xD48C, 0xF07E,
	0x2F80, 0xC403, 0xFA8E, 0x54CF, 0xF854, 0xECEF, 0x3430, 0xE2B4,
	0x0DD4, 0x46ED, 0xBAB9, 0x14E3, 0x0461, 0xFDEE, 0xEADD, 0x3CDC,
	0x0788, 0x1424, 0xD71C, 0xE338, 0xC0E2, 0x478F, 0xAD82, 0xE621,
	0x1A29, 0xEEA8, 0x0694, 0xB7F2, 0x01B0, 0xD64B, 0x45A6, 0x188F,
	0xFEEF, 0x0207, 0xD7DC, 0xF5FD, 0x9C9E, 0x1440, 0x451E, 0x288C,
	0x0D4C, 0xFBB8, 0xF5A3, 0xF9E7, 0x35DD, 0x0180, 0xF11F, 0x28CA,
	0xD05F, 0xE4F9, 0x62E6, 0xF7CF, 0x2E26, 0xDE18, 0x08D1, 0x0A62,
	0x31D2, 0x1FFE, 0x020D, 0x04A3, 0x04D1, 0xE242, 0xB659, 0xF8CC,
	0x1167, 0xE945, 0xD6CB, 0xFBF7, 0x9659, 0xE39B, 0xCB9B, 0x7352,
	0xEB7A, 0xEBB9, 0x3970, 0x42A5, 0xC17C, 0x25D1, 0x71BE, 0x0864,
	0xFB16, 0x7144, 0xE855, 0xB4C5, 0x1E53, 0xFC20, 0x619A, 0x284D,
	0xDFA1, 0xAA6C, 0xF0C7, 0xFF17, 0xEFB4, 0xF703, 0xD588, 0x89A9,
	0x163A, 0x08C7, 0x0797, 0xCDF4, 0x18AF, 0x0340, 0x1D79, 0xC5CF,
	0xE6FE, 0xB892, 0xE6E0, 0xC464, 0xF8A7, 0xC4BF, 0xCAB2, 0xFE34,
	0xB14D, 0xD6A8, 0x4BE8, 0xB393, 0xCA55, 0x1983, 0xB858, 0x2E94,
	0x25A7, 0x0E16, 0xF579, 0xF49B, 0x1238, 0x4404, 0x0DEE, 0x00EB,
	0xCEC0, 0xE9FF, 0x662F, 0x305C, 0x6647, 0x4A18, 0xF747, 0xFEC0,
	0x419B, 0xDF0B, 0x0A29, 0x2316, 0x1E1A, 0xDD96, 0x1FDF, 0xFAC7,
	0xBD7B, 0x0D0F, 0xB873, 0xB61A, 0x05C3, 0xE868, 0x0EF6, 0xCE54,
	0x27A1, 0x47AE, 0x4203, 0xC4D0, 0x5969, 0xE833, 0xE09F, 0x2D48,
	0xF580, 0x38E5, 0xF5F7, 0x2C88, 0x4139, 0xC6A3, 0xE8F8, 0xB988,
	0xBB7C, 0xFC8F, 0xD3CA, 0xDC37, 0x29BF, 0x5714, 0x0CBC, 0x068E,
	0x3858, 0x035D, 0xCD26, 0x7FFF, 0xF961, 0x2425, 0xE907, 0x297A,
	0xC6F3, 0xF9C6, 0xBC91, 0x206D, 0xBC27, 0xC6AB, 0x2203, 0xB8D5,
	0xEA8B, 0x0959, 0x2D02, 0xD265, 0x3343, 0x0521, 0x4A77, 0xE225
	};

ZTEST(basicmath_q15_benchmark, test_benchmark_vec_add_q15)
{
	uint32_t irq_key, timestamp, timespan;
	q15_t *output;

	/* Allocate output buffer */
	output = malloc(PATTERN_LENGTH * sizeof(q15_t));
	zassert_not_null(output, "output buffer allocation failed");

	/* Begin benchmark */
	benchmark_begin(&irq_key, &timestamp);

	/* Execute function */
	arm_add_q15(input1, input2, output, PATTERN_LENGTH);

	/* End benchmark */
	timespan = benchmark_end(irq_key, timestamp);

	/* Free output buffer */
	free(output);

	/* Print result */
	TC_PRINT(BENCHMARK_TYPE " = %u\n", timespan);
}

ZTEST(basicmath_q15_benchmark, test_benchmark_vec_sub_q15)
{
	uint32_t irq_key, timestamp, timespan;
	q15_t *output;

	/* Allocate output buffer */
	output = malloc(PATTERN_LENGTH * sizeof(q15_t));
	zassert_not_null(output, "output buffer allocation failed");

	/* Begin benchmark */
	benchmark_begin(&irq_key, &timestamp);

	/* Execute function */
	arm_sub_q15(input1, input2, output, PATTERN_LENGTH);

	/* End benchmark */
	timespan = benchmark_end(irq_key, timestamp);

	/* Free output buffer */
	free(output);

	/* Print result */
	TC_PRINT(BENCHMARK_TYPE " = %u\n", timespan);
}

ZTEST(basicmath_q15_benchmark, test_benchmark_vec_mult_q15)
{
	uint32_t irq_key, timestamp, timespan;
	q15_t *output;

	/* Allocate output buffer */
	output = malloc(PATTERN_LENGTH * sizeof(q15_t));
	zassert_not_null(output, "output buffer allocation failed");

	/* Begin benchmark */
	benchmark_begin(&irq_key, &timestamp);

	/* Execute function */
	arm_mult_q15(input1, input2, output, PATTERN_LENGTH);

	/* End benchmark */
	timespan = benchmark_end(irq_key, timestamp);

	/* Free output buffer */
	free(output);

	/* Print result */
	TC_PRINT(BENCHMARK_TYPE " = %u\n", timespan);
}

ZTEST(basicmath_q15_benchmark, test_benchmark_vec_abs_q15)
{
	uint32_t irq_key, timestamp, timespan;
	q15_t *output;

	/* Allocate output buffer */
	output = malloc(PATTERN_LENGTH * sizeof(q15_t));
	zassert_not_null(output, "output buffer allocation failed");

	/* Begin benchmark */
	benchmark_begin(&irq_key, &timestamp);

	/* Execute function */
	arm_abs_q15(input1, output, PATTERN_LENGTH);

	/* End benchmark */
	timespan = benchmark_end(irq_key, timestamp);

	/* Free output buffer */
	free(output);

	/* Print result */
	TC_PRINT(BENCHMARK_TYPE " = %u\n", timespan);
}

ZTEST(basicmath_q15_benchmark, test_benchmark_vec_negate_q15)
{
	uint32_t irq_key, timestamp, timespan;
	q15_t *output;

	/* Allocate output buffer */
	output = malloc(PATTERN_LENGTH * sizeof(q15_t));
	zassert_not_null(output, "output buffer allocation failed");

	/* Begin benchmark */
	benchmark_begin(&irq_key, &timestamp);

	/* Execute function */
	arm_negate_q15(input1, output, PATTERN_LENGTH);

	/* End benchmark */
	timespan = benchmark_end(irq_key, timestamp);

	/* Free output buffer */
	free(output);

	/* Print result */
	TC_PRINT(BENCHMARK_TYPE " = %u\n", timespan);
}

ZTEST(basicmath_q15_benchmark, test_benchmark_vec_offset_q15)
{
	uint32_t irq_key, timestamp, timespan;
	q15_t *output;

	/* Allocate output buffer */
	output = malloc(PATTERN_LENGTH * sizeof(q15_t));
	zassert_not_null(output, "output buffer allocation failed");

	/* Begin benchmark */
	benchmark_begin(&irq_key, &timestamp);

	/* Execute function */
	arm_offset_q15(input1, 1.0, output, PATTERN_LENGTH);

	/* End benchmark */
	timespan = benchmark_end(irq_key, timestamp);

	/* Free output buffer */
	free(output);

	/* Print result */
	TC_PRINT(BENCHMARK_TYPE " = %u\n", timespan);
}

ZTEST(basicmath_q15_benchmark, test_benchmark_vec_scale_q15)
{
	uint32_t irq_key, timestamp, timespan;
	q15_t *output;

	/* Allocate output buffer */
	output = malloc(PATTERN_LENGTH * sizeof(q15_t));
	zassert_not_null(output, "output buffer allocation failed");

	/* Begin benchmark */
	benchmark_begin(&irq_key, &timestamp);

	/* Execute function */
	arm_scale_q15(input1, 0x45, 1, output, PATTERN_LENGTH);

	/* End benchmark */
	timespan = benchmark_end(irq_key, timestamp);

	/* Free output buffer */
	free(output);

	/* Print result */
	TC_PRINT(BENCHMARK_TYPE " = %u\n", timespan);
}

ZTEST(basicmath_q15_benchmark, test_benchmark_vec_dot_prod_q15)
{
	uint32_t irq_key, timestamp, timespan;
	q63_t output;

	/* Begin benchmark */
	benchmark_begin(&irq_key, &timestamp);

	/* Execute function */
	arm_dot_prod_q15(input1, input2, PATTERN_LENGTH, &output);

	/* End benchmark */
	timespan = benchmark_end(irq_key, timestamp);

	/* Print result */
	TC_PRINT(BENCHMARK_TYPE " = %u\n", timespan);
}

ZTEST_SUITE(basicmath_q15_benchmark, NULL, NULL, NULL, NULL, NULL);
```

## src/q31.c
```c
/*
 * Copyright (c) 2020 Stephanos Ioannidis <root@stephanos.io>
 * Copyright (C) 2010-2020 ARM Limited or its affiliates. All rights reserved.
 *
 * SPDX-License-Identifier: Apache-2.0
 */

#include <zephyr/ztest.h>
#include <zephyr/kernel.h>
#include <stdlib.h>
#include <arm_math.h>
#include "../../common/benchmark_common.h"

#define PATTERN_LENGTH	(256)

static const q31_t input1[256] = {
	0xC631366A, 0xFB13DDA9, 0xEED09227, 0xD28B3673,
	0xE2196135, 0xF374965D, 0x02ACCA0C, 0xCB7C49FF,
	0x07379279, 0x1447DB6D, 0xC6573A28, 0x9B58C226,
	0x28DFD755, 0x3D3B07A2, 0x0D68B78C, 0xD7DCA4EE,
	0xDB0C855B, 0x023602B6, 0xF916B096, 0xEBF0F01A,
	0xEF2088F4, 0x271B8868, 0x27D08994, 0xD6A88ADC,
	0x32EC53E8, 0xE81E138E, 0xCD458FEA, 0xB954E128,
	0x1EDE0E95, 0xF552AE24, 0xE50ED7CD, 0xEA8006A8,
	0xD15FDC5B, 0xE6664B86, 0xF2D00F35, 0x580806BE,
	0xDEABF04F, 0x0ED614B8, 0x02DD4DB0, 0x31168702,
	0xE8E1C9F2, 0x057B8340, 0x140401B2, 0xE9CD8CA6,
	0xF32B25C9, 0xD6E1A540, 0x1F2B6682, 0xB50095B3,
	0x9F6DCA67, 0xE4B450BB, 0x4EB1B95A, 0xDB7BFF93,
	0xCBEAEC9B, 0x21F416A1, 0xCDE2CCB1, 0xBD7E7949,
	0x1FA7DD36, 0xE053411E, 0x11C4257F, 0xED7C5D35,
	0xC19ADE19, 0xCE19D0C7, 0xF74B2CB9, 0x2A399C7B,
	0x0535E354, 0xFBF6A6C0, 0x20863CC0, 0xDB69DB37,
	0xB4F29C11, 0xD6B22F7B, 0x038B9816, 0xE3C682A0,
	0xEDCBB8B7, 0xDE7C72C9, 0x32F8DD8B, 0x3A95873C,
	0xF2111759, 0xF7DA7E6A, 0xED96D85D, 0xD2362CAF,
	0xF2E7EF09, 0xD4AC5EF7, 0xFBC85EF5, 0x0C1C43AB,
	0x0DF7FEB7, 0x3E65BFDA, 0xBBEFE59B, 0xE9684971,
	0xD0395A63, 0x00748F9A, 0x0F3489D3, 0x040CB837,
	0xFBF33C8F, 0xF3071033, 0x21D0FB32, 0x032EEE15,
	0x0DD08506, 0xE353BDD5, 0x1DF580B8, 0x29D7206E,
	0xBB37A59D, 0x1C10046B, 0xE45E09A1, 0xF9905A90,
	0xEB10CB71, 0x0B15EBA8, 0x085EF241, 0x38FE421D,
	0xBDA824C3, 0xF4F75651, 0xEC519026, 0x37A99EC2,
	0xEAD68528, 0xF4AAD39D, 0x163E8F6E, 0xEE264172,
	0x18138FDC, 0xEED062BC, 0x4B543E58, 0x1A6C1F71,
	0xEDC2E5D1, 0x45451847, 0xDD23449A, 0x23DAB3A8,
	0xFEF8783A, 0x5F9B1AB0, 0x19217DD4, 0x1EA54ED7,
	0xE0BDADFE, 0xEDA12547, 0xFCD4F5D8, 0xE9FE19F6,
	0x0442389E, 0xFE9C42A5, 0xF509E355, 0x2AE61FA0,
	0x1BC01C55, 0xDE523096, 0x1E3AADDC, 0x0C2E1F51,
	0xD86F78CD, 0x327333F7, 0x19F2138F, 0x2F9F42BC,
	0xE3E5BD9B, 0xEF39864E, 0xE856DC90, 0xEF27A130,
	0xEBC4DCE8, 0x0F708DD1, 0x2778EC5B, 0xFA3C037A,
	0xC065422F, 0xDDE79F2C, 0xE880E4F0, 0xB14CE586,
	0x091F7AC1, 0xD6929567, 0x24C4425C, 0x100FEC70,
	0x0D2B053C, 0x23FACA44, 0xF99AAE94, 0xC135C785,
	0xFC28C4F4, 0x10D76869, 0x0A7B1272, 0x10608353,
	0x2E9C08B0, 0x59A18ED8, 0xF0D49846, 0xC8D1A81B,
	0x1BBDF0B6, 0xF289F305, 0x05E74FEC, 0x27EBFC25,
	0xF4EA822B, 0x0CB43282, 0x19B782A9, 0x233C62FC,
	0xE8EDF38F, 0x025E93FD, 0xF7D7D282, 0xA675C383,
	0x0171EB58, 0xCB893E3C, 0xEFB60317, 0xFB72B6EF,
	0xF05A1137, 0x42ACFE0E, 0x25EB1D6B, 0x1C9D26B4,
	0x215B4D22, 0xE1C1E29B, 0x3B3E68FD, 0xBFE233EE,
	0x336C6C8E, 0x079D9442, 0x097E9C6B, 0xF3C69D03,
	0xDC026526, 0x0C6A4F89, 0x1063CA94, 0x093E62E9,
	0x21F1CD33, 0x08991A66, 0x03385438, 0xEE1A0BD8,
	0xDD01E7C7, 0x2223F95A, 0xDECC8D24, 0xEC2DEE81,
	0xE5CB797B, 0xD73940C9, 0x2A6D5443, 0x347F86DD,
	0xF3950FA3, 0xDC9AB3D4, 0xDBE1D805, 0xFB6B0E5C,
	0x207C019F, 0xF1F00F8F, 0xED3E7606, 0x470168BA,
	0xF3061229, 0xD3526760, 0x0F2D08F3, 0x97CDCF77,
	0xC2D5A7AA, 0xE7752C0B, 0xECCE8901, 0x0BFDE47E,
	0x4CACC995, 0x0221E381, 0xE43CD3B4, 0xF2E1262A,
	0x18D68649, 0x07C9883C, 0x07239928, 0xC62A1170,
	0x24F5B0E5, 0x02A9DF50, 0x03E2DA18, 0xF06623E6,
	0xED03EB89, 0x1DC68DE4, 0x225EF5AE, 0x48005603,
	0x4C0CEE5E, 0xFE56170E, 0x80000000, 0x057AA227,
	0x0E600876, 0xFD1D866A, 0xEA74C1DB, 0x22ED63F0
	};

static const q31_t input2[256] = {
	0x1C0A13BC, 0x1B873800, 0xE34CB773, 0xDA6DADAE,
	0xFF8618DF, 0xF79C1734, 0x087D8481, 0x21A431EA,
	0xF840AF7D, 0x0AE2BCEE, 0x2A582599, 0x19EC693D,
	0x091B03C7, 0x4E3E7131, 0xF462C8D3, 0xFEC29627,
	0x0824B403, 0xE5605B52, 0x0FD08240, 0x0CDE1B94,
	0xCE1148E2, 0x1160A638, 0xB583AAE1, 0x44B1F71F,
	0x265DF7F3, 0xD4F1E9B5, 0x2EE474D4, 0xCD383FED,
	0x36A03599, 0x0D833B71, 0xCAF5999D, 0xDA601039,
	0x3D1BA57B, 0x12CA8626, 0x12B5DB84, 0xE7E396C3,
	0xDE5B5D5C, 0x0DA9623A, 0x1E4CD13C, 0x2AE25F57,
	0xCE7D118B, 0x1D17F86A, 0x30F5A933, 0xEFCC13E2,
	0xDBC3AD5F, 0x2BB33845, 0x0FD0F0FD, 0xD643FCCC,
	0xF6476F7F, 0xF1F1F7BD, 0xBA683437, 0xE87FCB22,
	0x210DD0F6, 0xF0738E7F, 0xF61B2952, 0xF9A85CFD,
	0xEF980CC1, 0x1C78B775, 0x5D937EC5, 0xEA54C61D,
	0x0B8AF897, 0xC9C3B40E, 0x1DBCFF62, 0xF1A1866F,
	0xCFE278AE, 0x04844959, 0x1A821BBA, 0xEFEC5903,
	0xFE724C57, 0x1FBFA58E, 0xBDBA24C0, 0x1489DE32,
	0xF0B04CF9, 0x03F7C82E, 0xFA6DB38E, 0xDF0EF9CB,
	0x057E618A, 0x3ADA9765, 0xDC214567, 0xBEFAEC05,
	0x07C36015, 0xD506010D, 0x23FC80EA, 0x1019EB8A,
	0xFC3FA8E9, 0xEF70F6CF, 0xC2E534C0, 0x00CA86AB,
	0x359CB10A, 0xCEEED4CD, 0xF7A108E0, 0xEE58A199,
	0xE9DB5FCC, 0xEC75497C, 0xDECA4BD8, 0xE9B39B39,
	0x24DC6736, 0xF58219E5, 0x18F2A349, 0x2DB6B98D,
	0x32F3CB95, 0xF7B5D2EB, 0xF2D98779, 0x0738182A,
	0xE91D0A75, 0xF0A3271F, 0xDC4338E3, 0x320EF7F1,
	0xA5F51F14, 0x229D5EB5, 0xE340F852, 0x109E486D,
	0x265AABD0, 0x00D30A8B, 0xFE0E4A39, 0xF211B88A,
	0x2684E20F, 0xF05DD624, 0xFBB526FD, 0x33BBC360,
	0x16BDF629, 0xEE2B449E, 0x0DBE4FE2, 0x176744B2,
	0xBCAE90B1, 0xD7506581, 0x0E084745, 0xF48548B8,
	0x0F7B2E33, 0x1C048268, 0x1DA01712, 0x0BD9FFFF,
	0x09071057, 0x15C78815, 0xFEF31ACF, 0x20A46B7F,
	0x1A201E7D, 0xC99A8A86, 0x07EB6EFA, 0x0C51BB67,
	0xE19171BB, 0xED7FB395, 0x2139EDC4, 0xF7B8731A,
	0x3147704D, 0x00CDE1E8, 0x0BDCE7A3, 0xDC6E4D8E,
	0xE472432E, 0xFBA6F1C2, 0xFA6ADCE7, 0xED4397A2,
	0xD91373D0, 0xFF761BFB, 0x80000000, 0x13A8BF6C,
	0x0A435241, 0x050FC71E, 0xE9FBFD16, 0xD7551A22,
	0xEA4BBE90, 0xE04F3D13, 0xEB821D9A, 0x0E3A1F7D,
	0xE497D3E1, 0xBD1DEBEF, 0x20A89097, 0xD3FCF04F,
	0xE0CF2CE8, 0xEAD4AB1D, 0xD1FE455F, 0x3826A092,
	0x05F55C1A, 0x02460DAC, 0xF2605E45, 0xF0E2F7E9,
	0x055B6EFF, 0x15026E0E, 0x0CE37D91, 0x0A6608DF,
	0x0816BED3, 0xFDCA18C4, 0x11A9FA87, 0xE897E122,
	0x15F7DEC7, 0x00BCD0F5, 0x08A61E81, 0xED1B06BF,
	0xC660A3D6, 0xD96AACC4, 0x108D13EB, 0xE04D11F8,
	0x10D1ECA1, 0xF79C5AA0, 0xF4EEB4A7, 0xFDA8B0D4,
	0xD7E48BEC, 0xC34688EB, 0x0B8D245B, 0x252EB410,
	0x23D68826, 0xF6684A2F, 0xEACB4E33, 0xFDDA246D,
	0xDCD3CBD5, 0x014DACE7, 0xD34FCA72, 0x0768A475,
	0x121B47FE, 0xFABBB9E9, 0xE1B27B22, 0xD2C319EF,
	0x08BD722A, 0xF3586DAE, 0xF2CF2D0D, 0xCB98E626,
	0xFAB40975, 0xF74793E7, 0x0E4FAECF, 0xCBF853B2,
	0xBD58E24C, 0x165711EA, 0xDB490DB3, 0x0CEE2B58,
	0x1C2BDE43, 0xDF5E5585, 0xE0E245B1, 0x1D12CF16,
	0xFA6030C3, 0x00202A46, 0xE7D2A60B, 0xE92A0C14,
	0xF5CC7899, 0x273C7A64, 0x1F8B8D48, 0xEF1B951A,
	0xEE0B4B6C, 0xC08FA7FB, 0xF7625189, 0x2FBE33F9,
	0x25F96B97, 0xE4079AFF, 0x05B10472, 0x2743154D,
	0x1733D292, 0x0C21E583, 0x28EB1125, 0x2861780A,
	0xF297AE48, 0x311766BE, 0xEDF26EF4, 0xD4B0C893,
	0x293701E2, 0xC0D85C67, 0x06D39B8C, 0x0B7E6C0C
	};

ZTEST(basicmath_q31_benchmark, test_benchmark_vec_add_q31)
{
	uint32_t irq_key, timestamp, timespan;
	q31_t *output;

	/* Allocate output buffer */
	output = malloc(PATTERN_LENGTH * sizeof(q31_t));
	zassert_not_null(output, "output buffer allocation failed");

	/* Begin benchmark */
	benchmark_begin(&irq_key, &timestamp);

	/* Execute function */
	arm_add_q31(input1, input2, output, PATTERN_LENGTH);

	/* End benchmark */
	timespan = benchmark_end(irq_key, timestamp);

	/* Free output buffer */
	free(output);

	/* Print result */
	TC_PRINT(BENCHMARK_TYPE " = %u\n", timespan);
}

ZTEST(basicmath_q31_benchmark, test_benchmark_vec_sub_q31)
{
	uint32_t irq_key, timestamp, timespan;
	q31_t *output;

	/* Allocate output buffer */
	output = malloc(PATTERN_LENGTH * sizeof(q31_t));
	zassert_not_null(output, "output buffer allocation failed");

	/* Begin benchmark */
	benchmark_begin(&irq_key, &timestamp);

	/* Execute function */
	arm_sub_q31(input1, input2, output, PATTERN_LENGTH);

	/* End benchmark */
	timespan = benchmark_end(irq_key, timestamp);

	/* Free output buffer */
	free(output);

	/* Print result */
	TC_PRINT(BENCHMARK_TYPE " = %u\n", timespan);
}

ZTEST(basicmath_q31_benchmark, test_benchmark_vec_mult_q31)
{
	uint32_t irq_key, timestamp, timespan;
	q31_t *output;

	/* Allocate output buffer */
	output = malloc(PATTERN_LENGTH * sizeof(q31_t));
	zassert_not_null(output, "output buffer allocation failed");

	/* Begin benchmark */
	benchmark_begin(&irq_key, &timestamp);

	/* Execute function */
	arm_mult_q31(input1, input2, output, PATTERN_LENGTH);

	/* End benchmark */
	timespan = benchmark_end(irq_key, timestamp);

	/* Free output buffer */
	free(output);

	/* Print result */
	TC_PRINT(BENCHMARK_TYPE " = %u\n", timespan);
}

ZTEST(basicmath_q31_benchmark, test_benchmark_vec_abs_q31)
{
	uint32_t irq_key, timestamp, timespan;
	q31_t *output;

	/* Allocate output buffer */
	output = malloc(PATTERN_LENGTH * sizeof(q31_t));
	zassert_not_null(output, "output buffer allocation failed");

	/* Begin benchmark */
	benchmark_begin(&irq_key, &timestamp);

	/* Execute function */
	arm_abs_q31(input1, output, PATTERN_LENGTH);

	/* End benchmark */
	timespan = benchmark_end(irq_key, timestamp);

	/* Free output buffer */
	free(output);

	/* Print result */
	TC_PRINT(BENCHMARK_TYPE " = %u\n", timespan);
}

ZTEST(basicmath_q31_benchmark, test_benchmark_vec_negate_q31)
{
	uint32_t irq_key, timestamp, timespan;
	q31_t *output;

	/* Allocate output buffer */
	output = malloc(PATTERN_LENGTH * sizeof(q31_t));
	zassert_not_null(output, "output buffer allocation failed");

	/* Begin benchmark */
	benchmark_begin(&irq_key, &timestamp);

	/* Execute function */
	arm_negate_q31(input1, output, PATTERN_LENGTH);

	/* End benchmark */
	timespan = benchmark_end(irq_key, timestamp);

	/* Free output buffer */
	free(output);

	/* Print result */
	TC_PRINT(BENCHMARK_TYPE " = %u\n", timespan);
}

ZTEST(basicmath_q31_benchmark, test_benchmark_vec_offset_q31)
{
	uint32_t irq_key, timestamp, timespan;
	q31_t *output;

	/* Allocate output buffer */
	output = malloc(PATTERN_LENGTH * sizeof(q31_t));
	zassert_not_null(output, "output buffer allocation failed");

	/* Begin benchmark */
	benchmark_begin(&irq_key, &timestamp);

	/* Execute function */
	arm_offset_q31(input1, 1.0, output, PATTERN_LENGTH);

	/* End benchmark */
	timespan = benchmark_end(irq_key, timestamp);

	/* Free output buffer */
	free(output);

	/* Print result */
	TC_PRINT(BENCHMARK_TYPE " = %u\n", timespan);
}

ZTEST(basicmath_q31_benchmark, test_benchmark_vec_scale_q31)
{
	uint32_t irq_key, timestamp, timespan;
	q31_t *output;

	/* Allocate output buffer */
	output = malloc(PATTERN_LENGTH * sizeof(q31_t));
	zassert_not_null(output, "output buffer allocation failed");

	/* Begin benchmark */
	benchmark_begin(&irq_key, &timestamp);

	/* Execute function */
	arm_scale_q31(input1, 0x45, 1, output, PATTERN_LENGTH);

	/* End benchmark */
	timespan = benchmark_end(irq_key, timestamp);

	/* Free output buffer */
	free(output);

	/* Print result */
	TC_PRINT(BENCHMARK_TYPE " = %u\n", timespan);
}

ZTEST(basicmath_q31_benchmark, test_benchmark_vec_dot_prod_q31)
{
	uint32_t irq_key, timestamp, timespan;
	q63_t output;

	/* Begin benchmark */
	benchmark_begin(&irq_key, &timestamp);

	/* Execute function */
	arm_dot_prod_q31(input1, input2, PATTERN_LENGTH, &output);

	/* End benchmark */
	timespan = benchmark_end(irq_key, timestamp);

	/* Print result */
	TC_PRINT(BENCHMARK_TYPE " = %u\n", timespan);
}

ZTEST_SUITE(basicmath_q31_benchmark, NULL, NULL, NULL, NULL, NULL);
```

## src/q7.c
```c
/*
 * Copyright (c) 2020 Stephanos Ioannidis <root@stephanos.io>
 * Copyright (C) 2010-2020 ARM Limited or its affiliates. All rights reserved.
 *
 * SPDX-License-Identifier: Apache-2.0
 */

#include <zephyr/ztest.h>
#include <zephyr/kernel.h>
#include <stdlib.h>
#include <arm_math.h>
#include "../../common/benchmark_common.h"

#define PATTERN_LENGTH	(256)

static const q7_t input1[PATTERN_LENGTH] = {
	0x17, 0xCC, 0x33, 0xF2, 0x14, 0x01, 0x2A, 0xF2,
	0xEC, 0x22, 0x01, 0xF7, 0x2A, 0xB5, 0xCF, 0xED,
	0x2F, 0xE8, 0xCB, 0xE8, 0xF2, 0x08, 0xC6, 0xF2,
	0x34, 0x2F, 0xE1, 0xEF, 0xE8, 0xF1, 0xC1, 0xEF,
	0x3B, 0x23, 0x07, 0x01, 0xFE, 0x07, 0x03, 0xF7,
	0x45, 0xF5, 0xE9, 0xF5, 0x0F, 0x13, 0xF5, 0xF2,
	0x06, 0x1C, 0xF4, 0xFB, 0x12, 0xAF, 0x09, 0x0C,
	0xE8, 0x03, 0xF2, 0x10, 0x2D, 0xD3, 0x16, 0xF5,
	0x32, 0x0C, 0x59, 0xDA, 0x0C, 0x1C, 0xB5, 0x49,
	0x23, 0x05, 0xA1, 0x21, 0x1B, 0x1E, 0xCE, 0xC1,
	0xE0, 0x58, 0x22, 0x01, 0xDB, 0x05, 0x06, 0x30,
	0xCF, 0xCC, 0x0D, 0xA1, 0x38, 0x35, 0xFE, 0x19,
	0xD5, 0x01, 0x15, 0x37, 0x10, 0xDC, 0xF4, 0xD0,
	0x09, 0x0F, 0x1C, 0xA3, 0xCA, 0xF7, 0x29, 0x19,
	0x10, 0xF5, 0xFB, 0xD8, 0x0A, 0xA4, 0xD3, 0x08,
	0x44, 0xDF, 0x2F, 0x5E, 0xFA, 0xFC, 0x48, 0x0B,
	0xFA, 0xB9, 0x43, 0xF3, 0xCC, 0x6A, 0x51, 0x0B,
	0xF8, 0xC6, 0xD2, 0xE0, 0xD6, 0xFA, 0xE0, 0x1B,
	0xCC, 0x31, 0x03, 0xE1, 0x18, 0x11, 0x04, 0xCC,
	0xFA, 0xF6, 0xFE, 0x25, 0x0E, 0x34, 0x15, 0xE7,
	0xDD, 0xE3, 0xFE, 0xDE, 0x12, 0xCD, 0xE0, 0xF6,
	0xD6, 0xF5, 0xDE, 0x0D, 0x28, 0x09, 0xF2, 0xC2,
	0x1A, 0x54, 0xBB, 0xEB, 0xB7, 0xDB, 0x12, 0x05,
	0x0F, 0xEE, 0x48, 0x00, 0x02, 0x11, 0xCA, 0xA9,
	0x0C, 0x7F, 0x1D, 0x34, 0x13, 0xC8, 0x15, 0xFA,
	0xDE, 0x39, 0xFE, 0x02, 0x09, 0x07, 0x2C, 0xF4,
	0xEE, 0xE9, 0x11, 0x22, 0xE2, 0xAB, 0x37, 0xC1,
	0xEA, 0x00, 0x3E, 0xEC, 0x23, 0x03, 0xEE, 0xBB,
	0xE2, 0x6D, 0x17, 0x00, 0xEF, 0x2F, 0x19, 0x31,
	0x05, 0xCB, 0xFF, 0x0A, 0x29, 0xA6, 0xD9, 0x42,
	0x1A, 0xDE, 0x21, 0x31, 0x3E, 0x34, 0xFB, 0x11,
	0xE3, 0x8F, 0xF1, 0xC6, 0xEF, 0x51, 0x01, 0xE0
	};

static const q7_t input2[PATTERN_LENGTH] = {
	0x0F, 0x06, 0xDE, 0x12, 0xE8, 0x03, 0xF2, 0xEC,
	0x2C, 0xC7, 0x0C, 0xF3, 0xF6, 0xE2, 0xFB, 0x14,
	0xC0, 0xDD, 0xE5, 0xDB, 0xD6, 0xCE, 0x19, 0xEB,
	0xF7, 0x0D, 0x20, 0x0C, 0x1B, 0xB9, 0xF4, 0xF2,
	0x02, 0xE9, 0x21, 0x3F, 0xE4, 0x02, 0x75, 0x0D,
	0x31, 0x0F, 0x38, 0x16, 0xEA, 0x14, 0x7F, 0xEC,
	0x06, 0x20, 0xE7, 0x0C, 0x27, 0xDA, 0x02, 0xF2,
	0xF8, 0xF4, 0xFE, 0x36, 0xCC, 0xCC, 0x0B, 0xCF,
	0xFD, 0x01, 0xDD, 0xF7, 0x30, 0x18, 0xED, 0x34,
	0xE7, 0xFF, 0x05, 0xE5, 0x1E, 0xE7, 0xDB, 0xE1,
	0xDC, 0x17, 0xE1, 0x0B, 0x1D, 0xD6, 0x01, 0xF2,
	0x17, 0x24, 0x45, 0xD8, 0xD8, 0xF2, 0xE9, 0xE1,
	0xD1, 0xEF, 0x07, 0x2D, 0x07, 0xF8, 0x07, 0xB7,
	0x13, 0x3C, 0xCA, 0xDB, 0x00, 0xC8, 0x2B, 0xFC,
	0xE4, 0xFF, 0x33, 0x0B, 0x1A, 0x2C, 0xE3, 0x05,
	0x1D, 0x16, 0xED, 0xB3, 0x10, 0xFF, 0xD4, 0x09,
	0x11, 0xFD, 0x01, 0x4A, 0xF8, 0xF4, 0x45, 0x15,
	0x4F, 0x08, 0x17, 0x13, 0x0B, 0xCE, 0xE9, 0xB4,
	0x07, 0x0B, 0xD5, 0x15, 0xF3, 0xE9, 0x0E, 0xE7,
	0xF5, 0xFA, 0x10, 0x01, 0xAD, 0xE5, 0xF3, 0xFC,
	0xE6, 0xFE, 0xCE, 0xDE, 0x40, 0xE7, 0x1F, 0x3D,
	0x0E, 0x20, 0x19, 0xFC, 0xF9, 0xF7, 0xC1, 0xDE,
	0x48, 0xFB, 0x07, 0x09, 0x20, 0x13, 0x23, 0xEA,
	0xED, 0xF3, 0x0F, 0x2C, 0xE1, 0x22, 0xD5, 0xD6,
	0xB7, 0x69, 0x05, 0x58, 0x23, 0xD1, 0xF5, 0xA0,
	0xE3, 0x10, 0x26, 0xFE, 0x19, 0x3B, 0x1D, 0xF6,
	0xFE, 0x2E, 0x0D, 0xF5, 0x38, 0xF4, 0xCB, 0xE3,
	0x4D, 0xFE, 0xE6, 0x6B, 0xF5, 0xCC, 0xCA, 0xDA,
	0xD5, 0xEA, 0x1D, 0x35, 0x06, 0x0B, 0x1E, 0x17,
	0xC5, 0xD4, 0x04, 0xF0, 0x03, 0xFE, 0x04, 0xD3,
	0x1E, 0xD2, 0x0B, 0x08, 0xCD, 0xC1, 0xDF, 0xFE,
	0xF7, 0xDB, 0xD0, 0x03, 0x4F, 0xE7, 0x0D, 0x1A
	};

ZTEST(basicmath_q7_benchmark, test_benchmark_vec_add_q7)
{
	uint32_t irq_key, timestamp, timespan;
	q7_t *output;

	/* Allocate output buffer */
	output = malloc(PATTERN_LENGTH * sizeof(q7_t));
	zassert_not_null(output, "output buffer allocation failed");

	/* Begin benchmark */
	benchmark_begin(&irq_key, &timestamp);

	/* Execute function */
	arm_add_q7(input1, input2, output, PATTERN_LENGTH);

	/* End benchmark */
	timespan = benchmark_end(irq_key, timestamp);

	/* Free output buffer */
	free(output);

	/* Print result */
	TC_PRINT(BENCHMARK_TYPE " = %u\n", timespan);
}

ZTEST(basicmath_q7_benchmark, test_benchmark_vec_sub_q7)
{
	uint32_t irq_key, timestamp, timespan;
	q7_t *output;

	/* Allocate output buffer */
	output = malloc(PATTERN_LENGTH * sizeof(q7_t));
	zassert_not_null(output, "output buffer allocation failed");

	/* Begin benchmark */
	benchmark_begin(&irq_key, &timestamp);

	/* Execute function */
	arm_sub_q7(input1, input2, output, PATTERN_LENGTH);

	/* End benchmark */
	timespan = benchmark_end(irq_key, timestamp);

	/* Free output buffer */
	free(output);

	/* Print result */
	TC_PRINT(BENCHMARK_TYPE " = %u\n", timespan);
}

ZTEST(basicmath_q7_benchmark, test_benchmark_vec_mult_q7)
{
	uint32_t irq_key, timestamp, timespan;
	q7_t *output;

	/* Allocate output buffer */
	output = malloc(PATTERN_LENGTH * sizeof(q7_t));
	zassert_not_null(output, "output buffer allocation failed");

	/* Begin benchmark */
	benchmark_begin(&irq_key, &timestamp);

	/* Execute function */
	arm_mult_q7(input1, input2, output, PATTERN_LENGTH);

	/* End benchmark */
	timespan = benchmark_end(irq_key, timestamp);

	/* Free output buffer */
	free(output);

	/* Print result */
	TC_PRINT(BENCHMARK_TYPE " = %u\n", timespan);
}

ZTEST(basicmath_q7_benchmark, test_benchmark_vec_abs_q7)
{
	uint32_t irq_key, timestamp, timespan;
	q7_t *output;

	/* Allocate output buffer */
	output = malloc(PATTERN_LENGTH * sizeof(q7_t));
	zassert_not_null(output, "output buffer allocation failed");

	/* Begin benchmark */
	benchmark_begin(&irq_key, &timestamp);

	/* Execute function */
	arm_abs_q7(input1, output, PATTERN_LENGTH);

	/* End benchmark */
	timespan = benchmark_end(irq_key, timestamp);

	/* Free output buffer */
	free(output);

	/* Print result */
	TC_PRINT(BENCHMARK_TYPE " = %u\n", timespan);
}

ZTEST(basicmath_q7_benchmark, test_benchmark_vec_negate_q7)
{
	uint32_t irq_key, timestamp, timespan;
	q7_t *output;

	/* Allocate output buffer */
	output = malloc(PATTERN_LENGTH * sizeof(q7_t));
	zassert_not_null(output, "output buffer allocation failed");

	/* Begin benchmark */
	benchmark_begin(&irq_key, &timestamp);

	/* Execute function */
	arm_negate_q7(input1, output, PATTERN_LENGTH);

	/* End benchmark */
	timespan = benchmark_end(irq_key, timestamp);

	/* Free output buffer */
	free(output);

	/* Print result */
	TC_PRINT(BENCHMARK_TYPE " = %u\n", timespan);
}

ZTEST(basicmath_q7_benchmark, test_benchmark_vec_offset_q7)
{
	uint32_t irq_key, timestamp, timespan;
	q7_t *output;

	/* Allocate output buffer */
	output = malloc(PATTERN_LENGTH * sizeof(q7_t));
	zassert_not_null(output, "output buffer allocation failed");

	/* Begin benchmark */
	benchmark_begin(&irq_key, &timestamp);

	/* Execute function */
	arm_offset_q7(input1, 1.0, output, PATTERN_LENGTH);

	/* End benchmark */
	timespan = benchmark_end(irq_key, timestamp);

	/* Free output buffer */
	free(output);

	/* Print result */
	TC_PRINT(BENCHMARK_TYPE " = %u\n", timespan);
}

ZTEST(basicmath_q7_benchmark, test_benchmark_vec_scale_q7)
{
	uint32_t irq_key, timestamp, timespan;
	q7_t *output;

	/* Allocate output buffer */
	output = malloc(PATTERN_LENGTH * sizeof(q7_t));
	zassert_not_null(output, "output buffer allocation failed");

	/* Begin benchmark */
	benchmark_begin(&irq_key, &timestamp);

	/* Execute function */
	arm_scale_q7(input1, 0x45, 1, output, PATTERN_LENGTH);

	/* End benchmark */
	timespan = benchmark_end(irq_key, timestamp);

	/* Free output buffer */
	free(output);

	/* Print result */
	TC_PRINT(BENCHMARK_TYPE " = %u\n", timespan);
}

ZTEST(basicmath_q7_benchmark, test_benchmark_vec_dot_prod_q7)
{
	uint32_t irq_key, timestamp, timespan;
	q31_t output;

	/* Begin benchmark */
	benchmark_begin(&irq_key, &timestamp);

	/* Execute function */
	arm_dot_prod_q7(input1, input2, PATTERN_LENGTH, &output);

	/* End benchmark */
	timespan = benchmark_end(irq_key, timestamp);

	/* Print result */
	TC_PRINT(BENCHMARK_TYPE " = %u\n", timespan);
}

ZTEST_SUITE(basicmath_q7_benchmark, NULL, NULL, NULL, NULL, NULL);
```
