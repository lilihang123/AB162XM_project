## CMakeLists.txt
```
# SPDX-License-Identifier: Apache-2.0

cmake_minimum_required(VERSION 3.20.0)
find_package(Zephyr REQUIRED HINTS $ENV{ZEPHYR_BASE})
project(sched_userspace_bench)

set_property(
   SOURCE src/user.c
   PROPERTY COMPILE_DEFINITIONS
   __ZEPHYR_USER__
)

set_property(
   SOURCE src/main.c
   PROPERTY COMPILE_DEFINITIONS
   __ZEPHYR_SUPERVISOR__
)

target_sources(app PRIVATE src/main.c src/user.c)

target_include_directories(app PRIVATE
  ${ZEPHYR_BASE}/kernel/include
  ${ZEPHYR_BASE}/arch/${ARCH}/include
  )
```

## prj.conf
```kconfig
CONFIG_TEST=y
CONFIG_USERSPACE=y
CONFIG_MAX_THREAD_BYTES=8
CONFIG_MAX_XLAT_TABLES=1024
CONFIG_SCHED_MULTIQ=y
CONFIG_SPEED_OPTIMIZATIONS=y
CONFIG_FORCE_NO_ASSERT=y
```

## src/main.c
```c
/*
 * Copyright (c) 2019 Intel Corporation
 *
 * SPDX-License-Identifier: Apache-2.0
 */

#include <zephyr/kernel.h>
#include <zephyr/sys/printk.h>

/* private kernel APIs */
#include <wait_q.h>
#include <ksched.h>

#include "app_threads.h"
#include "user.h"

#define MAIN_PRIO 8
#define THREADS_PRIO 9

enum {
	MEAS_START,
	MEAS_END,
	NUM_STAMP_STATES
};

uint32_t stamps[NUM_STAMP_STATES];

static inline int stamp(int state)
{
	uint32_t t;

	/* In theory the TSC has much lower overhead and higher
	 * precision.  In practice it's VERY jittery in recent qemu
	 * versions and frankly too noisy to trust.
	 */
#ifdef CONFIG_X86
	__asm__ volatile("rdtsc" : "=a"(t) : : "edx");
#else
	t = k_cycle_get_32();
#endif

	stamps[state] = t;
	return t;
}

static int yielder_status;

void yielder_entry(void *_thread, void *_tid, void *_nb_threads)
{
	struct k_app_thread *thread = (struct k_app_thread *) _thread;
	int ret;

	struct k_mem_partition *parts[] = {
		thread->partition,
	};

	ret = k_mem_domain_init(&thread->domain, ARRAY_SIZE(parts), parts);
	if (ret != 0) {
		printk("k_mem_domain_init failed %d\n", ret);
		yielder_status = 1;
		return;
	}

	k_mem_domain_add_thread(&thread->domain, k_current_get());

	k_thread_user_mode_enter(context_switch_yield, _nb_threads, NULL, NULL);
}


static k_tid_t threads[MAX_NB_THREADS];

static int exec_test(uint8_t nb_threads)
{
	if (nb_threads > MAX_NB_THREADS) {
		printk("Too many threads\n");
		return 1;
	}

	yielder_status = 0;

	for (size_t tid = 0; tid < nb_threads; tid++) {
		app_threads[tid].partition = app_partitions[tid];
		app_threads[tid].stack = &app_thread_stacks[tid];

		void *_tid = (void *)(uintptr_t)tid;

		threads[tid] = k_thread_create(&app_threads[tid].thread,
					app_thread_stacks[tid],
					APP_STACKSIZE, yielder_entry,
					&app_threads[tid], _tid, (void *)(uintptr_t)nb_threads,
					THREADS_PRIO, 0, K_FOREVER);
	}

	/* make sure the main thread has a higher priority
	 * this way, user threads all start together
	 * (lower number --> higher prio)
	 */
	k_thread_priority_set(k_current_get(), MAIN_PRIO);

	stamp(MEAS_START);
	for (size_t tid = 0; tid < nb_threads; tid++) {
		k_thread_start(threads[tid]);
	}
	for (size_t tid = 0; tid < nb_threads; tid++) {
		k_thread_join(threads[tid], K_FOREVER);
	}
	stamp(MEAS_END);

	uint32_t full_time = stamps[MEAS_END] - stamps[MEAS_START];
	uint64_t time_ms = k_cyc_to_ns_near64(full_time)/NB_YIELDS;

	printk("Swapping %2u threads: %8" PRIu32 " cyc & %6" PRIu32 " rounds -> %6"
				PRIu64 " ns per ctx\n", nb_threads, full_time,
				NB_YIELDS, time_ms);

	return yielder_status;
}


int main(void)
{
	int ret;

	printk("Userspace scheduling benchmark started on board %s\n", CONFIG_BOARD);

	size_t nb_threads_list[] = {2, 8, 16, 32, 0};

	printk("============================\n");
	printk("user/user^n swapping (yield)\n");

	for (size_t i = 0; nb_threads_list[i] > 0; i++) {
		ret = exec_test(nb_threads_list[i]);
		if (ret != 0) {
			printk("FAIL\n");
			return 0;
		}
	}

	printk("SUCCESS\n");
	return 0;
}
```

## src/app_threads.h
```c
/*
 * Copyright (c) 2022 Huawei Technologies SASU
 *
 * SPDX-License-Identifier: Apache-2.0
 */

#pragma once

#include <zephyr/app_memory/app_memdomain.h>

#define MAX_NB_THREADS 50

#define APP_STACKSIZE 1024

struct k_app_thread {
	struct k_thread thread;
	struct k_mem_domain domain;
	void *stack;
	struct k_mem_partition *partition;
};

struct k_app_thread app_threads[MAX_NB_THREADS];

/* Generate threads data structures */
#define DEFINE_THREADS_HELPER(nb) \
	K_THREAD_STACK_DEFINE(app_##nb##_stack, APP_STACKSIZE); \
	K_APPMEM_PARTITION_DEFINE(app_##nb##_partition); \
	K_APP_DMEM(app_##nb##_partition) int dummy##nb; /* Need data in each partition */

#define DEFINE_THREADS_HELPER_10(nb0, nb1, nb2, nb3, nb4, nb5, nb6, nb7, nb8, nb9) \
	DEFINE_THREADS_HELPER(nb0) \
	DEFINE_THREADS_HELPER(nb1) \
	DEFINE_THREADS_HELPER(nb2) \
	DEFINE_THREADS_HELPER(nb3) \
	DEFINE_THREADS_HELPER(nb4) \
	DEFINE_THREADS_HELPER(nb5) \
	DEFINE_THREADS_HELPER(nb6) \
	DEFINE_THREADS_HELPER(nb7) \
	DEFINE_THREADS_HELPER(nb8) \
	DEFINE_THREADS_HELPER(nb9)

DEFINE_THREADS_HELPER_10(1,   2,  3,  4,  5,  6,  7,  8,  9, 10)
DEFINE_THREADS_HELPER_10(11, 12, 13, 14, 15, 16, 17, 18, 19, 20)
DEFINE_THREADS_HELPER_10(21, 22, 23, 24, 25, 26, 27, 28, 29, 30)
DEFINE_THREADS_HELPER_10(31, 32, 33, 34, 35, 36, 37, 38, 39, 40)
DEFINE_THREADS_HELPER_10(41, 42, 43, 44, 45, 46, 47, 48, 49, 50)

void *app_thread_stacks[MAX_NB_THREADS] = {
	app_1_stack, app_2_stack, app_3_stack, app_4_stack, app_5_stack,
	app_6_stack, app_7_stack, app_8_stack, app_9_stack, app_10_stack,
	app_11_stack, app_12_stack, app_13_stack, app_14_stack, app_15_stack,
	app_16_stack, app_17_stack, app_18_stack, app_19_stack, app_20_stack,
	app_21_stack, app_22_stack, app_23_stack, app_24_stack, app_25_stack,
	app_26_stack, app_27_stack, app_28_stack, app_29_stack, app_30_stack,
	app_31_stack, app_32_stack, app_33_stack, app_34_stack, app_35_stack,
	app_36_stack, app_37_stack, app_38_stack, app_39_stack, app_40_stack,
	app_41_stack, app_42_stack, app_43_stack, app_44_stack, app_45_stack,
	app_46_stack, app_47_stack, app_48_stack, app_49_stack, app_50_stack
};

struct k_mem_partition *app_partitions[MAX_NB_THREADS] = {
	&app_1_partition, &app_2_partition, &app_3_partition, &app_4_partition,
	&app_5_partition, &app_6_partition, &app_7_partition, &app_8_partition,
	&app_9_partition, &app_10_partition,
	&app_11_partition, &app_12_partition, &app_13_partition, &app_14_partition,
	&app_15_partition, &app_16_partition, &app_17_partition, &app_18_partition,
	&app_19_partition, &app_20_partition,
	&app_21_partition, &app_22_partition, &app_23_partition, &app_24_partition,
	&app_25_partition, &app_26_partition, &app_27_partition, &app_28_partition,
	&app_29_partition, &app_30_partition,
	&app_31_partition, &app_32_partition, &app_33_partition, &app_34_partition,
	&app_35_partition, &app_36_partition, &app_37_partition, &app_38_partition,
	&app_39_partition, &app_40_partition,
	&app_41_partition, &app_42_partition, &app_43_partition, &app_44_partition,
	&app_45_partition, &app_46_partition, &app_47_partition, &app_48_partition,
	&app_49_partition, &app_50_partition
};

struct k_mem_domain app_domains[MAX_NB_THREADS];
```

## src/user.c
```c
/*
 * Copyright (c) 2022 Huawei Technologies SASU
 *
 * SPDX-License-Identifier: Apache-2.0
 */

#include <stddef.h>
#include <stdint.h>
#include <zephyr/kernel.h>

#include "user.h"

void context_switch_yield(void *p1, void *p2, void *p3)
{
	uint32_t nb_threads = (uint32_t)(uintptr_t) p1;
	uint32_t rounds = NB_YIELDS / nb_threads;

	while (rounds--) {
		k_yield();
	}
}
```

## src/user.h
```c
/*
 * Copyright (c) 2022 Huawei Technologies SASU
 *
 * SPDX-License-Identifier: Apache-2.0
 */

#define NB_YIELDS UINT32_C(1000000)

void context_switch_yield(void *p1, void *p2, void *p3);
```
