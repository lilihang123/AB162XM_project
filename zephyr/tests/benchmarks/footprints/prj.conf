## CMakeLists.txt
```
# SPDX-License-Identifier: Apache-2.0

cmake_minimum_required(VERSION 3.20.0)
find_package(Zephyr REQUIRED HINTS $ENV{ZEPHYR_BASE})
project(common_kernel_footprint)

FILE(GLOB app_sources src/[^up]*.c)
target_sources(app PRIVATE ${app_sources})
target_sources_ifdef(CONFIG_USERSPACE app PRIVATE src/userspace.c)
target_sources_ifdef(CONFIG_PM_DEVICE app PRIVATE src/pm_device.c)

target_include_directories(app PRIVATE
  ${ZEPHYR_BASE}/kernel/include
  ${ZEPHYR_BASE}/arch/${ARCH}/include
  )
```

## prj.conf
```kconfig
CONFIG_HEAP_MEM_POOL_SIZE=256
CONFIG_MAIN_STACK_SIZE=2048
CONFIG_MP_MAX_NUM_CPUS=1
CONFIG_THREAD_NAME=y
CONFIG_LOG=y
CONFIG_LOG_MODE_MINIMAL=y
```

## prj_pm.conf
```kconfig
CONFIG_HEAP_MEM_POOL_SIZE=256
CONFIG_MAIN_STACK_SIZE=2048
CONFIG_MP_MAX_NUM_CPUS=1
CONFIG_PM=y
CONFIG_PM_DEVICE=y
CONFIG_PM_DEVICE_RUNTIME=y
CONFIG_THREAD_NAME=y
CONFIG_LOG=y
CONFIG_LOG_MODE_MINIMAL=y
```

## prj_userspace.conf
```kconfig
CONFIG_HEAP_MEM_POOL_SIZE=256
CONFIG_MAIN_STACK_SIZE=2048
CONFIG_MP_MAX_NUM_CPUS=1
CONFIG_LOG=y
CONFIG_LOG_MODE_MINIMAL=y
CONFIG_THREAD_NAME=y
CONFIG_TEST_USERSPACE=y
CONFIG_DYNAMIC_OBJECTS=y
CONFIG_HW_STACK_PROTECTION=y
CONFIG_APPLICATION_DEFINED_SYSCALL=y
```

## src/main.c
```c
/*
 * Copyright (c) 2013-2015 Wind River Systems, Inc.
 * Copyright (c) 2016-2020 Intel Corporation.
 *
 * SPDX-License-Identifier: Apache-2.0
 */

/**
 * @file
 * @brief Measure time
 *
 */
#include <zephyr/kernel.h>
#include <ksched.h>
#include <zephyr/sys/libc-hooks.h>
#include "footprint.h"

#ifdef CONFIG_USERSPACE
K_APPMEM_PARTITION_DEFINE(footprint_mem_partition);
struct k_mem_domain footprint_mem_domain;
#endif

K_THREAD_STACK_DEFINE(my_stack_area, STACK_SIZE);
K_THREAD_STACK_DEFINE(my_stack_area_0, STACK_SIZE);

struct k_thread my_thread;
struct k_thread my_thread_0;

extern void run_heap_malloc_free(void);
extern void run_libc(void);
extern void run_mutex(void);
extern void run_pm_device(void);
extern void run_semaphore(void);
extern void run_thread_system(void);
extern void run_timer(void);
extern void run_userspace(void);
extern void run_workq(void);

int main(void)
{
	printk("Hello from %s!\n", CONFIG_BOARD);

#ifdef CONFIG_USERSPACE
	int ret;
	struct k_mem_partition *mem_parts[] = {
#if Z_LIBC_PARTITION_EXISTS
		&z_libc_partition,
#endif
		&footprint_mem_partition
	};

	ret = k_mem_domain_init(&footprint_mem_domain,
				ARRAY_SIZE(mem_parts), mem_parts);
	__ASSERT_NO_MSG(ret == 0);
	ARG_UNUSED(ret);
#endif /* CONFIG_USERSPACE */

	run_thread_system();

	run_heap_malloc_free();

	run_semaphore();

	run_mutex();

	run_timer();

	run_libc();

	run_workq();

#ifdef CONFIG_PM_DEVICE
	run_pm_device();
#endif

#ifdef CONFIG_USERSPACE
	run_userspace();
#endif

	printk("PROJECT EXECUTION SUCCESSFUL\n");
	return 0;
}
```

## src/footprint.h
```c
/*
 * Copyright (c) 2020 Intel Corporation.
 *
 * SPDX-License-Identifier: Apache-2.0
 */

#ifndef _FOOTPRINT_H_
#define _FOOTPRINT_H_

#include <zephyr/kernel.h>
#include <zephyr/app_memory/app_memdomain.h>

#define STACK_SIZE	512

K_THREAD_STACK_DECLARE(my_stack_area, STACK_SIZE);
K_THREAD_STACK_DECLARE(my_stack_area_0, STACK_SIZE);
extern struct k_thread my_thread;
extern struct k_thread my_thread_0;

#ifdef CONFIG_USERSPACE
#define FP_DMEM		K_APP_DMEM(footprint_mem_partition)
#define FP_BMEM		K_APP_BMEM(footprint_mem_partition)
extern struct k_mem_partition footprint_mem_partition;
extern struct k_mem_domain footprint_mem_domain;
#else
#define FP_DMEM
#define FP_BMEM
#endif

#endif /* _FOOTPRINT_H_ */
```

## src/heap.c
```c
/*
 * Copyright (c) 2013-2015 Wind River Systems, Inc.
 * Copyright (c) 2016-2020 Intel Corporation.
 *
 * SPDX-License-Identifier: Apache-2.0
 */

/**
 * @file
 * @brief Measure time
 *
 */
#include <zephyr/kernel.h>
#include <ksched.h>

#include "footprint.h"

void run_heap_malloc_free(void)
{
	void *allocated_mem = k_malloc(10);

	if (allocated_mem == NULL) {
		printk("\n Malloc failed\n");
		return;
	}

	k_free(allocated_mem);
}
```

## src/libc.c
```c
/*
 * Copyright (c) 2020 Intel Corporation.
 *
 * SPDX-License-Identifier: Apache-2.0
 */

#undef _POSIX_C_SOURCE
#define _POSIX_C_SOURCE 200809L

#include <zephyr/kernel.h>
#include <ksched.h>

#include "footprint.h"

static const char const_string[] = "String!\n";
static char new_string[32];

void run_libc(void)
{
	int len;

	len = strlen(const_string);
	len = strnlen(const_string, len);

	memset(new_string, 0, sizeof(new_string));
	if (memcmp(const_string, new_string, 0) != 0) {
		/* avoid unused return error */
	}
	if (memcmp(const_string, new_string, len) != 0) {
		/* avoid unused return error */
	}

	strcpy(new_string, const_string);
	strncpy(new_string, const_string, len);
}
```

## src/mutex.c
```c
/*
 * Copyright (c) 2020 Intel Corporation.
 *
 * SPDX-License-Identifier: Apache-2.0
 */

#include <zephyr/kernel.h>

#include "footprint.h"

#define STACK_SIZE	512

K_MUTEX_DEFINE(user_mutex);

#ifdef CONFIG_USERSPACE
static void user_thread_fn(void *arg1, void *arg2, void *arg3)
{
	ARG_UNUSED(arg1);
	ARG_UNUSED(arg2);
	ARG_UNUSED(arg3);

	k_mutex_lock(&user_mutex, K_FOREVER);

	k_mutex_unlock(&user_mutex);
}

static void run_user_mutex(void)
{
	k_tid_t tid;

	/* Exercise simple workqueue */
	tid = k_thread_create(&my_thread, my_stack_area, STACK_SIZE,
			      user_thread_fn, NULL, NULL, NULL,
			      0, K_USER, K_FOREVER);
	k_object_access_grant(&user_mutex, tid);

	k_thread_start(tid);
	k_thread_join(tid, K_FOREVER);
}
#endif /* CONFIG_USERSPACE */

static void run_system_mutex(void)
{
	struct k_mutex sys_mutex;

	k_mutex_init(&sys_mutex);

	k_mutex_lock(&sys_mutex, K_FOREVER);

	k_mutex_unlock(&sys_mutex);
}

void run_mutex(void)
{
	run_system_mutex();

#ifdef CONFIG_USERSPACE
	run_user_mutex();
#endif
}
```

## src/pm_device.c
```c
/*
 * Copyright (c) 2021 Google, LLC
 *
 * SPDX-License-Identifier: Apache-2.0
 */

/**
 * @file
 * @brief Stub driver to measure the footprint impact of power management
 *
 */
#include <zephyr/device.h>
#include <zephyr/pm/device.h>
#include <zephyr/pm/device_runtime.h>

#define DUMMY_PM_DRIVER_NAME	"dummy_pm_driver"
#define DUMMY_DRIVER_NAME	"dummy_driver"

static int dummy_device_pm_action(const struct device *dev,
				  enum pm_device_action action)
{
	return 0;
}

/* Define a driver with and without power management enabled */
PM_DEVICE_DEFINE(dummy_pm_driver, dummy_device_pm_action);

DEVICE_DEFINE(dummy_pm_driver, DUMMY_PM_DRIVER_NAME, NULL,
	      PM_DEVICE_GET(dummy_pm_driver), NULL, NULL, POST_KERNEL,
	      CONFIG_KERNEL_INIT_PRIORITY_DEFAULT, NULL);

DEVICE_DEFINE(dummy_driver, DUMMY_DRIVER_NAME, NULL, NULL, NULL, NULL,
	      POST_KERNEL, CONFIG_KERNEL_INIT_PRIORITY_DEFAULT, NULL);

void run_pm_device(void)
{
	const struct device *dev;
	enum pm_device_state pm_state;

	/* Get the PM state from a device with PM support */
	dev = device_get_binding(DUMMY_PM_DRIVER_NAME);
	if (pm_device_state_get(dev, &pm_state)) {
		printk("\n PM device get state failed\n");
		return;
	}

	if (pm_device_runtime_get(dev)) {
		printk("\n PM device runtime get failed\n");
		return;
	}

	if (pm_device_runtime_put(dev)) {
		printk("\n PM device runtime put failed\n");
		return;
	}

	/* Get the PM state from a device without PM support */
	dev = device_get_binding(DUMMY_DRIVER_NAME);
	if (pm_device_state_get(dev, &pm_state) != ENOSYS) {
		printk("\n PM device get state did not fail\n");
		return;
	}
}
```

## src/semaphore.c
```c
/*
 * Copyright (c) 2017-2020 Intel Corporation.
 *
 * SPDX-License-Identifier: Apache-2.0
 */

#include <zephyr/kernel.h>
#include <ksched.h>

#include "footprint.h"

#define STACK_SIZE	512

K_SEM_DEFINE(semaphore0, 0, 1);

void thread_fn(void *p1, void *p2, void *p3)
{
	k_sem_give(&semaphore0);

	k_sem_take(&semaphore0, K_FOREVER);
}

void run_semaphore(void)
{
	k_tid_t sem0_tid;
	struct k_sem sem0;

	k_sem_init(&sem0, 0, 1);

	k_sem_give(&sem0);

	k_sem_take(&sem0, K_FOREVER);

	sem0_tid = k_thread_create(&my_thread, my_stack_area,
				   STACK_SIZE, thread_fn,
				   NULL, NULL, NULL,
				   0, 0, K_NO_WAIT);

	k_thread_join(sem0_tid, K_FOREVER);

#ifdef CONFIG_USERSPACE
	sem0_tid = k_thread_create(&my_thread, my_stack_area,
				   STACK_SIZE, thread_fn,
				   NULL, NULL, NULL,
				   0, K_USER, K_FOREVER);

	k_object_access_grant(&semaphore0, sem0_tid);

	k_thread_start(sem0_tid);
	k_thread_join(sem0_tid, K_FOREVER);
#endif
}
```

## src/system_thread.c
```c
/*
 * Copyright (c) 2013-2015 Wind River Systems, Inc.
 * Copyright (c) 2016-2020 Intel Corporation.
 *
 * SPDX-License-Identifier: Apache-2.0
 */

/**
 * @file
 * @brief Measure time
 *
 */
#include <zephyr/kernel.h>
#include <ksched.h>

#include "footprint.h"

#define STACK_SIZE	512

K_SEM_DEFINE(yield_sem, 0, 1);

void test_thread_entry(void *p, void *p1, void *p2)
{
	static int i;

	i++;
}

void thread_swap(void *p1, void *p2, void *p3)
{
	k_thread_abort(_current);
}

void thread_suspend(void *p1, void *p2, void *p3)
{
	k_thread_suspend(_current);
}

void thread_yield0(void *p1, void *p2, void *p3)
{
	uint32_t count = 0;

	k_sem_take(&yield_sem, K_MSEC(10));

	while (count != 1000U) {
		count++;
		k_yield();
	}
}

void thread_yield1(void *p1, void *p2, void *p3)
{
	k_sem_give(&yield_sem);
	while (1) {
		k_yield();
	}
}

void run_thread_system(void)
{
	int prio;
	k_tid_t yield0_tid;
	k_tid_t yield1_tid;

	k_tid_t my_tid = k_thread_create(&my_thread, my_stack_area,
					 STACK_SIZE,
					 thread_swap,
					 NULL, NULL, NULL,
					 5 /*priority*/, 0, K_FOREVER);

	k_thread_priority_set(my_tid, 5);
	prio = k_thread_priority_get(my_tid);
	if (prio != 5) {
		printk("thread priority is not set to 5!\n");
	}

	k_thread_start(my_tid);

	k_thread_abort(my_tid);

	k_tid_t sus_res_tid = k_thread_create(&my_thread, my_stack_area,
					      STACK_SIZE,
					      thread_suspend,
					      NULL, NULL, NULL,
					      -1 /*priority*/, 0, K_NO_WAIT);

	k_thread_resume(sus_res_tid);

	k_thread_join(sus_res_tid, K_FOREVER);

	k_sleep(K_MSEC(10));

	yield0_tid = k_thread_create(&my_thread, my_stack_area,
				     STACK_SIZE,
				     thread_yield0,
				     NULL, NULL, NULL,
				     0 /*priority*/, 0, K_NO_WAIT);

	yield1_tid = k_thread_create(&my_thread_0, my_stack_area_0,
				     STACK_SIZE,
				     thread_yield1,
				     NULL, NULL, NULL,
				     0 /*priority*/, 0, K_NO_WAIT);

	k_sleep(K_MSEC(1000));

	k_thread_abort(yield0_tid);
	k_thread_abort(yield1_tid);
}
```

## src/timer.c
```c
/*
 * Copyright (c) 2020 Intel Corporation.
 *
 * SPDX-License-Identifier: Apache-2.0
 */

#include <zephyr/kernel.h>
#include <ksched.h>

#include "footprint.h"

#define DURATION	100
#define PERIOD		50
#define EXPIRE_TIMES	4

struct timer_data {
	uint32_t expire_cnt;
	uint32_t stop_cnt;
	int64_t timestamp;
};

static struct k_timer timer0;
static FP_BMEM struct timer_data tdata;

static void init_timer_data(void)
{
	tdata.expire_cnt = 0;
	tdata.stop_cnt = 0;
}

static void timer_init(struct k_timer *timer, k_timer_expiry_t expiry_fn,
		       k_timer_stop_t stop_fn)
{
	k_object_access_grant(timer, k_current_get());
	k_timer_init(timer, expiry_fn, stop_fn);
}

static void timer_stop(struct k_timer *timer)
{
	tdata.stop_cnt++;
}

static void timer_expire(struct k_timer *timer)
{
	tdata.expire_cnt++;
}

static void busy_wait_ms(int32_t ms)
{
	k_busy_wait(ms*1000);
}

static void thread_fn(void *arg1, void *arg2, void *arg3)
{
	ARG_UNUSED(arg1);
	ARG_UNUSED(arg2);
	ARG_UNUSED(arg3);

	init_timer_data();
	k_timer_start(&timer0, K_MSEC(DURATION), K_MSEC(PERIOD));
	tdata.timestamp = k_uptime_get();
	busy_wait_ms(DURATION + PERIOD * EXPIRE_TIMES + PERIOD / 2);
	k_timer_stop(&timer0);

	init_timer_data();
	k_timer_start(&timer0, K_MSEC(DURATION), K_MSEC(PERIOD));

	/* Call the k_timer_start() again to make sure that
	 * the initial timeout request gets cancelled and new
	 * one will get added.
	 */
	busy_wait_ms(DURATION / 2);
	k_timer_start(&timer0, K_MSEC(DURATION), K_MSEC(PERIOD));
	tdata.timestamp = k_uptime_get();
	busy_wait_ms(DURATION + PERIOD * EXPIRE_TIMES + PERIOD / 2);

	k_timer_stop(&timer0);
}

void run_timer(void)
{
	k_tid_t tid;

	timer_init(&timer0, timer_expire, timer_stop);

	tid = k_thread_create(&my_thread, my_stack_area, STACK_SIZE,
			      thread_fn, NULL, NULL, NULL,
			      0, 0, K_NO_WAIT);

	k_thread_join(tid, K_FOREVER);

#ifdef CONFIG_USERSPACE
	tid = k_thread_create(&my_thread, my_stack_area, STACK_SIZE,
			      thread_fn, NULL, NULL, NULL,
			      0, K_USER, K_NO_WAIT);

	k_mem_domain_add_thread(&footprint_mem_domain, tid);

	k_thread_access_grant(tid, &timer0);
	k_thread_start(tid);

	k_thread_join(tid, K_FOREVER);

#endif
}
```

## src/userspace.c
```c
/*
 * Copyright (c) 2016-2020 Intel Corporation.
 *
 * SPDX-License-Identifier: Apache-2.0
 */

/**
 * @file
 * @brief Measure time
 *
 */
#include <zephyr/kernel.h>
#include <ksched.h>
#include <zephyr/internal/syscall_handler.h>
#include <zephyr/app_memory/app_memdomain.h>

#include "footprint.h"
#include "userspace.h"

#define STACK_SIZE	512

K_SEM_DEFINE(test_sema, 1, 10);

struct k_thread my_thread_user;

int z_impl_dummy_syscall(void)
{
	return 0;
}

static inline int z_vrfy_dummy_syscall(void)
{
	return 0;
}
#include <zephyr/syscalls/dummy_syscall_mrsh.c>

int z_impl_validation_overhead_syscall(void)
{
	return 0;
}

static inline int z_vrfy_validation_overhead_syscall(void)
{
	bool status_0 = K_SYSCALL_OBJ_INIT(&test_sema, K_OBJ_SEM);

	bool status_1 = K_SYSCALL_OBJ(&test_sema, K_OBJ_SEM);

	return status_0 || status_1;
}
#include <zephyr/syscalls/validation_overhead_syscall_mrsh.c>


void test_drop_to_user_mode_1(void *p1, void *p2, void *p3)
{
	volatile uint32_t dummy = 100U;

	dummy++;
}

void drop_to_user_mode_thread(void *p1, void *p2, void *p3)
{
	k_thread_user_mode_enter(test_drop_to_user_mode_1, NULL, NULL, NULL);
}

void drop_to_user_mode(void)
{
	k_thread_create(&my_thread_user, my_stack_area_0, STACK_SIZE,
			drop_to_user_mode_thread,
			NULL, NULL, NULL,
			-1, K_INHERIT_PERMS, K_NO_WAIT);

	k_yield();
}

void user_thread_creation(void)
{
	k_thread_create(&my_thread_user, my_stack_area, STACK_SIZE,
			test_drop_to_user_mode_1,
			NULL, NULL, NULL,
			0, K_INHERIT_PERMS | K_USER, K_FOREVER);

	k_thread_abort(&my_thread_user);
}

void syscall_overhead_user_thread(void *p1, void *p2, void *p3)
{
	int val = dummy_syscall();

	val |= 0xFF;
}

void syscall_overhead(void)
{
	k_thread_create(&my_thread_user, my_stack_area_0, STACK_SIZE,
			syscall_overhead_user_thread,
			NULL, NULL, NULL,
			-1, K_INHERIT_PERMS | K_USER, K_NO_WAIT);
}

void validation_overhead_user_thread(void *p1, void *p2, void *p3)
{
	/* get validation numbers */
	validation_overhead_syscall();
}

void validation_overhead(void)
{
	k_thread_access_grant(k_current_get(), &test_sema);

	k_thread_create(&my_thread_user, my_stack_area, STACK_SIZE,
			validation_overhead_user_thread,
			NULL, NULL, NULL,
			-1 /*priority*/, K_INHERIT_PERMS | K_USER, K_NO_WAIT);
}

void run_userspace(void)
{
	k_mem_domain_add_thread(&footprint_mem_domain, k_current_get());

	drop_to_user_mode();

	user_thread_creation();

	syscall_overhead();

	validation_overhead();

}
```

## src/userspace.h
```c
/*
 * Copyright (c) 2020 Intel Corporation.
 *
 * SPDX-License-Identifier: Apache-2.0
 */

#ifndef _USERSPACE_H_
#define _USERSPACE_H_

__syscall int dummy_syscall(void);
__syscall int validation_overhead_syscall(void);

#include <zephyr/syscalls/userspace.h>

#endif /* _USERSPACE_H_ */
```

## src/workq.c
```c
/*
 * Copyright (c) 2020 Intel Corporation.
 *
 * SPDX-License-Identifier: Apache-2.0
 */

#include <zephyr/kernel.h>
#include <zephyr/internal/syscall_handler.h>

#include "footprint.h"

static struct k_work_q workq;
static K_THREAD_STACK_DEFINE(workq_stack, STACK_SIZE);

struct k_sem sync_sema;

#if CONFIG_USERSPACE
static struct k_work_user_q user_workq;
static K_THREAD_STACK_DEFINE(user_workq_stack, STACK_SIZE);

static FP_BMEM struct k_work_user user_work_item;

void user_workq_func(struct k_work_user *unused)
{
	ARG_UNUSED(unused);

	k_sem_give(&sync_sema);
}

#endif

void workq_func(struct k_work *unused)
{
	ARG_UNUSED(unused);

	k_sem_give(&sync_sema);
}

void simple_workq_thread(void *arg1, void *arg2, void *arg3)
{
	struct k_work work_item;

	ARG_UNUSED(arg1);
	ARG_UNUSED(arg2);
	ARG_UNUSED(arg3);

	k_sem_reset(&sync_sema);
	k_work_init(&work_item, workq_func);
	k_work_submit_to_queue(&workq, &work_item);

	k_sem_take(&sync_sema, K_FOREVER);
}

void delayed_workq_thread(void *arg1, void *arg2, void *arg3)
{
	struct k_work_delayable work_item;

	ARG_UNUSED(arg1);
	ARG_UNUSED(arg2);
	ARG_UNUSED(arg3);

	k_sem_reset(&sync_sema);
	k_work_init_delayable(&work_item, workq_func);
	k_work_reschedule_for_queue(&workq, &work_item, K_NO_WAIT);

	k_sem_take(&sync_sema, K_FOREVER);
}

#if CONFIG_USERSPACE
void simple_user_workq_thread(void *arg1, void *arg2, void *arg3)
{
	ARG_UNUSED(arg1);
	ARG_UNUSED(arg2);
	ARG_UNUSED(arg3);

	k_sem_reset(&sync_sema);
	k_work_user_init(&user_work_item, user_workq_func);
	k_work_user_submit_to_queue(&user_workq, &user_work_item);

	k_sem_take(&sync_sema, K_FOREVER);
}
#endif

void run_workq(void)
{
	k_tid_t tid;

	k_sem_init(&sync_sema, 0, 1);

	k_work_queue_start(&workq, workq_stack,
			   K_THREAD_STACK_SIZEOF(workq_stack),
			   CONFIG_MAIN_THREAD_PRIORITY, NULL);

	/* Exercise simple workqueue */
	tid = k_thread_create(&my_thread, my_stack_area, STACK_SIZE,
			      simple_workq_thread, NULL, NULL, NULL,
			      0, 0, K_NO_WAIT);

	k_thread_join(tid, K_FOREVER);

	/* Exercise delayed workqueue */
	tid = k_thread_create(&my_thread, my_stack_area, STACK_SIZE,
			      delayed_workq_thread, NULL, NULL, NULL,
			      0, 0, K_NO_WAIT);

	k_thread_join(tid, K_FOREVER);

#if CONFIG_USERSPACE
	k_work_user_queue_start(&user_workq, user_workq_stack,
				K_THREAD_STACK_SIZEOF(user_workq_stack),
				CONFIG_MAIN_THREAD_PRIORITY, NULL);

	/* The work queue thread has been started, but it's OK because
	 * it doesn't need these permissions until something's submitted
	 * to it.
	 */
	k_mem_domain_add_thread(&footprint_mem_domain, &user_workq.thread);
	k_thread_access_grant(&user_workq.thread, &sync_sema);

	tid = k_thread_create(&my_thread, my_stack_area, STACK_SIZE,
			      simple_user_workq_thread, NULL, NULL, NULL,
			      0, K_USER, K_FOREVER);

	k_thread_access_grant(tid, &sync_sema,
			      &user_workq.thread, &user_workq.queue,
			      &user_workq_stack);

	k_mem_domain_add_thread(&footprint_mem_domain, tid);

	k_thread_start(tid);
	k_thread_join(tid, K_FOREVER);

#endif
}
```
