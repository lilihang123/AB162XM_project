## CMakeLists.txt
```
# SPDX-License-Identifier: Apache-2.0

cmake_minimum_required(VERSION 3.20.0)
find_package(Zephyr REQUIRED HINTS $ENV{ZEPHYR_BASE})
project(latency_measure)

FILE(GLOB app_sources src/*.c)
target_sources(app PRIVATE ${app_sources})
```

## Kconfig
```
# Copyright (c) 2024 Intel Corporation
# SPDX-License-Identifier: Apache-2.0

mainmenu "Latency Measure Benchmark"

source "Kconfig.zephyr"

config BENCHMARK_NUM_ITERATIONS
	int "Number of iterations to gather data"
	default 1000
```

## prj.conf
```kconfig
# Default base configuration file

CONFIG_TEST=y

# eliminate timer interrupts during the benchmark
CONFIG_SYS_CLOCK_TICKS_PER_SEC=1

# We use irq_offload(), enable it
CONFIG_IRQ_OFFLOAD=y

# Reduce memory/code footprint
CONFIG_BT=n
CONFIG_FORCE_NO_ASSERT=y

CONFIG_TEST_HW_STACK_PROTECTION=n
# Disable HW Stack Protection (see #28664)
CONFIG_HW_STACK_PROTECTION=n
CONFIG_COVERAGE=n

# Disable system power management
CONFIG_PM=n

# Can only run under 1 CPU
CONFIG_MP_MAX_NUM_CPUS=1
CONFIG_TIMING_FUNCTIONS=y

CONFIG_HEAP_MEM_POOL_SIZE=2048
CONFIG_APPLICATION_DEFINED_SYSCALL=y

# Disable time slicing
CONFIG_TIMESLICING=n

# Enable events
CONFIG_EVENTS=y
```

## prj.canaries.conf
```kconfig
# Extra configuration file to enable stack canary support
# Use with EXTRA_CONF_FILE

CONFIG_TEST_RANDOM_GENERATOR=y
CONFIG_STACK_CANARIES=y
```

## prj.objcore.conf
```kconfig
# Extra configuration file to enable object core and statistics support
# Use with EXTRA_CONF_FILE

CONFIG_OBJ_CORE=y
CONFIG_OBJ_CORE_STATS=y
```

## prj.timeslicing.conf
```kconfig
# Extra configuration file to enable timeslicing support
# Use with EXTRA_CONF_FILE

CONFIG_TIMESLICING=y
```

## prj.userspace.conf
```kconfig
# Extra configuration file to enable userspace support
# Use with EXTRA_CONF_FILE

CONFIG_USERSPACE=y
```

## boards/frdm_k64f.conf
```kconfig
# The minimum number of system ticks per second that this platform will
# allow for a tickless kernel given its 24-bit timer and its 120 MHz
# clock rate is 15.
CONFIG_SYS_CLOCK_TICKS_PER_SEC=15
```

## boards/mec1501modular_assy6885.conf
```kconfig
# Disable power management to prevent SoC from sleeping.
# The test would not finish otherwise as there is no external
# interrupts to wake up the SoC.
# This board has an extra option to control PM, so need to
# disable it here.
CONFIG_PM=n
```

## src/main.c
```c
/*
 * Copyright (c) 2012-2015 Wind River Systems, Inc.
 * Copyright (c) 2023,2024 Intel Corporation.
 *
 * SPDX-License-Identifier: Apache-2.0
 */

/*
 * @file
 * This file contains the main testing module that invokes all the tests.
 */

#include <zephyr/kernel.h>
#include <zephyr/timestamp.h>
#include "utils.h"
#include "timing_sc.h"
#include <zephyr/tc_util.h>

#define STACK_SIZE (1024 + CONFIG_TEST_EXTRA_STACK_SIZE)

uint32_t tm_off;

BENCH_BMEM struct timestamp_data  timestamp;

#ifdef CONFIG_USERSPACE
K_APPMEM_PARTITION_DEFINE(bench_mem_partition);
#endif

K_THREAD_STACK_DEFINE(start_stack, START_STACK_SIZE);
K_THREAD_STACK_DEFINE(alt_stack, ALT_STACK_SIZE);

K_SEM_DEFINE(pause_sem, 0, 1);

struct k_thread  start_thread;
struct k_thread  alt_thread;

int error_count; /* track number of errors */

extern void thread_switch_yield(uint32_t num_iterations, bool is_cooperative);
extern void int_to_thread(uint32_t num_iterations);
extern void sema_test_signal(uint32_t num_iterations, uint32_t options);
extern void mutex_lock_unlock(uint32_t num_iterations, uint32_t options);
extern void sema_context_switch(uint32_t num_iterations,
				uint32_t start_options, uint32_t alt_options);
extern int thread_ops(uint32_t num_iterations, uint32_t start_options,
		      uint32_t alt_options);
extern int fifo_ops(uint32_t num_iterations, uint32_t options);
extern int fifo_blocking_ops(uint32_t num_iterations, uint32_t start_options,
			     uint32_t alt_options);
extern int lifo_ops(uint32_t num_iterations, uint32_t options);
extern int lifo_blocking_ops(uint32_t num_iterations, uint32_t start_options,
			     uint32_t alt_options);
extern int event_ops(uint32_t num_iterations, uint32_t options);
extern int event_blocking_ops(uint32_t num_iterations, uint32_t start_options,
			      uint32_t alt_options);
extern int condvar_blocking_ops(uint32_t num_iterations, uint32_t start_options,
				uint32_t alt_options);
extern int stack_ops(uint32_t num_iterations, uint32_t options);
extern int stack_blocking_ops(uint32_t num_iterations, uint32_t start_options,
			       uint32_t alt_options);
extern void heap_malloc_free(void);

static void test_thread(void *arg1, void *arg2, void *arg3)
{
	uint32_t freq;

	ARG_UNUSED(arg1);
	ARG_UNUSED(arg2);
	ARG_UNUSED(arg3);

#ifdef CONFIG_USERSPACE
	k_mem_domain_add_partition(&k_mem_domain_default,
				   &bench_mem_partition);
#endif

	timing_init();

	bench_test_init();

	freq = timing_freq_get_mhz();

	TC_START("Time Measurement");
	TC_PRINT("Timing results: Clock frequency: %u MHz\n", freq);

	timestamp_overhead_init(CONFIG_BENCHMARK_NUM_ITERATIONS);

	/* Preemptive threads context switching */
	thread_switch_yield(CONFIG_BENCHMARK_NUM_ITERATIONS, false);

	/* Cooperative threads context switching */
	thread_switch_yield(CONFIG_BENCHMARK_NUM_ITERATIONS, true);

	int_to_thread(CONFIG_BENCHMARK_NUM_ITERATIONS);

	/* Thread creation, starting, suspending, resuming and aborting. */

	thread_ops(CONFIG_BENCHMARK_NUM_ITERATIONS, 0, 0);
#ifdef CONFIG_USERSPACE
	thread_ops(CONFIG_BENCHMARK_NUM_ITERATIONS, 0, K_USER);
	thread_ops(CONFIG_BENCHMARK_NUM_ITERATIONS, K_USER, K_USER);
	thread_ops(CONFIG_BENCHMARK_NUM_ITERATIONS, K_USER, 0);
#endif

	fifo_ops(CONFIG_BENCHMARK_NUM_ITERATIONS, 0);
#ifdef CONFIG_USERSPACE
	fifo_ops(CONFIG_BENCHMARK_NUM_ITERATIONS, K_USER);
#endif

	fifo_blocking_ops(CONFIG_BENCHMARK_NUM_ITERATIONS, 0, 0);
#ifdef CONFIG_USERSPACE
	fifo_blocking_ops(CONFIG_BENCHMARK_NUM_ITERATIONS, 0, K_USER);
	fifo_blocking_ops(CONFIG_BENCHMARK_NUM_ITERATIONS, K_USER, 0);
	fifo_blocking_ops(CONFIG_BENCHMARK_NUM_ITERATIONS, K_USER, K_USER);
#endif


	lifo_ops(CONFIG_BENCHMARK_NUM_ITERATIONS, 0);
#ifdef CONFIG_USERSPACE
	lifo_ops(CONFIG_BENCHMARK_NUM_ITERATIONS, K_USER);
#endif

	lifo_blocking_ops(CONFIG_BENCHMARK_NUM_ITERATIONS, 0, 0);
#ifdef CONFIG_USERSPACE
	lifo_blocking_ops(CONFIG_BENCHMARK_NUM_ITERATIONS, 0, K_USER);
	lifo_blocking_ops(CONFIG_BENCHMARK_NUM_ITERATIONS, K_USER, 0);
	lifo_blocking_ops(CONFIG_BENCHMARK_NUM_ITERATIONS, K_USER, K_USER);
#endif

	event_ops(CONFIG_BENCHMARK_NUM_ITERATIONS, 0);
#ifdef CONFIG_USERSPACE
	event_ops(CONFIG_BENCHMARK_NUM_ITERATIONS, K_USER);
#endif

	event_blocking_ops(CONFIG_BENCHMARK_NUM_ITERATIONS, 0, 0);
#ifdef CONFIG_USERSPACE
	event_blocking_ops(CONFIG_BENCHMARK_NUM_ITERATIONS, 0, K_USER);
	event_blocking_ops(CONFIG_BENCHMARK_NUM_ITERATIONS, K_USER, 0);
	event_blocking_ops(CONFIG_BENCHMARK_NUM_ITERATIONS, K_USER, K_USER);
#endif

	sema_test_signal(CONFIG_BENCHMARK_NUM_ITERATIONS, 0);
#ifdef CONFIG_USERSPACE
	sema_test_signal(CONFIG_BENCHMARK_NUM_ITERATIONS, K_USER);
#endif

	sema_context_switch(CONFIG_BENCHMARK_NUM_ITERATIONS, 0, 0);
#ifdef CONFIG_USERSPACE
	sema_context_switch(CONFIG_BENCHMARK_NUM_ITERATIONS, 0, K_USER);
	sema_context_switch(CONFIG_BENCHMARK_NUM_ITERATIONS, K_USER, 0);
	sema_context_switch(CONFIG_BENCHMARK_NUM_ITERATIONS, K_USER, K_USER);
#endif

	condvar_blocking_ops(CONFIG_BENCHMARK_NUM_ITERATIONS, 0, 0);
#ifdef CONFIG_USERSPACE
	condvar_blocking_ops(CONFIG_BENCHMARK_NUM_ITERATIONS, 0, K_USER);
	condvar_blocking_ops(CONFIG_BENCHMARK_NUM_ITERATIONS, K_USER, 0);
	condvar_blocking_ops(CONFIG_BENCHMARK_NUM_ITERATIONS, K_USER, K_USER);
#endif

	stack_ops(CONFIG_BENCHMARK_NUM_ITERATIONS, 0);
#ifdef CONFIG_USERSPACE
	stack_ops(CONFIG_BENCHMARK_NUM_ITERATIONS, K_USER);
#endif

	stack_blocking_ops(CONFIG_BENCHMARK_NUM_ITERATIONS, 0, 0);
#ifdef CONFIG_USERSPACE
	stack_blocking_ops(CONFIG_BENCHMARK_NUM_ITERATIONS, 0, K_USER);
	stack_blocking_ops(CONFIG_BENCHMARK_NUM_ITERATIONS, K_USER, 0);
	stack_blocking_ops(CONFIG_BENCHMARK_NUM_ITERATIONS, K_USER, K_USER);
#endif

	mutex_lock_unlock(CONFIG_BENCHMARK_NUM_ITERATIONS, 0);
#ifdef CONFIG_USERSPACE
	mutex_lock_unlock(CONFIG_BENCHMARK_NUM_ITERATIONS, K_USER);
#endif

	heap_malloc_free();

	TC_END_REPORT(error_count);
}

K_THREAD_DEFINE(test_thread_id, STACK_SIZE, test_thread, NULL, NULL, NULL,
		K_PRIO_PREEMPT(10), 0, 0);

int main(void)
{
	k_thread_join(test_thread_id, K_FOREVER);
	return 0;
}
```

## src/condvar.c
```c
/*
 * Copyright (c) 2024 Intel Corporation
 *
 * SPDX-License-Identifier: Apache-2.0
 */

/*
 * @file measure time for various condition variable operations
 * 1. Block waiting for a condition variable
 * 2. Signal a condition variable (with context switch)
 */

#include <zephyr/kernel.h>
#include <zephyr/timing/timing.h>
#include "utils.h"
#include "timing_sc.h"

static K_CONDVAR_DEFINE(condvar);
static K_MUTEX_DEFINE(mutex);

static void start_thread_entry(void *p1, void *p2, void *p3)
{
	uint32_t  num_iterations = (uint32_t)(uintptr_t)p1;
	uint32_t  i;
	timing_t  start;
	timing_t  finish;
	uint64_t  sum[2] = {0ull, 0ull};

	k_mutex_lock(&mutex, K_FOREVER);

	k_thread_start(&alt_thread);

	for (i = 0; i < num_iterations; i++) {
		/* 1. Get the first timestamp and block on condvar */

		start = timing_timestamp_get();
		k_condvar_wait(&condvar, &mutex, K_FOREVER);

		/* 3. Get the final timstamp */

		finish = timing_timestamp_get();

		sum[0] += timing_cycles_get(&start, &timestamp.sample);
		sum[1] += timing_cycles_get(&timestamp.sample, &finish);
	}

	/* Wait for alt_thread to finish */

	k_thread_join(&alt_thread, K_FOREVER);

	timestamp.cycles = sum[0];
	k_sem_take(&pause_sem, K_FOREVER);

	timestamp.cycles = sum[1];
}

static void alt_thread_entry(void *p1, void *p2, void *p3)
{
	uint32_t  num_iterations = (uint32_t)(uintptr_t)p1;
	uint32_t  i;

	for (i = 0; i < num_iterations; i++) {

		/* 2. Get midpoint timestamp and signal the condvar */

		timestamp.sample = timing_timestamp_get();
		k_condvar_signal(&condvar);
	}
}

int condvar_blocking_ops(uint32_t num_iterations, uint32_t start_options,
			 uint32_t alt_options)
{
	int       priority;
	char      tag[50];
	char      description[120];
	uint64_t  cycles;

	priority = k_thread_priority_get(k_current_get());

	timing_start();

	k_thread_create(&start_thread, start_stack,
			K_THREAD_STACK_SIZEOF(start_stack),
			start_thread_entry,
			(void *)(uintptr_t)num_iterations,
			NULL, NULL,
			priority - 2, start_options, K_FOREVER);

	k_thread_create(&alt_thread, alt_stack,
			K_THREAD_STACK_SIZEOF(alt_stack),
			alt_thread_entry,
			(void *)(uintptr_t)num_iterations,
			NULL, NULL,
			priority - 1, alt_options, K_FOREVER);

	k_thread_access_grant(&start_thread, &alt_thread,
			      &condvar, &mutex, &pause_sem);
	k_thread_access_grant(&alt_thread, &condvar);

	/* Start test thread */

	k_thread_start(&start_thread);

	/* Stats gathered. Display them. */

	snprintf(tag, sizeof(tag), "condvar.wait.blocking.%c_to_%c",
		 (start_options & K_USER) ? 'u' : 'k',
		 (alt_options & K_USER) ? 'u' : 'k');
	snprintf(description, sizeof(description),
		 "%-40s - Wait for a condvar (context switch)", tag);

	cycles = timestamp.cycles;
	PRINT_STATS_AVG(description, (uint32_t)cycles,
			num_iterations, false, "");

	k_sem_give(&pause_sem);

	snprintf(tag, sizeof(tag), "condvar.signal.wake+ctx.%c_to_%c",
		 (alt_options & K_USER) ? 'u' : 'k',
		 (start_options & K_USER) ? 'u' : 'k');
	snprintf(description, sizeof(description),
		 "%-40s - Signal a condvar (context switch)", tag);
	cycles = timestamp.cycles;
	PRINT_STATS_AVG(description, (uint32_t)cycles,
			num_iterations, false, "");

	k_thread_join(&start_thread, K_FOREVER);

	timing_stop();

	return 0;
}
```

## src/events.c
```c
/*
 * Copyright (c) 2024 Intel Corporation
 *
 * SPDX-License-Identifier: Apache-2.0
 */

/*
 * @file measure time for various event operations
 *
 * This file contains the tests that measure the times for manipulating
 * event objects from both kernel and user threads:
 * 1. Immediately posting and setting events
 * 2. Immediately receiving any or all events.
 * 3. Blocking to receive either any or all events.
 * 4. Waking (and switching to) a thread waiting for any or all events.
 */

#include <zephyr/kernel.h>
#include <zephyr/timing/timing.h>
#include "utils.h"
#include "timing_sc.h"

#define BENCH_EVENT_SET  0x1234
#define ALL_EVENTS       0xFFFFFFFF

static K_EVENT_DEFINE(event_set);

static void event_ops_entry(void *p1, void *p2, void *p3)
{
	uint32_t  num_iterations = (uint32_t)(uintptr_t)p1;
	timing_t  start;
	timing_t  finish;
	uint32_t  i;

	/* 2. Benchmark k_event_post() with no waiters */

	k_event_clear(&event_set, ALL_EVENTS);

	start = timing_timestamp_get();
	for (i = 0; i < num_iterations; i++) {
		k_event_post(&event_set, BENCH_EVENT_SET);
	}
	finish = timing_timestamp_get();

	timestamp.cycles = timing_cycles_get(&start, &finish);

	/* 3. Pause to allow main thread to print results */

	k_sem_take(&pause_sem, K_FOREVER);

	/* 5. Benchmark k_event_set() with no waiters */

	start = timing_timestamp_get();
	for (i = 0; i < num_iterations; i++) {
		k_event_set(&event_set, BENCH_EVENT_SET);
	}
	finish = timing_timestamp_get();

	timestamp.cycles = timing_cycles_get(&start, &finish);

	/* 6. Pause to allow main thread to print results */

	k_sem_take(&pause_sem, K_FOREVER);

	/* 8. Benchmark k_event_wait() (events have already been set) */

	start = timing_timestamp_get();
	for (i = 0; i < num_iterations; i++) {
		k_event_wait(&event_set, BENCH_EVENT_SET, false, K_FOREVER);
	}
	finish = timing_timestamp_get();

	timestamp.cycles = timing_cycles_get(&start, &finish);

	/* 9. Pause to allow main thread to print results */

	k_sem_take(&pause_sem, K_FOREVER);

	/* 11. Benchmark k_event_wait_all() (events have already been set) */

	start = timing_timestamp_get();
	for (i = 0; i < num_iterations; i++) {
		k_event_wait_all(&event_set, BENCH_EVENT_SET, false, K_FOREVER);
	}
	finish = timing_timestamp_get();

	timestamp.cycles = timing_cycles_get(&start, &finish);

	/* 12. Thread finishes */
}

static void start_thread_entry(void *p1, void *p2, void *p3)
{
	uint32_t  num_iterations = (uint32_t)(uintptr_t)p1;
	uint32_t  i;

	k_thread_start(&alt_thread);

	for (i = 0; i < num_iterations; i++) {

		/* 2. Set the events to wake alt_thread */

		timestamp.sample = timing_timestamp_get();
		k_event_set(&event_set, BENCH_EVENT_SET);
	}

	for (i = 0; i < num_iterations; i++) {

		/* 5. Post the events to wake alt_thread */

		timestamp.sample = timing_timestamp_get();
		k_event_post(&event_set, BENCH_EVENT_SET);
	}

	k_thread_join(&alt_thread, K_FOREVER);
}

static void alt_thread_entry(void *p1, void *p2, void *p3)
{
	uint32_t  num_iterations = (uint32_t)(uintptr_t)p1;
	uint32_t  i;
	timing_t  start;
	timing_t  mid;
	timing_t  finish;
	uint64_t  sum[4] = {0ULL, 0ULL, 0ULL, 0ULL};

	for (i = 0; i < num_iterations; i++) {

		/* 1. Wait for any of the events */

		start = timing_timestamp_get();
		k_event_wait(&event_set, BENCH_EVENT_SET, true, K_FOREVER);

		/* 3. Record the final timestamp */

		finish = timing_timestamp_get();
		mid = timestamp.sample;

		sum[0] += timing_cycles_get(&start, &mid);
		sum[1] += timing_cycles_get(&mid, &finish);
	}

	for (i = 0; i < num_iterations; i++) {

		/* 4. Wait for all of the events */

		start = timing_timestamp_get();
		k_event_wait_all(&event_set, BENCH_EVENT_SET, true, K_FOREVER);

		/* 6. Record the final timestamp */

		finish = timing_timestamp_get();
		mid = timestamp.sample;

		sum[2] += timing_cycles_get(&start, &mid);
		sum[3] += timing_cycles_get(&mid, &finish);
	}

	/* Let the main thread print the results */

	timestamp.cycles = sum[0];
	k_sem_take(&pause_sem, K_FOREVER);

	timestamp.cycles = sum[1];
	k_sem_take(&pause_sem, K_FOREVER);

	timestamp.cycles = sum[2];
	k_sem_take(&pause_sem, K_FOREVER);

	timestamp.cycles = sum[3];
}

int event_ops(uint32_t num_iterations, uint32_t options)
{
	int       priority;
	char      tag[50];
	char      description[120];
	uint64_t  cycles;

	priority = k_thread_priority_get(k_current_get());

	timing_start();

	k_thread_create(&start_thread, start_stack,
			K_THREAD_STACK_SIZEOF(start_stack),
			event_ops_entry,
			(void *)(uintptr_t)num_iterations,
			NULL, NULL,
			priority - 1, options, K_FOREVER);

	k_thread_access_grant(&start_thread, &event_set, &pause_sem);

	/* 1. Start test thread */

	k_thread_start(&start_thread);

	/* 4. Benchmark thread has paused */

	snprintf(tag, sizeof(tag), "events.post.immediate.%s",
		 (options & K_USER) ? "user" : "kernel");
	snprintf(description, sizeof(description),
		 "%-40s - Post events (nothing wakes)", tag);

	cycles = timestamp.cycles;
	PRINT_STATS_AVG(description, (uint32_t)cycles,
			num_iterations, false, "");

	k_sem_give(&pause_sem);

	/* 7. Benchmark thread has paused */

	snprintf(tag, sizeof(tag), "events.set.immediate.%s",
		 (options & K_USER) ? "user" : "kernel");
	snprintf(description, sizeof(description),
		 "%-40s - Set events (nothing wakes)", tag);
	cycles = timestamp.cycles;
	PRINT_STATS_AVG(description, (uint32_t)cycles,
			num_iterations, false, "");

	k_sem_give(&pause_sem);

	/* 10. Benchmark thread has paused */

	snprintf(tag, sizeof(tag), "events.wait.immediate.%s",
		 (options & K_USER) ? "user" : "kernel");
	snprintf(description, sizeof(description),
		 "%-40s - Wait for any events (no ctx switch)", tag);
	cycles = timestamp.cycles;
	PRINT_STATS_AVG(description, (uint32_t)cycles,
			num_iterations, false, "");

	k_sem_give(&pause_sem);

	/* 13. Benchmark thread has finished */

	snprintf(tag, sizeof(tag), "events.wait_all.immediate.%s",
		 (options & K_USER) ? "user" : "kernel");
	snprintf(description, sizeof(description),
		 "%-40s - Wait for all events (no ctx switch)", tag);
	cycles = timestamp.cycles;
	PRINT_STATS_AVG(description, (uint32_t)cycles,
			num_iterations, false, "");
	k_thread_join(&start_thread, K_FOREVER);

	timing_stop();

	return 0;
}

int event_blocking_ops(uint32_t num_iterations, uint32_t start_options,
		       uint32_t alt_options)
{
	int       priority;
	char      tag[50];
	char      description[120];
	uint64_t  cycles;

	priority = k_thread_priority_get(k_current_get());

	timing_start();

	k_thread_create(&start_thread, start_stack,
			K_THREAD_STACK_SIZEOF(start_stack),
			start_thread_entry,
			(void *)(uintptr_t)num_iterations,
			NULL, NULL,
			priority - 1, start_options, K_FOREVER);

	k_thread_create(&alt_thread, alt_stack,
			K_THREAD_STACK_SIZEOF(alt_stack),
			alt_thread_entry,
			(void *)(uintptr_t)num_iterations,
			NULL, NULL,
			priority - 2, alt_options, K_FOREVER);

	k_thread_access_grant(&start_thread, &alt_thread, &event_set,
			      &pause_sem);
	k_thread_access_grant(&alt_thread, &event_set, &pause_sem);

	k_thread_start(&start_thread);

	snprintf(tag, sizeof(tag),
		 "events.wait.blocking.%c_to_%c",
		 (alt_options & K_USER) ? 'u' : 'k',
		 (start_options & K_USER) ? 'u' : 'k');
	snprintf(description, sizeof(description),
		 "%-40s - Wait for any events (w/ ctx switch)", tag);
	cycles = timestamp.cycles -
		 timestamp_overhead_adjustment(start_options, alt_options);
	PRINT_STATS_AVG(description, (uint32_t)cycles,
			num_iterations, false, "");
	k_sem_give(&pause_sem);

	snprintf(tag, sizeof(tag),
		 "events.set.wake+ctx.%c_to_%c",
		 (start_options & K_USER) ? 'u' : 'k',
		 (alt_options & K_USER) ? 'u' : 'k');
	snprintf(description, sizeof(description),
		 "%-40s - Set events (w/ ctx switch)", tag);
	cycles = timestamp.cycles -
		 timestamp_overhead_adjustment(start_options, alt_options);
	PRINT_STATS_AVG(description, (uint32_t)cycles,
			num_iterations, false, "");
	k_sem_give(&pause_sem);

	snprintf(tag, sizeof(tag),
		 "events.wait_all.blocking.%c_to_%c",
		 (alt_options & K_USER) ? 'u' : 'k',
		 (start_options & K_USER) ? 'u' : 'k');
	snprintf(description, sizeof(description),
		 "%-40s - Wait for all events (w/ ctx switch)", tag);
	cycles = timestamp.cycles;
	PRINT_STATS_AVG(description, (uint32_t)cycles,
			num_iterations, false, "");
	k_sem_give(&pause_sem);

	snprintf(tag, sizeof(tag),
		 "events.post.wake+ctx.%c_to_%c",
		 (start_options & K_USER) ? 'u' : 'k',
		 (alt_options & K_USER) ? 'u' : 'k');
	snprintf(description, sizeof(description),
		 "%-40s - Post events (w/ ctx switch)", tag);
	cycles = timestamp.cycles;
	PRINT_STATS_AVG(description, (uint32_t)cycles,
			num_iterations, false, "");

	k_thread_join(&start_thread, K_FOREVER);

	timing_stop();

	return 0;
}
```

## src/fifo.c
```c
/*
 * Copyright (c) 2024 Intel Corporation
 *
 * SPDX-License-Identifier: Apache-2.0
 */

/*
 * @file measure time for various FIFO operations
 *
 * This file contains the tests that measures the times for the following
 * FIFO operations from both kernel threads and user threads:
 *  1. Immediately adding a data item to a FIFO
 *  2. Immediately removing a data item from a FIFO
 *  3. Immediately adding a data item to a FIFO with allocation
 *  4. Immediately removing a data item from a FIFO with allocation
 *  5. Blocking on removing a data item from a FIFO
 *  6. Waking (and context switching to) a thread blocked on a FIFO via
 *     k_fifo_put().
 *  7. Waking (and context switching to) a thread blocked on a FIFO via
 *     k_fifo_alloc_put().
 */

#include <zephyr/kernel.h>
#include <zephyr/timing/timing.h>
#include "utils.h"
#include "timing_sc.h"

#define STACK_SIZE (512 + CONFIG_TEST_EXTRA_STACK_SIZE)

static K_FIFO_DEFINE(fifo);

BENCH_BMEM uintptr_t fifo_data[5];

static void fifo_put_get_thread_entry(void *p1, void *p2, void *p3)
{
	uint32_t num_iterations = (uint32_t)(uintptr_t)p1;
	uint32_t options = (uint32_t)(uintptr_t)p2;
	timing_t start;
	timing_t mid;
	timing_t finish;
	uint64_t put_sum = 0ULL;
	uint64_t get_sum = 0ULL;
	uintptr_t *data;

	if ((options & K_USER) == 0) {
		for (uint32_t i = 0; i < num_iterations; i++) {
			start = timing_timestamp_get();

			k_fifo_put(&fifo, fifo_data);

			mid = timing_timestamp_get();

			data = k_fifo_get(&fifo, K_NO_WAIT);

			finish = timing_timestamp_get();

			put_sum += timing_cycles_get(&start, &mid);
			get_sum += timing_cycles_get(&mid, &finish);
		}

		timestamp.cycles = put_sum;
		k_sem_take(&pause_sem, K_FOREVER);

		timestamp.cycles = get_sum;
		k_sem_take(&pause_sem, K_FOREVER);

		put_sum = 0ULL;
		get_sum = 0ULL;
	}

	for (uint32_t i = 0; i < num_iterations; i++) {
		start = timing_timestamp_get();

		k_fifo_alloc_put(&fifo, fifo_data);

		mid = timing_timestamp_get();

		data = k_fifo_get(&fifo, K_NO_WAIT);

		finish = timing_timestamp_get();

		put_sum += timing_cycles_get(&start, &mid);
		get_sum += timing_cycles_get(&mid, &finish);
	}

	timestamp.cycles = put_sum;
	k_sem_take(&pause_sem, K_FOREVER);

	timestamp.cycles = get_sum;
}

int fifo_ops(uint32_t num_iterations, uint32_t options)
{
	int      priority;
	uint64_t cycles;
	char     tag[50];
	char     description[120];

	priority = k_thread_priority_get(k_current_get());

	timing_start();

	k_thread_create(&start_thread, start_stack,
			K_THREAD_STACK_SIZEOF(start_stack),
			fifo_put_get_thread_entry,
			(void *)(uintptr_t)num_iterations,
			(void *)(uintptr_t)options, NULL,
			priority - 1, options, K_FOREVER);

	k_thread_access_grant(&start_thread, &pause_sem, &fifo);

	k_thread_start(&start_thread);

	if ((options & K_USER) == 0) {
		snprintf(tag, sizeof(tag),
			 "fifo.put.immediate.%s",
			 options & K_USER ? "user" : "kernel");
		snprintf(description, sizeof(description),
			 "%-40s - Add data to FIFO (no ctx switch)", tag);

		cycles = timestamp.cycles;
		cycles -= timestamp_overhead_adjustment(options, options);
		PRINT_STATS_AVG(description, (uint32_t)cycles,
				num_iterations, false, "");
		k_sem_give(&pause_sem);

		snprintf(tag, sizeof(tag),
			 "fifo.get.immediate.%s",
			 options & K_USER ? "user" : "kernel");
		snprintf(description, sizeof(description),
			 "%-40s - Get data from FIFO (no ctx switch)", tag);
		cycles = timestamp.cycles;
		cycles -= timestamp_overhead_adjustment(options, options);
		PRINT_STATS_AVG(description, (uint32_t)cycles,
				num_iterations, false, "");
		k_sem_give(&pause_sem);
	}

	snprintf(tag, sizeof(tag),
		 "fifo.put.alloc.immediate.%s",
		 options & K_USER ? "user" : "kernel");
	snprintf(description, sizeof(description),
		 "%-40s - Allocate to add data to FIFO (no ctx switch)", tag);

	cycles = timestamp.cycles;
	PRINT_STATS_AVG(description, (uint32_t)cycles,
			num_iterations, false, "");
	k_sem_give(&pause_sem);

	snprintf(tag, sizeof(tag),
		 "fifo.get.free.immediate.%s",
		 options & K_USER ? "user" : "kernel");
	snprintf(description, sizeof(description),
		 "%-40s - Free when getting data from FIFO (no ctx switch)", tag);
	cycles = timestamp.cycles;
	PRINT_STATS_AVG(description, (uint32_t)cycles,
			num_iterations, false, "");

	k_thread_join(&start_thread, K_FOREVER);

	timing_stop();

	return 0;
}

static void alt_thread_entry(void *p1, void *p2, void *p3)
{
	uint32_t num_iterations = (uint32_t)(uintptr_t)p1;
	uint32_t options = (uint32_t)(uintptr_t)p2;
	timing_t  start;
	timing_t  mid;
	timing_t  finish;
	uint64_t  sum[4] = {0ULL, 0ULL, 0ULL, 0ULL};
	uintptr_t *data;
	uint32_t  i;

	if ((options & K_USER) == 0) {

		/* Used with k_fifo_put() */

		for (i = 0; i < num_iterations; i++) {

			/* 1. Block waiting for data on FIFO */

			start = timing_timestamp_get();

			data = k_fifo_get(&fifo, K_FOREVER);

			/* 3. Data obtained. */

			finish = timing_timestamp_get();

			mid = timestamp.sample;

			sum[0] += timing_cycles_get(&start, &mid);
			sum[1] += timing_cycles_get(&mid, &finish);
		}
	}

	/* Used with k_fifo_alloc_put() */

	for (i = 0; i < num_iterations; i++) {

		/* 4. Block waiting for data on FIFO */

		start = timing_timestamp_get();

		data = k_fifo_get(&fifo, K_FOREVER);

		/* 6. Data obtained */

		finish = timing_timestamp_get();

		mid = timestamp.sample;

		sum[2] += timing_cycles_get(&start, &mid);
		sum[3] += timing_cycles_get(&mid, &finish);
	}

	if ((options & K_USER) == 0) {
		timestamp.cycles = sum[0];
		k_sem_take(&pause_sem, K_FOREVER);
		timestamp.cycles = sum[1];
		k_sem_take(&pause_sem, K_FOREVER);
	}

	timestamp.cycles = sum[2];
	k_sem_take(&pause_sem, K_FOREVER);
	timestamp.cycles = sum[3];
}

static void start_thread_entry(void *p1, void *p2, void *p3)
{
	uint32_t num_iterations = (uint32_t)(uintptr_t)p1;
	uint32_t options = (uint32_t)(uintptr_t)p2;
	uint32_t i;

	k_thread_start(&alt_thread);

	if ((options & K_USER) == 0) {
		for (i = 0; i < num_iterations; i++) {

			/* 2. Add data thereby waking alt thread */

			timestamp.sample = timing_timestamp_get();

			k_fifo_put(&fifo, fifo_data);

		}
	}

	for (i = 0; i < num_iterations; i++) {

		/* 5. Add data thereby waking alt thread */

		timestamp.sample = timing_timestamp_get();

		k_fifo_alloc_put(&fifo, fifo_data);

	}

	k_thread_join(&alt_thread, K_FOREVER);
}

int fifo_blocking_ops(uint32_t num_iterations, uint32_t start_options,
		      uint32_t alt_options)
{
	int      priority;
	uint64_t cycles;
	char     tag[50];
	char     description[120];

	priority = k_thread_priority_get(k_current_get());

	timing_start();

	k_thread_create(&start_thread, start_stack,
			K_THREAD_STACK_SIZEOF(start_stack),
			start_thread_entry,
			(void *)(uintptr_t)num_iterations,
			(void *)(uintptr_t)(start_options | alt_options), NULL,
			priority - 1, start_options, K_FOREVER);

	k_thread_create(&alt_thread, alt_stack,
			K_THREAD_STACK_SIZEOF(alt_stack),
			alt_thread_entry,
			(void *)(uintptr_t)num_iterations,
			(void *)(uintptr_t)(start_options | alt_options), NULL,
			priority - 2, alt_options, K_FOREVER);

	k_thread_access_grant(&start_thread, &alt_thread, &pause_sem, &fifo);
	k_thread_access_grant(&alt_thread, &pause_sem, &fifo);

	k_thread_start(&start_thread);

	if (((start_options | alt_options) & K_USER) == 0) {
		snprintf(tag, sizeof(tag),
			 "fifo.get.blocking.%s_to_%s",
			 alt_options & K_USER ? "u" : "k",
			 start_options & K_USER ? "u" : "k");
		snprintf(description, sizeof(description),
			 "%-40s - Get data from FIFO (w/ ctx switch)", tag);

		cycles = timestamp.cycles;
		PRINT_STATS_AVG(description, (uint32_t)cycles,
				num_iterations, false, "");
		k_sem_give(&pause_sem);

		snprintf(tag, sizeof(tag),
			 "fifo.put.wake+ctx.%s_to_%s",
			 start_options & K_USER ? "u" : "k",
			 alt_options & K_USER ? "u" : "k");
		snprintf(description, sizeof(description),
			 "%-40s - Add data to FIFO (w/ ctx switch)", tag);
		cycles = timestamp.cycles;
		PRINT_STATS_AVG(description, (uint32_t)cycles,
				num_iterations, false, "");
		k_sem_give(&pause_sem);
	}

	snprintf(tag, sizeof(tag),
		 "fifo.get.free.blocking.%s_to_%s",
		 alt_options & K_USER ? "u" : "k",
		 start_options & K_USER ? "u" : "k");
	snprintf(description, sizeof(description),
		 "%-40s - Free when getting data from FIFO (w/ ctx siwtch)", tag);

	cycles = timestamp.cycles;
	PRINT_STATS_AVG(description, (uint32_t)cycles,
			num_iterations, false, "");
	k_sem_give(&pause_sem);

	snprintf(tag, sizeof(tag),
		 "fifo.put.alloc.wake+ctx.%s_to_%s",
		 start_options & K_USER ? "u" : "k",
		 alt_options & K_USER ? "u" : "k");
	snprintf(description, sizeof(description),
		 "%-40s - Allocate to add data to FIFO (w/ ctx switch)", tag);
	cycles = timestamp.cycles;
	PRINT_STATS_AVG(description, (uint32_t)cycles,
			num_iterations, false, "");

	k_thread_join(&start_thread, K_FOREVER);

	timing_stop();

	return 0;
}
```

## src/heap_malloc_free.c
```c
/*
 * Copyright (c) 2021 Intel Corporation
 *
 * SPDX-License-Identifier: Apache-2.0
 */

#include <zephyr/kernel.h>
#include <zephyr/timing/timing.h>
#include "utils.h"

#define TEST_COUNT 100
#define TEST_SIZE 10

void heap_malloc_free(void)
{
	timing_t heap_malloc_start_time = 0U;
	timing_t heap_malloc_end_time = 0U;

	timing_t heap_free_start_time = 0U;
	timing_t heap_free_end_time = 0U;

	uint32_t count = 0U;
	uint32_t sum_malloc = 0U;
	uint32_t sum_free = 0U;

	bool  failed = false;
	char  error_string[80];
	char  description[120];
	const char *notes = "";

	timing_start();

	while (count != TEST_COUNT) {
		heap_malloc_start_time = timing_counter_get();
		void *allocated_mem = k_malloc(TEST_SIZE);

		heap_malloc_end_time = timing_counter_get();
		if (allocated_mem == NULL) {
			error_count++;
			snprintk(error_string, 78,
				  "alloc memory @ iteration %d", count);
			notes = error_string;
			break;
		}

		heap_free_start_time = timing_counter_get();
		k_free(allocated_mem);
		heap_free_end_time = timing_counter_get();

		sum_malloc += timing_cycles_get(&heap_malloc_start_time,
				&heap_malloc_end_time);
		sum_free += timing_cycles_get(&heap_free_start_time,
				&heap_free_end_time);
		count++;
	}

	/*
	 * If count is 0, it means that there is not enough memory heap
	 * to do k_malloc at least once. Override the error string.
	 */

	if (count == 0) {
		failed = true;
		notes = "Memory heap too small--increase it.";
	}

	snprintf(description, sizeof(description),
		 "%-40s - Average time for heap malloc",
		 "heap.malloc.immediate");
	PRINT_STATS_AVG(description, sum_malloc, count, failed, notes);

	snprintf(description, sizeof(description),
		 "%-40s - Average time for heap free",
		 "heap.free.immediate");
	PRINT_STATS_AVG(description, sum_free, count, failed, notes);

	timing_stop();
}
```

## src/int_to_thread.c
```c
/*
 * Copyright (c) 2012-2014 Wind River Systems, Inc.
 * Copyright (c) 2017, 2023 Intel Corporation.
 *
 * SPDX-License-Identifier: Apache-2.0
 */

/**
 * @file
 *
 * @brief Measure time from ISR back to interrupted thread
 *
 * This file covers three interrupt to threads scenarios:
 *  1. ISR returning to the interrupted kernel thread
 *  2. ISR returning to a different (kernel) thread
 *  3. ISR returning to a different (user) thread
 *
 * In all three scenarios, the source of the ISR is a software generated
 * interrupt originating from a kernel thread. Ideally, these tests would
 * also cover the scenarios where the interrupted thread is a user thread.
 * However, some implementations of the irq_offload() routine lock interrupts,
 * which is not allowed in userspace.
 */

#include <zephyr/kernel.h>
#include "utils.h"
#include "timing_sc.h"

#include <zephyr/irq_offload.h>

static K_SEM_DEFINE(isr_sem, 0, 1);

/**
 * @brief Test ISR used to measure time to return to thread
 *
 * The interrupt handler gets the first timestamp used in the test.
 * It then copies the timetsamp into a message queue and returns.
 */
static void test_isr(const void *arg)
{
	struct k_sem *sem = (struct k_sem *)arg;

	if (arg != NULL) {
		k_sem_give(sem);
	}

	timestamp.sample = timing_timestamp_get();
}

/**
 * @brief Measure time to return from interrupt
 *
 * This function is used to measure the time it takes to return from an
 * interrupt.
 */
static void int_to_interrupted_thread(uint32_t num_iterations, uint64_t *sum)
{
	timing_t  start;
	timing_t  finish;

	*sum = 0ull;

	for (uint32_t i = 0; i < num_iterations; i++) {
		irq_offload(test_isr, NULL);
		finish = timing_timestamp_get();
		start = timestamp.sample;

		*sum += timing_cycles_get(&start, &finish);
	}
}

static void start_thread_entry(void *p1, void *p2, void *p3)
{
	uint32_t      num_iterations = (uint32_t)(uintptr_t)p1;
	struct k_sem *sem = p2;

	ARG_UNUSED(p3);

	uint64_t  sum = 0ull;
	timing_t  start;
	timing_t  finish;

	/* Ensure that <isr_sem> is unavailable */

	(void) k_sem_take(sem, K_NO_WAIT);
	k_thread_start(&alt_thread);

	for (uint32_t i = 0; i < num_iterations; i++) {

		/* 1. Wait on an unavailable semaphore */

		k_sem_take(sem, K_FOREVER);

		/* 3. Obtain the start and finish timestamps */

		finish = timing_timestamp_get();
		start = timestamp.sample;

		sum += timing_cycles_get(&start, &finish);
	}

	timestamp.cycles = sum;
}

static void alt_thread_entry(void *p1, void *p2, void *p3)
{
	uint32_t      num_iterations = (uint32_t)(uintptr_t)p1;
	struct k_sem *sem = p2;

	ARG_UNUSED(p3);

	for (uint32_t i = 0; i < num_iterations; i++) {

		/* 2. Trigger the test_isr() to execute */

		irq_offload(test_isr, sem);

		/*
		 * ISR expected to have awakened higher priority start_thread
		 * thereby preempting alt_thread.
		 */
	}

	k_thread_join(&start_thread, K_FOREVER);
}

static void int_to_another_thread(uint32_t num_iterations, uint64_t *sum,
				  uint32_t options)
{
	int  priority;
	*sum = 0ull;

	priority = k_thread_priority_get(k_current_get());

	k_thread_create(&start_thread, start_stack,
			K_THREAD_STACK_SIZEOF(start_stack),
			start_thread_entry,
			(void *)(uintptr_t)num_iterations, &isr_sem, NULL,
			priority - 2, options, K_FOREVER);

	k_thread_create(&alt_thread, alt_stack,
			K_THREAD_STACK_SIZEOF(alt_stack),
			alt_thread_entry,
			(void *)(uintptr_t)num_iterations, &isr_sem, NULL,
			priority - 1, 0, K_FOREVER);

#if CONFIG_USERSPACE
	if (options != 0) {
		k_thread_access_grant(&start_thread, &isr_sem, &alt_thread);
	}
#endif

	k_thread_start(&start_thread);

	k_thread_join(&alt_thread, K_FOREVER);

	*sum = timestamp.cycles;
}

/**
 *
 * @brief The test main function
 *
 * @return 0 on success
 */
int int_to_thread(uint32_t num_iterations)
{
	uint64_t sum;
	char description[120];

	timing_start();
	TICK_SYNCH();

	int_to_interrupted_thread(num_iterations, &sum);

	sum -= timestamp_overhead_adjustment(0, 0);

	snprintf(description, sizeof(description),
		 "%-40s - Return from ISR to interrupted thread",
		 "isr.resume.interrupted.thread.kernel");
	PRINT_STATS_AVG(description, (uint32_t)sum, num_iterations, false, "");

	/* ************** */

	int_to_another_thread(num_iterations, &sum, 0);

	sum -= timestamp_overhead_adjustment(0, 0);

	snprintf(description, sizeof(description),
		 "%-40s - Return from ISR to another thread",
		 "isr.resume.different.thread.kernel");
	PRINT_STATS_AVG(description, (uint32_t)sum, num_iterations, false, "");

	/* ************** */

#if CONFIG_USERSPACE
	int_to_another_thread(num_iterations, &sum, K_USER);

	sum -= timestamp_overhead_adjustment(0, K_USER);

	snprintf(description, sizeof(description),
		 "%-40s - Return from ISR to another thread",
		 "isr.resume.different.thread.user");
	PRINT_STATS_AVG(description, (uint32_t)sum, num_iterations, false, "");
#endif

	timing_stop();
	return 0;
}
```

## src/lifo.c
```c
/*
 * Copyright (c) 2024 Intel Corporation
 *
 * SPDX-License-Identifier: Apache-2.0
 */

/*
 * @file measure time for various LIFO operations
 *
 * This file contains the tests that measures the times for the following
 * LIFO operations from both kernel threads and user threads:
 *  1. Immediately adding a data item to a LIFO
 *  2. Immediately removing a data item from a LIFO
 *  3. Immediately adding a data item to a LIFO with allocation
 *  4. Immediately removing a data item from a LIFO with allocation
 *  5. Blocking on removing a data item from a LIFO
 *  6. Waking (and context switching to) a thread blocked on a LIFO via
 *     k_lifo_put().
 *  7. Waking (and context switching to) a thread blocked on a LIFO via
 *     k_lifo_alloc_put().
 */

#include <zephyr/kernel.h>
#include <zephyr/timing/timing.h>
#include "utils.h"
#include "timing_sc.h"

#define STACK_SIZE (512 + CONFIG_TEST_EXTRA_STACK_SIZE)

static K_LIFO_DEFINE(lifo);

BENCH_BMEM uintptr_t lifo_data[5];

static void lifo_put_get_thread_entry(void *p1, void *p2, void *p3)
{
	uint32_t num_iterations = (uint32_t)(uintptr_t)p1;
	uint32_t options = (uint32_t)(uintptr_t)p2;
	timing_t start;
	timing_t mid;
	timing_t finish;
	uint64_t put_sum = 0ULL;
	uint64_t get_sum = 0ULL;
	uintptr_t *data;

	if ((options & K_USER) == 0) {
		for (uint32_t i = 0; i < num_iterations; i++) {
			start = timing_timestamp_get();

			k_lifo_put(&lifo, lifo_data);

			mid = timing_timestamp_get();

			data = k_lifo_get(&lifo, K_NO_WAIT);

			finish = timing_timestamp_get();

			put_sum += timing_cycles_get(&start, &mid);
			get_sum += timing_cycles_get(&mid, &finish);
		}

		timestamp.cycles = put_sum;
		k_sem_take(&pause_sem, K_FOREVER);

		timestamp.cycles = get_sum;
		k_sem_take(&pause_sem, K_FOREVER);

		put_sum = 0ULL;
		get_sum = 0ULL;
	}

	for (uint32_t i = 0; i < num_iterations; i++) {
		start = timing_timestamp_get();

		k_lifo_alloc_put(&lifo, lifo_data);

		mid = timing_timestamp_get();

		data = k_lifo_get(&lifo, K_NO_WAIT);

		finish = timing_timestamp_get();

		put_sum += timing_cycles_get(&start, &mid);
		get_sum += timing_cycles_get(&mid, &finish);
	}

	timestamp.cycles = put_sum;
	k_sem_take(&pause_sem, K_FOREVER);

	timestamp.cycles = get_sum;
}

int lifo_ops(uint32_t num_iterations, uint32_t options)
{
	int      priority;
	uint64_t cycles;
	char     tag[50];
	char     description[120];

	priority = k_thread_priority_get(k_current_get());

	timing_start();

	k_thread_create(&start_thread, start_stack,
			K_THREAD_STACK_SIZEOF(start_stack),
			lifo_put_get_thread_entry,
			(void *)(uintptr_t)num_iterations,
			(void *)(uintptr_t)options, NULL,
			priority - 1, options, K_FOREVER);

	k_thread_access_grant(&start_thread, &pause_sem, &lifo);

	k_thread_start(&start_thread);

	if ((options & K_USER) == 0) {
		snprintf(tag, sizeof(tag),
			 "lifo.put.immediate.%s",
			 options & K_USER ? "user" : "kernel");
		snprintf(description, sizeof(description),
			 "%-40s - Add data to LIFO (no ctx switch)", tag);

		cycles = timestamp.cycles;
		cycles -= timestamp_overhead_adjustment(options, options);
		PRINT_STATS_AVG(description, (uint32_t)cycles,
				num_iterations, false, "");
		k_sem_give(&pause_sem);

		snprintf(tag, sizeof(tag),
			 "lifo.get.immediate.%s",
			 options & K_USER ? "user" : "kernel");
		snprintf(description, sizeof(description),
			 "%-40s - Get data from LIFO (no ctx switch)", tag);
		cycles = timestamp.cycles;
		cycles -= timestamp_overhead_adjustment(options, options);
		PRINT_STATS_AVG(description, (uint32_t)cycles,
				num_iterations, false, "");
		k_sem_give(&pause_sem);
	}

	snprintf(tag, sizeof(tag),
		 "lifo.put.alloc.immediate.%s",
		 options & K_USER ? "user" : "kernel");
	snprintf(description, sizeof(description),
		 "%-40s - Allocate to add data to LIFO (no ctx switch)", tag);

	cycles = timestamp.cycles;
	PRINT_STATS_AVG(description, (uint32_t)cycles,
			num_iterations, false, "");
	k_sem_give(&pause_sem);

	snprintf(tag, sizeof(tag),
		 "lifo.get.free.immediate.%s",
		 options & K_USER ? "user" : "kernel");
	snprintf(description, sizeof(description),
		 "%-40s - Free when getting data from LIFO (no ctx switch)", tag);
	cycles = timestamp.cycles;
	PRINT_STATS_AVG(description, (uint32_t)cycles,
			num_iterations, false, "");

	k_thread_join(&start_thread, K_FOREVER);

	timing_stop();

	return 0;
}

static void alt_thread_entry(void *p1, void *p2, void *p3)
{
	uint32_t num_iterations = (uint32_t)(uintptr_t)p1;
	uint32_t options = (uint32_t)(uintptr_t)p2;
	timing_t  start;
	timing_t  mid;
	timing_t  finish;
	uint64_t  sum[4] = {0ULL, 0ULL, 0ULL, 0ULL};
	uintptr_t *data;
	uint32_t  i;

	if ((options & K_USER) == 0) {

		/* Used with k_lifo_put() */

		for (i = 0; i < num_iterations; i++) {

			/* 1. Block waiting for data on LIFO */

			start = timing_timestamp_get();

			data = k_lifo_get(&lifo, K_FOREVER);

			/* 3. Data obtained. */

			finish = timing_timestamp_get();

			mid = timestamp.sample;

			sum[0] += timing_cycles_get(&start, &mid);
			sum[1] += timing_cycles_get(&mid, &finish);
		}
	}

	/* Used with k_lifo_alloc_put() */

	for (i = 0; i < num_iterations; i++) {

		/* 4. Block waiting for data on LIFO */

		start = timing_timestamp_get();

		data = k_lifo_get(&lifo, K_FOREVER);

		/* 6. Data obtained */

		finish = timing_timestamp_get();

		mid = timestamp.sample;

		sum[2] += timing_cycles_get(&start, &mid);
		sum[3] += timing_cycles_get(&mid, &finish);
	}

	if ((options & K_USER) == 0) {
		timestamp.cycles = sum[0];
		k_sem_take(&pause_sem, K_FOREVER);
		timestamp.cycles = sum[1];
		k_sem_take(&pause_sem, K_FOREVER);
	}

	timestamp.cycles = sum[2];
	k_sem_take(&pause_sem, K_FOREVER);
	timestamp.cycles = sum[3];
}

static void start_thread_entry(void *p1, void *p2, void *p3)
{
	uint32_t num_iterations = (uint32_t)(uintptr_t)p1;
	uint32_t options = (uint32_t)(uintptr_t)p2;
	uint32_t i;

	k_thread_start(&alt_thread);

	if ((options & K_USER) == 0) {
		for (i = 0; i < num_iterations; i++) {

			/* 2. Add data thereby waking alt thread */

			timestamp.sample = timing_timestamp_get();

			k_lifo_put(&lifo, lifo_data);

		}
	}

	for (i = 0; i < num_iterations; i++) {

		/* 5. Add data thereby waking alt thread */

		timestamp.sample = timing_timestamp_get();

		k_lifo_alloc_put(&lifo, lifo_data);

	}

	k_thread_join(&alt_thread, K_FOREVER);
}

int lifo_blocking_ops(uint32_t num_iterations, uint32_t start_options,
		      uint32_t alt_options)
{
	int      priority;
	uint64_t cycles;
	char     tag[50];
	char     description[120];

	priority = k_thread_priority_get(k_current_get());

	timing_start();

	k_thread_create(&start_thread, start_stack,
			K_THREAD_STACK_SIZEOF(start_stack),
			start_thread_entry,
			(void *)(uintptr_t)num_iterations,
			(void *)(uintptr_t)(start_options | alt_options), NULL,
			priority - 1, start_options, K_FOREVER);

	k_thread_create(&alt_thread, alt_stack,
			K_THREAD_STACK_SIZEOF(alt_stack),
			alt_thread_entry,
			(void *)(uintptr_t)num_iterations,
			(void *)(uintptr_t)(start_options | alt_options), NULL,
			priority - 2, alt_options, K_FOREVER);

	k_thread_access_grant(&start_thread, &alt_thread, &pause_sem, &lifo);
	k_thread_access_grant(&alt_thread, &pause_sem, &lifo);

	k_thread_start(&start_thread);

	if (((start_options | alt_options) & K_USER) == 0) {
		snprintf(tag, sizeof(tag),
			 "lifo.get.blocking.%s_to_%s",
			 alt_options & K_USER ? "u" : "k",
			 start_options & K_USER ? "u" : "k");
		snprintf(description, sizeof(description),
			 "%-40s - Get data from LIFO (w/ ctx switch)", tag);

		cycles = timestamp.cycles;
		PRINT_STATS_AVG(description, (uint32_t)cycles,
				num_iterations, false, "");
		k_sem_give(&pause_sem);

		snprintf(tag, sizeof(tag),
			 "lifo.put.wake+ctx.%s_to_%s",
			 start_options & K_USER ? "u" : "k",
			 alt_options & K_USER ? "u" : "k");
		snprintf(description, sizeof(description),
			 "%-40s - Add data to LIFO (w/ ctx switch)", tag);
		cycles = timestamp.cycles;
		PRINT_STATS_AVG(description, (uint32_t)cycles,
				num_iterations, false, "");
		k_sem_give(&pause_sem);
	}

	snprintf(tag, sizeof(tag),
		 "lifo.get.free.blocking.%s_to_%s",
		 alt_options & K_USER ? "u" : "k",
		 start_options & K_USER ? "u" : "k");
	snprintf(description, sizeof(description),
		 "%-40s - Free when getting data from LIFO (w/ ctx switch)", tag);

	cycles = timestamp.cycles;
	PRINT_STATS_AVG(description, (uint32_t)cycles,
			num_iterations, false, "");
	k_sem_give(&pause_sem);

	snprintf(tag, sizeof(tag),
		 "lifo.put.alloc.wake+ctx.%s_to_%s",
		 start_options & K_USER ? "u" : "k",
		 alt_options & K_USER ? "u" : "k");
	snprintf(description, sizeof(description),
		 "%-40s - Allocate to add data to LIFO (w/ ctx siwtch)", tag);
	cycles = timestamp.cycles;
	PRINT_STATS_AVG(description, (uint32_t)cycles,
			num_iterations, false, "");

	k_thread_join(&start_thread, K_FOREVER);

	timing_stop();

	return 0;
}
```

## src/mutex_lock_unlock.c
```c
/*
 * Copyright (c) 2012-2015 Wind River Systems, Inc.
 * Copyright (c) 2020,2023 Intel Corporation
 *
 * SPDX-License-Identifier: Apache-2.0
 */

/*
 * @file measure time for mutex lock and unlock
 *
 * This file contains the test that measures mutex lock and unlock times
 * in the kernel. There is no contention on the mutex being tested.
 */

#include <zephyr/kernel.h>
#include <zephyr/timing/timing.h>
#include "utils.h"
#include "timing_sc.h"

static K_MUTEX_DEFINE(test_mutex);

static void start_lock_unlock(void *p1, void *p2, void *p3)
{
	uint32_t  i;
	uint32_t  num_iterations = (uint32_t)(uintptr_t)p1;
	timing_t  start;
	timing_t  finish;
	uint64_t  lock_cycles;
	uint64_t  unlock_cycles;

	ARG_UNUSED(p2);
	ARG_UNUSED(p3);

	start = timing_timestamp_get();

	/* Recursively lock take the mutex */

	for (i = 0; i < num_iterations; i++) {
		k_mutex_lock(&test_mutex, K_NO_WAIT);
	}

	finish = timing_timestamp_get();

	lock_cycles = timing_cycles_get(&start, &finish);

	start = timing_timestamp_get();

	/* Recursively unlock the mutex */

	for (i = 0; i < num_iterations; i++) {
		k_mutex_unlock(&test_mutex);
	}

	finish = timing_timestamp_get();

	unlock_cycles = timing_cycles_get(&start, &finish);

	timestamp.cycles = lock_cycles;
	k_sem_take(&pause_sem, K_FOREVER);

	timestamp.cycles = unlock_cycles;
}


/**
 *
 * @brief Test for the multiple mutex lock/unlock time
 *
 * The routine performs multiple mutex locks and then multiple mutex
 * unlocks to measure the necessary time.
 *
 * @return 0 on success
 */
int mutex_lock_unlock(uint32_t num_iterations, uint32_t options)
{
	char tag[50];
	char description[120];
	int  priority;
	uint64_t  cycles;

	timing_start();

	priority = k_thread_priority_get(k_current_get());

	k_thread_create(&start_thread, start_stack,
			K_THREAD_STACK_SIZEOF(start_stack),
			start_lock_unlock,
			(void *)(uintptr_t)num_iterations, NULL, NULL,
			priority - 1, options, K_FOREVER);

	k_thread_access_grant(&start_thread, &test_mutex, &pause_sem);
	k_thread_start(&start_thread);

	cycles = timestamp.cycles;
	k_sem_give(&pause_sem);

	snprintf(tag, sizeof(tag),
		 "mutex.lock.immediate.recursive.%s",
		 (options & K_USER) == K_USER ? "user" : "kernel");
	snprintf(description, sizeof(description),
		 "%-40s - Lock a mutex", tag);
	PRINT_STATS_AVG(description, (uint32_t)cycles, num_iterations,
			false, "");

	cycles = timestamp.cycles;

	snprintf(tag, sizeof(tag),
		 "mutex.unlock.immediate.recursive.%s",
		 (options & K_USER) == K_USER ? "user" : "kernel");
	snprintf(description, sizeof(description),
		 "%-40s - Unlock a mutex", tag);
	PRINT_STATS_AVG(description, (uint32_t)cycles, num_iterations,
			false, "");

	timing_stop();
	return 0;
}
```

## src/timing_sc.c
```c
/*
 * Copyright (c) 2023 Intel Corporation
 *
 * SPDX-License-Identifier: Apache-2.0
 */

/*
 * @file
 * This file contains routines for implementing a timestamp system call
 * as well as routines for determining the overhead associated with it.
 */

#include <zephyr/kernel.h>
#include "utils.h"
#include "timing_sc.h"

BENCH_BMEM uint64_t timestamp_overhead;
#ifdef CONFIG_USERSPACE
BENCH_BMEM uint64_t user_timestamp_overhead;
#endif

timing_t z_impl_timing_timestamp_get(void)
{
	return timing_counter_get();
}

#ifdef CONFIG_USERSPACE
timing_t z_vrfy_timing_timestamp_get(void)
{
	return z_impl_timing_timestamp_get();
}
#include <zephyr/syscalls/timing_timestamp_get_mrsh.c>
#endif

static void start_thread_entry(void *p1, void *p2, void *p3)
{
	uint32_t  num_iterations = (uint32_t)(uintptr_t)p1;
	timing_t  start;
	timing_t  finish;

	ARG_UNUSED(p2);
	ARG_UNUSED(p3);

	start = timing_timestamp_get();
	for (uint32_t i = 0; i < num_iterations; i++) {
		timing_timestamp_get();
	}
	finish = timing_timestamp_get();

	timestamp.cycles = timing_cycles_get(&start, &finish);
}

void timestamp_overhead_init(uint32_t num_iterations)
{
	int  priority;

	priority = k_thread_priority_get(k_current_get());

	k_thread_create(&start_thread, start_stack,
			K_THREAD_STACK_SIZEOF(start_stack),
			start_thread_entry,
			(void *)(uintptr_t)num_iterations, NULL, NULL,
			priority - 1, 0, K_FOREVER);

	k_thread_start(&start_thread);

	k_thread_join(&start_thread, K_FOREVER);

	timestamp_overhead = timestamp.cycles;

#ifdef CONFIG_USERSPACE
	k_thread_create(&start_thread, start_stack,
			K_THREAD_STACK_SIZEOF(start_stack),
			start_thread_entry,
			(void *)(uintptr_t)num_iterations, NULL, NULL,
			priority - 1, K_USER, K_FOREVER);

	k_thread_start(&start_thread);

	k_thread_join(&start_thread, K_FOREVER);

	user_timestamp_overhead = timestamp.cycles;
#endif
}

uint64_t timestamp_overhead_adjustment(uint32_t options1, uint32_t options2)
{
#ifdef CONFIG_USERSPACE
	if (((options1 | options2) & K_USER) == K_USER) {
		if (((options1 & options2) & K_USER) == K_USER) {
			/*
			 * Both start and finish timestamps were obtained
			 * from userspace.
			 */
			return user_timestamp_overhead;
		}
		/*
		 * One timestamp came from userspace, and the other came
		 * from kernel space. Estimate the overhead as the mean
		 * between the two.
		 */
		return (timestamp_overhead + user_timestamp_overhead) / 2;
	}
#endif

	/*
	 * Both start and finish timestamps were obtained
	 * from kernel space.
	 */
	return timestamp_overhead;
}
```
