## CMakeLists.txt
```
# SPDX-License-Identifier: Apache-2.0

cmake_minimum_required(VERSION 3.20.0)

find_package(Zephyr REQUIRED HINTS $ENV{ZEPHYR_BASE})
project(posix_uname)

target_sources(app PRIVATE src/main.c)
```

## sample.yaml
```
sample:
  description: posix uname sample
  name: posix uname
common:
  tags: posix
  platform_exclude:
    - native_posix
    - native_posix/native/64
  integration_platforms:
    - native_sim
    - qemu_riscv64
  harness: console
  harness_config:
    type: multi_line
    ordered: true
    regex:
      - "sysname\\[7\\]: Zephyr"
      - "nodename\\[\\d+\\]: .*"
      - "release\\[\\d+\\]: \\d+\\.\\d+\\.\\d+"
      - "version\\[\\d+\\]: .*"
      - "machine\\[\\d+\\]: .*"
tests:
  sample.posix.uname:
    tags: uname
```

## prj.conf
```kconfig
CONFIG_POSIX_API=y
CONFIG_SHELL=y
CONFIG_POSIX_UNAME_SHELL=y
CONFIG_MP_MAX_NUM_CPUS=1
```

## src/main.c
```c
/*
 * Copyright (c) 2023 Meta
 *
 * SPDX-License-Identifier: Apache-2.0
 */

#include <stdio.h>
#include <sys/utsname.h>

int main(void)
{
	struct utsname info;

	uname(&info);

	printf("\nPrinting everything in utsname...\n");
	printf("sysname[%zu]: %s\n", sizeof(info.sysname), info.sysname);
	printf("nodename[%zu]: %s\n", sizeof(info.nodename), info.nodename);
	printf("release[%zu]: %s\n", sizeof(info.release), info.release);
	printf("version[%zu]: %s\n", sizeof(info.version), info.version);
	printf("machine[%zu]: %s\n", sizeof(info.machine), info.machine);

	return 0;
}
```
