## CMakeLists.txt
```
# Copyright (c) Google LLC
# SPDX-License-Identifier: Apache-2.0

cmake_minimum_required(VERSION 3.20.0)

find_package(Zephyr REQUIRED HINTS $ENV{ZEPHYR_BASE})
project(chre_sample)

FILE(GLOB app_sources src/*.cpp)
target_sources(app PRIVATE ${app_sources})
target_include_directories(app PRIVATE include)
```

## sample.yaml
```
sample:
  description: A simple echo app using Android's Context Hub Runtime Environment (CHRE).
  name: chre
tests:
  sample.modules.chre:
    tags:
      - introduction
      - chre
    platform_exclude: qemu_leon3
    modules:
      - chre
    harness: console
    harness_config:
      type: multi_line
      ordered: false
      regex:
        - "Hello CHRE!"
        - "I: EventLoop start.*"
        - "D: Instance ID 1 assigned to app ID 0x0000000000000001.*"
        - "EchoApp::nanoappStart\\(\\)"
        - "EchoApp::nanoappHandleEvent\\(sender_instance_id=0, event_type=1, event_data@(\\\
        (nil\\))|0\\)"
        - "Event \\(1\\) complete!"
        - "EchoApp::nanoappEnd\\(\\)"
        - "I: Exiting EventLoop.*"
    integration_platforms:
      - native_sim
    filter: CONFIG_FULL_LIBC_SUPPORTED
```

## prj.conf
```kconfig
CONFIG_CHRE=y
CONFIG_LOG=y
CONFIG_LOG_MODE_MINIMAL=y
CONFIG_CHRE_LOG_LEVEL_DBG=y

CONFIG_CPP=y
CONFIG_STD_CPP17=y
```

## src/main.cpp
```c
/* Copyright (c) 2021 Google LLC
 * SPDX-License-Identifier: Apache-2.0
 */

#include <zephyr/kernel.h>
#include <zephyr/sys/printk.h>
#include <zephyr/logging/log_ctrl.h>

#include "apps.hpp"
#include "chre/core/event_loop_manager.h"
#include "chre/target_platform/init.h"

inline const char *boolToString(bool cond)
{
	return cond ? "SUCCESS" : "FAIL";
}

int main(void)
{
	auto echo_app = chre::initializeStaticNanoappEchoApp();
	auto& eventLoop = chre::EventLoopManagerSingleton::get()->getEventLoop();
	uint32_t instanceId;

	if (chre::zephyr::init()) {
		printk("Failed to initialize!\n");
		return -1;
	}

	printk("Hello CHRE!\n");

	k_msleep(500);
	/*
	 * Flush all log messages that resulted from initialization to avoid
	 * getting them mingled with those printk messages below.
	 */
	while (IS_ENABLED(CONFIG_LOG_PROCESS_THREAD) && log_data_pending()) {
		k_msleep(100);
	}
	printk("Starting EchoApp... %s\n", boolToString(eventLoop.startNanoapp(echo_app)));
	printk("Nanoapp count=%zu\n", eventLoop.getNanoappCount());
	printk("Finding instance ID... %s\n", boolToString(eventLoop.findNanoappInstanceIdByAppId(1, &instanceId)));
	printk("Nanoapp count=%zu\n", eventLoop.getNanoappCount());
	printk("Instance ID: %u\n", instanceId);

	printk("Sending event %zu...\n", eventLoop.getNanoappCount());
	eventLoop.postEventOrDie(CHRE_EVENT_MESSAGE_FROM_HOST, nullptr, [](uint16_t eventType, void *eventData) {
		printk("Event (%u) complete!\n", eventType);
	});

	k_sleep(K_MSEC(500));
	printk("Ending EchoApp... %s\n",
	       boolToString(eventLoop.unloadNanoapp(instanceId, false)));
	chre::zephyr::deinit();
	printk("Goodbye!\n");
	return 0;
}
```

## include/apps.hpp
```c
/* Copyright (c) 2021 Google LLC
 * SPDX-License-Identifier: Apache-2.0
 */

#ifndef SAMPLES_APPLICATION_DEVELOPMENT_CHRE_INCLUDE_APPS_H_
#define SAMPLES_APPLICATION_DEVELOPMENT_CHRE_INCLUDE_APPS_H_

#include "chre/core/nanoapp.h"
#include "chre/util/unique_ptr.h"

namespace chre {

UniquePtr<Nanoapp> initializeStaticNanoappEchoApp();

}  /* namespace chre */

#endif /* SAMPLES_APPLICATION_DEVELOPMENT_CHRE_INCLUDE_APPS_H_ */
```

## src/echoapp.cpp
```c
/* Copyright (c) 2021 Google LLC
 * SPDX-License-Identifier: Apache-2.0
 */

#include <cinttypes>
#include <zephyr/sys/printk.h>

#include "chre_api/chre/event.h"
#include "chre/core/event_loop_manager.h"
#include "chre/platform/static_nanoapp_init.h"
#include "chre/util/system/napp_permissions.h"

namespace
{
constexpr const uint64_t kAppId = 1;
constexpr const uint32_t kAppVersion = 1;

chre::Nanoapp *nanoapp = nullptr;

bool nanoappStart(void)
{
	printk("EchoApp::nanoappStart()\n");
	nanoapp = chre::EventLoopManagerSingleton ::get()->getEventLoop().getCurrentNanoapp();
	nanoapp->registerForBroadcastEvent(CHRE_EVENT_MESSAGE_FROM_HOST);
	return true;
}

void nanoappHandleEvent(uint32_t sender_instance_id, uint16_t event_type, const void *event_data)
{
	printk("EchoApp::nanoappHandleEvent(sender_instance_id=%u, event_type=%u, event_data@%p)\n",
	       sender_instance_id, event_type, event_data);
}

void nanoappEnd()
{
	nanoapp->unregisterForBroadcastEvent(0);
	nanoapp = nullptr;
	printk("EchoApp::nanoappEnd()\n");
}

} /* anonymous namespace */

CHRE_STATIC_NANOAPP_INIT(EchoApp, kAppId, kAppVersion, chre::NanoappPermissions::CHRE_PERMS_NONE);
```
