## CMakeLists.txt
```
# Copyright 2022 Meta
# SPDX-License-Identifier: Apache-2.0

cmake_minimum_required(VERSION 3.20.0)
find_package(Zephyr REQUIRED HINTS $ENV{ZEPHYR_BASE})
project(thrift_hello_server)

FILE(GLOB app_sources
    src/*.cpp
)

include(${ZEPHYR_BASE}/modules/thrift/cmake/thrift.cmake)

set(generated_sources "")
set(gen_dir ${ZEPHYR_BINARY_DIR}/misc/generated/thrift_hello)
list(APPEND generated_sources ${gen_dir}/gen-cpp/hello_types.h)
list(APPEND generated_sources ${gen_dir}/gen-cpp/Hello.cpp)
list(APPEND generated_sources ${gen_dir}/gen-cpp/Hello.h)
list(APPEND app_sources ${generated_sources})

thrift(
    app
    cpp
    :no_skeleton
    ${gen_dir}
    ${ZEPHYR_BASE}/samples/modules/thrift/hello/hello.thrift
    ""
    ${generated_sources}
)

target_sources(app PRIVATE ${app_sources})

# needed because std::iterator was deprecated with -std=c++17
target_compile_options(app PRIVATE -Wno-deprecated-declarations)

# convert .pem files to array data at build time
zephyr_include_directories(${gen_dir})

generate_inc_file_for_target(
    app
    ${ZEPHYR_BASE}/samples/modules/thrift/hello/qemu-cert.pem
    ${gen_dir}/qemu_cert.pem.inc
    )

generate_inc_file_for_target(
    app
    ${ZEPHYR_BASE}/samples/modules/thrift/hello/qemu-key.pem
    ${gen_dir}/qemu_key.pem.inc
    )

generate_inc_file_for_target(
    app
    ${ZEPHYR_BASE}/samples/modules/thrift/hello/native-cert.pem
    ${gen_dir}/native_cert.pem.inc
    )

generate_inc_file_for_target(
    app
    ${ZEPHYR_BASE}/samples/modules/thrift/hello/native-key.pem
    ${gen_dir}/native_key.pem.inc
    )
```

## sample.yaml
```
sample:
  description: Hello Thrift client sample
  name: hello thrift client
common:
  tags:
    - thrift
    - cpp
    - sample
  build_only: true
  modules:
    - thrift
  platform_allow:
    - mps2/an385
    - qemu_x86_64
  integration_platforms:
    - qemu_x86_64
  filter: CONFIG_FULL_LIBCPP_SUPPORTED
tests:
  sample.thrift.hello.client.binaryProtocol: {}
  sample.thrift.hello.client.compactProtocol:
    extra_configs:
      - CONFIG_THRIFT_COMPACT_PROTOCOL=y
  sample.thrift.hello.client.tlsTransport:
    extra_args: OVERLAY_CONFIG="../overlay-tls.conf"
```

## prj.conf
```kconfig
CONFIG_REQUIRES_FULL_LIBCPP=y

# CONFIG_THRIFT Dependencies
CONFIG_CPP=y
CONFIG_STD_CPP17=y
CONFIG_CPP_EXCEPTIONS=y
CONFIG_POSIX_API=y
CONFIG_XOPEN_STREAMS=y
CONFIG_COMMON_LIBC_THRD=y
CONFIG_DYNAMIC_THREAD=y
CONFIG_THREAD_STACK_INFO=y
CONFIG_NETWORKING=y
CONFIG_NET_SOCKETS=y
CONFIG_NET_SOCKETPAIR=y
CONFIG_HEAP_MEM_POOL_SIZE=16384
CONFIG_EVENTFD=y

CONFIG_THRIFT=y

CONFIG_TEST_RANDOM_GENERATOR=y
# pthread_cond_wait() triggers sentinel for some reason
CONFIG_STACK_SENTINEL=n

# Generic networking options
CONFIG_NETWORKING=y
CONFIG_NET_UDP=y
CONFIG_NET_TCP=y
CONFIG_NET_IPV6=n
CONFIG_NET_IPV4=y
CONFIG_NET_SOCKETS=y
CONFIG_ZVFS_OPEN_MAX=6
CONFIG_NET_CONNECTION_MANAGER=y

# Kernel options
CONFIG_ENTROPY_GENERATOR=y
CONFIG_TEST_RANDOM_GENERATOR=y
CONFIG_INIT_STACKS=y

# Logging
CONFIG_NET_LOG=y
CONFIG_LOG=y
CONFIG_NET_STATISTICS=y
CONFIG_PRINTK=y

# Network buffers
CONFIG_NET_PKT_RX_COUNT=16
CONFIG_NET_PKT_TX_COUNT=16
CONFIG_NET_BUF_RX_COUNT=64
CONFIG_NET_BUF_TX_COUNT=64
CONFIG_NET_CONTEXT_NET_PKT_POOL=y

# IP address options
CONFIG_NET_MAX_CONTEXTS=10

# Network application options and configuration
CONFIG_NET_CONFIG_SETTINGS=y
CONFIG_NET_CONFIG_NEED_IPV6=n
CONFIG_NET_CONFIG_NEED_IPV4=y
CONFIG_NET_CONFIG_MY_IPV4_ADDR="192.0.2.1"
CONFIG_NET_CONFIG_PEER_IPV4_ADDR="192.0.2.2"

# Number of socket descriptors might need adjusting
# if there are more than 1 handlers defined.
CONFIG_ZVFS_OPEN_MAX=16

# Some platforms require relatively large stack sizes.
# This can be tuned per-board.
CONFIG_MAIN_STACK_SIZE=8192
CONFIG_SYSTEM_WORKQUEUE_STACK_SIZE=8192
CONFIG_NET_TCP_WORKQ_STACK_SIZE=4096
CONFIG_NET_MGMT_EVENT_STACK_SIZE=4096
CONFIG_IDLE_STACK_SIZE=4096
CONFIG_NET_RX_STACK_SIZE=8192
```

## src/main.cpp
```c
/*
 * Copyright 2022 Young Mei
 *
 * SPDX-License-Identifier: Apache-2.0
 */

#ifdef __ZEPHYR__
#include <zephyr/kernel.h>
#endif

#include <cstdlib>
#include <iostream>

#include <fcntl.h>

#include <thrift/protocol/TBinaryProtocol.h>
#include <thrift/protocol/TCompactProtocol.h>
#include <thrift/transport/TBufferTransports.h>
#include <thrift/transport/TSSLSocket.h>
#include <thrift/transport/TSocket.h>

#include "Hello.h"

using namespace apache::thrift;
using namespace apache::thrift::protocol;
using namespace apache::thrift::transport;

#ifndef IS_ENABLED
#define IS_ENABLED(flag) flag
#endif

#ifndef CONFIG_THRIFT_COMPACT_PROTOCOL
#define CONFIG_THRIFT_COMPACT_PROTOCOL 0
#endif

#ifndef CONFIG_THRIFT_SSL_SOCKET
#define CONFIG_THRIFT_SSL_SOCKET 0
#endif

#ifdef __ZEPHYR__
int main(void)
#else
int main(int argc, char **argv)
#endif
{
	std::string my_addr;

#ifdef __ZEPHYR__
	my_addr = CONFIG_NET_CONFIG_PEER_IPV4_ADDR;
#else
	if (IS_ENABLED(CONFIG_THRIFT_SSL_SOCKET)) {
		if (argc != 5) {
			printf("usage: %s <ip> <native-cert.pem> <native-key.pem> "
			       "<qemu-cert.pem>\n",
			       argv[0]);
			return EXIT_FAILURE;
		}
	}

	if (argc >= 2) {
		my_addr = std::string(argv[1]);
	} else {
		my_addr = "192.0.2.1";
	}
#endif

	int port = 4242;
	std::shared_ptr<TProtocol> protocol;
	std::shared_ptr<TTransport> transport;
	std::shared_ptr<TSSLSocketFactory> socketFactory;
	std::shared_ptr<TTransport> trans;

	if (IS_ENABLED(CONFIG_THRIFT_SSL_SOCKET)) {
		const int port = 4242;
		socketFactory = std::make_shared<TSSLSocketFactory>();
		socketFactory->authenticate(true);

#ifdef __ZEPHYR__
		static const char qemu_cert_pem[] = {
#include "qemu_cert.pem.inc"
			'\0'
		};

		static const char qemu_key_pem[] = {
#include "qemu_key.pem.inc"
			'\0'
		};

		static const char native_cert_pem[] = {
#include "native_cert.pem.inc"
			'\0'
		};

		socketFactory->loadCertificateFromBuffer(qemu_cert_pem);
		socketFactory->loadPrivateKeyFromBuffer(qemu_key_pem);
		socketFactory->loadTrustedCertificatesFromBuffer(native_cert_pem);
#else
		socketFactory->loadCertificate(argv[2]);
		socketFactory->loadPrivateKey(argv[3]);
		socketFactory->loadTrustedCertificates(argv[4]);
#endif
		trans = socketFactory->createSocket(my_addr, port);
	} else {
		trans = std::make_shared<TSocket>(my_addr, port);
	}

	transport = std::make_shared<TBufferedTransport>(trans);

	if (IS_ENABLED(CONFIG_THRIFT_COMPACT_PROTOCOL)) {
		protocol = std::make_shared<TCompactProtocol>(transport);
	} else {
		protocol = std::make_shared<TBinaryProtocol>(transport);
	}

	HelloClient client(protocol);

	try {
		transport->open();
		client.ping();
		std::string s;
		client.echo(s, "Hello, world!");
		for (int i = 0; i < 5; ++i) {
			client.counter();
		}

		transport->close();
	} catch (std::exception &e) {
		printf("caught exception: %s\n", e.what());
		return EXIT_FAILURE;
	}

	return EXIT_SUCCESS;
}
```
