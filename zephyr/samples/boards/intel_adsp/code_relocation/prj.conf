## CMakeLists.txt
```
# SPDX-License-Identifier: Apache-2.0

cmake_minimum_required(VERSION 3.20.0)

find_package(Zephyr REQUIRED HINTS $ENV{ZEPHYR_BASE})
project(adsp_cavs_code_relocation)

target_sources(app PRIVATE src/main.c src/reloc.c)

zephyr_code_relocate(FILES src/reloc.c LOCATION SRAM2_LITERAL)
zephyr_code_relocate(FILES src/reloc.c LOCATION SRAM2_TEXT)
zephyr_code_relocate(FILES src/reloc.c LOCATION SRAM3_DATA)
zephyr_code_relocate(FILES src/reloc.c LOCATION SRAM3_RODATA)
zephyr_code_relocate(FILES src/reloc.c LOCATION SRAM4_BSS)
```

## sample.yaml
```
sample:
  description: Code relocation sample for Intel ADSP Cavs.
  name: cavs_code_reloc
tests:
  sample.intel_adsp.code_relocation:
    platform_allow: intel_adsp/cavs25
    tags: linker
```

## prj.conf
```kconfig
CONFIG_CODE_DATA_RELOCATION=y
CONFIG_HAVE_CUSTOM_LINKER_SCRIPT=y
CONFIG_CUSTOM_LINKER_SCRIPT="linker_xtensa_intel_adsp_cavs.ld"
```

## app.overlay
```dts
/ {
	sram3: memory@be1e0000 {
		device_type = "memory";
		compatible = "mmio-sram";
		reg = <0xbe1e0000 DT_SIZE_K(64)>;
	};
};
```

## src/main.c
```c
/*
 * Copyright (c) 2022 Intel Corporation
 *
 * SPDX-License-Identifier: Apache-2.0
 */

#include <zephyr/kernel.h>

extern void reloc(void);

int main(void)
{
	printk("%s location: %p\n", __func__, main);
	printk("Calling relocated code\n");
	reloc();
	return 0;
}
```

## src/reloc.c
```c
/*
 * Copyright (c) 2022 Intel Corporation
 *
 * SPDX-License-Identifier: Apache-2.0
 */

#include <zephyr/kernel.h>

static uint32_t maybe_bss;

void reloc(void)
{
	printk("Relocated code! %s location %p\n", __func__, reloc);
	printk("maybe_bss location: %p maybe_bss value: %u\n", &maybe_bss,
	       maybe_bss);
}
```
