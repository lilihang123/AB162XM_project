## CMakeLists.txt
```
# SPDX-License-Identifier: Apache-2.0

cmake_minimum_required(VERSION 3.20.0)
find_package(Zephyr REQUIRED HINTS $ENV{ZEPHYR_BASE})
project(uart_stm32_single_wire)

target_sources(app PRIVATE
    src/main.c
    )
```

## sample.yaml
```
sample:
  name: STM32 Single Wire UART sample
tests:
  sample.boards.stm32.uart.single_wire:
    platform_allow: stm32f3_disco
    tags:
      - drivers
      - uart
    harness: console
    harness_config:
      fixture: single_line_uart_loopback
      type: one_line
      regex:
        - "Received c"
```

## prj.conf
```kconfig
# Nothing needed here
```

## boards/stm32f3_disco.overlay
```dts
/*
 * Copyright (c) 2021 Jonathan Hahn
 *
 * SPDX-License-Identifier: Apache-2.0
 */

/ {
	 aliases {
		single-line-uart1 = &usart2;
		single-line-uart2 = &uart4;
	};
};

&usart2 {
	pinctrl-0 = <&usart2_tx_pa2>;
	single-wire;
};

&uart4 {
	pinctrl-0 = <&uart4_tx_pc10>;
	single-wire;
};
```

## src/main.c
```c
/*
 * Copyright (c) 2021 Jonathan Hahn
 *
 * SPDX-License-Identifier: Apache-2.0
 */

#include <zephyr/kernel.h>
#include <zephyr/device.h>
#include <zephyr/devicetree.h>
#include <zephyr/drivers/uart.h>

#define UART_NODE1 DT_ALIAS(single_line_uart1)
#define UART_NODE2 DT_ALIAS(single_line_uart2)

const struct device *const sl_uart1 = DEVICE_DT_GET(UART_NODE1);
const struct device *const sl_uart2 = DEVICE_DT_GET(UART_NODE2);

int main(void)
{
	unsigned char recv;

	if (!device_is_ready(sl_uart1) || !device_is_ready(sl_uart2)) {
		printk("uart devices not ready\n");
		return 0;
	}

	while (true) {

		uart_poll_out(sl_uart1, 'c');

		/* give the uarts some time to get the data through */
		k_sleep(K_MSEC(50));

		int ret = uart_poll_in(sl_uart2, &recv);

		if (ret < 0) {
			printk("Receiving failed. Error: %d", ret);
		} else {
			printk("Received %c\n", recv);
		}

		k_sleep(K_MSEC(2000));
	}
	return 0;
}
```
