## CMakeLists.txt
```
# SPDX-License-Identifier: Apache-2.0

cmake_minimum_required(VERSION 3.20.0)

find_package(Zephyr REQUIRED HINTS $ENV{ZEPHYR_BASE})
project(spiram_test)

target_sources(app PRIVATE src/main.c)
```

## sample.yaml
```
sample:
  description: Application to test memory allocation from SPIRAM
  name: spiram_test
tests:
  sample.board.esp32.spiram:
    platform_allow: esp32_devkitc_wrover/esp32/procpu
    tags: esp32
    harness: console
    harness_config:
      type: multi_line
      regex:
        - "SPIRAM mem test pass"
        - "Internal mem test pass"
```

## prj.conf
```kconfig
CONFIG_ESP_SPIRAM=y
CONFIG_ESP_HEAP_MIN_EXTRAM_THRESHOLD=2048
CONFIG_HEAP_MEM_POOL_SIZE=98304
CONFIG_ESP_HEAP_SEARCH_ALL_REGIONS=n
```

## src/main.c
```c
/*
 * Copyright (c) 2021 Espressif Systems (Shanghai) Co., Ltd.
 *
 * SPDX-License-Identifier: Apache-2.0
 */

#include <zephyr/kernel.h>
#include <zephyr/sys/printk.h>
#include <soc/soc_memory_layout.h>

static int check_allocated_memory(int *m1, size_t size)
{
	int ret = 0;

	if (size < CONFIG_ESP_HEAP_MIN_EXTRAM_THRESHOLD) {
		if (!esp_ptr_internal(m1)) {
			printk("Memory allocation is not within"
					" specified bounds\n");
			ret = -1;
		}
	} else {
		if (!esp_ptr_external_ram(m1)) {
			printk("Memory allocation is not within"
					" specified bounds\n");
			ret = -1;
		}
	}
	return ret;
}

static int test_heap_caps(size_t size)
{
	int *m1, *m2;
	int cnt = 0, err = 0;

	m2 = NULL;
	/* Allocated as much as we can, and create linked list */
	while ((m1 = k_malloc(size))) {
		if (check_allocated_memory(m1, size) == -1) {
			err = -1;
			goto ret;
		}
		*(int **) m1 = m2;
		m2 = m1;
		cnt++;
	}

	/* Free all allocated memory */
	while (m2) {
		m1 = *(int **) m2;
		k_free(m2);
		m2 = m1;
	}
	/* Confirm that allocation can succeed now */
	m1 = k_malloc(size);
	if (check_allocated_memory(m1, size) == -1) {
		err = -1;
		goto ret;
	}
	if (!m1) {
		err = -1;
	} else {
		k_free(m1);
		printk("mem test ok! %d\n", cnt);
	}
ret:
	return err;
}

int main(void)
{
	int err = test_heap_caps(10001);

	if (err == -1) {
		printk("SPIRAM mem test failed\n");
	} else {
		printk("SPIRAM mem test pass\n");
	}

	err = test_heap_caps(1001);
	if (err == -1) {
		printk("Internal mem test failed\n");
	} else {
		printk("Internal mem test pass\n");
	}
	return 0;
}
```
