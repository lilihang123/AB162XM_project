## CMakeLists.txt
```
# SPDX-License-Identifier: Apache-2.0

cmake_minimum_required(VERSION 3.20.0)

find_package(Zephyr REQUIRED HINTS $ENV{ZEPHYR_BASE})
project(flash_memory_mapped)

target_sources(app PRIVATE src/main.c)
```

## sample.yaml
```
sample:
  description: Sample application to test memory-mapped flash region
  name: flash_memory_mapped
tests:
  sample.board.esp32.flash_memory_mapped:
    platform_allow:
      - esp32_devkitc_wroom/esp32/procpu
      - esp32c3_devkitm
      - esp32s3_devkitm/esp32s3/procpu
    harness: console
    harness_config:
      type: one_line
      regex:
        - "memory-mapped reading matches flash API read"
```

## prj.conf
```kconfig
CONFIG_LOG=y
CONFIG_FLASH=y
CONFIG_FLASH_PAGE_LAYOUT=y
```

## src/main.c
```c
/*
 * Copyright (c) 2023 Espressif Systems (Shanghai) Co., Ltd.
 *
 * SPDX-License-Identifier: Apache-2.0
 */

#include <zephyr/kernel.h>
#include <zephyr/sys/printk.h>
#include <zephyr/device.h>
#include <zephyr/drivers/flash.h>
#include <zephyr/storage/flash_map.h>

#include <spi_flash_mmap.h>
#include <soc.h>

#include <zephyr/logging/log.h>
LOG_MODULE_REGISTER(flash_memory_mapped, CONFIG_LOG_DEFAULT_LEVEL);

int main(void)
{
	uint8_t buffer[32];
	const struct device *flash_device;
	const void *mem_ptr;
	spi_flash_mmap_handle_t handle;
	off_t address = FIXED_PARTITION_OFFSET(scratch_partition);
	size_t size = FIXED_PARTITION_SIZE(scratch_partition);

	flash_device = DEVICE_DT_GET(DT_CHOSEN(zephyr_flash_controller));
	if (!device_is_ready(flash_device)) {
		printk("%s: device not ready.\n", flash_device->name);
		return 0;
	}

	/* map selected region */
	spi_flash_mmap(address, size, SPI_FLASH_MMAP_DATA, &mem_ptr, &handle);
	LOG_INF("memory-mapped pointer address: %p", mem_ptr);

	/* erase and read flash */
	flash_erase(flash_device, address, size);
	LOG_HEXDUMP_INF(mem_ptr, 32, "flash read using memory-mapped pointer");

	LOG_INF("writing 32-bytes data using flash API");
	memset(buffer, 0, sizeof(buffer));
	for (int k = 0; k < 32; k++) {
		buffer[k] = k;
	}
	flash_write(flash_device, address, buffer, 32);

	/* read using flash API */
	memset(buffer, 0, sizeof(buffer));
	flash_read(flash_device, address, buffer, 32);
	LOG_HEXDUMP_INF(buffer, 32, "flash read using flash API");

	LOG_HEXDUMP_INF(mem_ptr, 32, "flash read using memory-mapped pointer");

	if (memcmp(buffer, mem_ptr, 32) == 0) {
		LOG_INF("memory-mapped reading matches flash API read");
	} else {
		LOG_ERR("memory-mapped reading does not match flash API read");
	}

	/* unmap mapped region */
	spi_flash_munmap(handle);

	return 0;
}
```
