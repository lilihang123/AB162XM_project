## CMakeLists.txt
```
# SPDX-License-Identifier: Apache-2.0

cmake_minimum_required(VERSION 3.20.0)

find_package(Zephyr REQUIRED HINTS $ENV{ZEPHYR_BASE})
project(hello_cpp_world)

target_sources(app PRIVATE src/main.cpp)
```

## sample.yaml
```
sample:
  description: Hello World C++ sample, the simplest C++ Zephyr application
  name: hello cpp world
common:
  tags: introduction
  integration_platforms:
    - qemu_riscv32
  harness: console
  harness_config:
    type: one_line
    regex:
      - "Hello, C\\+\\+ world! (.*)"
tests:
  sample.cpp.helloworld:
    min_ram: 128
    arch_exclude:
      # See #66027
      - xtensa
    platform_exclude:
      # See zephyrproject-rtos/sdk-ng#593
      - qemu_x86
      - intel_ish_5_4_1
      - intel_ish_5_6_0
      - intel_ish_5_8_0
```

## prj.conf
```kconfig
CONFIG_CPP=y
CONFIG_REQUIRES_FULL_LIBCPP=y
```

## src/main.cpp
```c
/*
 * Copyright (c) 2023, Meta
 *
 * SPDX-License-Identifier: Apache-2.0
 */

#include <iostream>

int main(void)
{
	std::cout << "Hello, C++ world! " << CONFIG_BOARD << std::endl;
	return 0;
}
```
