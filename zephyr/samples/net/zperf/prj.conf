## CMakeLists.txt
```
# SPDX-License-Identifier: Apache-2.0

cmake_minimum_required(VERSION 3.20.0)

find_package(Zephyr REQUIRED HINTS $ENV{ZEPHYR_BASE})
project(zperf)

target_sources(app PRIVATE
  src/main.c
  )

if (CONFIG_NET_SAMPLE_CODE_RELOCATE)
  # Relocate key networking stack components and L2 layer to RAM
  zephyr_code_relocate(LIBRARY subsys__net__ip
    LOCATION "${CONFIG_NET_SAMPLE_CODE_RAM_NAME}_TEXT" NOKEEP)
  zephyr_code_relocate(LIBRARY subsys__net
    LOCATION "${CONFIG_NET_SAMPLE_CODE_RAM_NAME}_TEXT" NOKEEP)
if (CONFIG_NET_L2_ETHERNET)
  zephyr_code_relocate(LIBRARY drivers__ethernet
    LOCATION "${CONFIG_NET_SAMPLE_CODE_RAM_NAME}_TEXT" NOKEEP)
  zephyr_code_relocate(LIBRARY subsys__net__l2__ethernet
    LOCATION "${CONFIG_NET_SAMPLE_CODE_RAM_NAME}_TEXT" NOKEEP)
endif()
endif()
```

## Kconfig
```
# Copyright 2023 NXP
# SPDX-License-Identifier: Apache-2.0

source "Kconfig.zephyr"

config NET_SAMPLE_CODE_RELOCATE
	bool "Relocate networking code into RAM"
	select CODE_DATA_RELOCATION
	help
	  Relocate networking code into RAM when running the zperf
	  sample. Can improve performance on platforms with fast code
	  RAM.

if NET_SAMPLE_CODE_RELOCATE

config NET_SAMPLE_CODE_RAM_NAME
	string "Networking code RAM location"
	default "RAM"
	help
	  Region to relocate networking code to

endif # NET_SAMPLE_CODE_RELOCATE
```

## sample.yaml
```
common:
  tags:
    - net
    - zperf
  # TODO: Does not work properly with native_posix, need more TLC
  platform_exclude:
    - native_posix
    - native_posix/native/64
    - sam_e70_xplained/same70q21
  min_ram: 64
sample:
  description: Network performance measurement tool for Zephyr
  name: zperf
tests:
  sample.net.zperf:
    harness: net
    platform_allow: qemu_x86
  sample.net.zperf_st:
    harness: console
    harness_config:
      type: multi_line
      regex:
        - "coming up"
    platform_allow:
      - nucleo_h563zi
      - nucleo_h743zi
      - nucleo_f429zi
      - nucleo_f746zg
      - stm32h573i_dk
  sample.net.zperf_no_shell:
    harness: net
    extra_configs:
      - CONFIG_NET_SHELL=n
    platform_allow: qemu_x86
  sample.net.zperf.netusb_ecm:
    harness: net
    extra_args: OVERLAY_CONFIG="overlay-netusb.conf"
    tags:
      - usb
      - net
      - zperf
    depends_on: usb_device
    # native_sim usb driver does not work with CONFIG_POSIX_API
    platform_exclude:
      - native_sim
      - native_sim/native/64
      - native_posix
      - native_posix/native/64
  sample.net.zperf.device_next_ecm:
    harness: net
    extra_args: OVERLAY_CONFIG="overlay-usbd_next_ecm.conf"
                DTC_OVERLAY_FILE="usbd_next_ecm.overlay"
    platform_allow: nrf52840dk/nrf52840 frdm_k64f
    tags: usb net zperf
    depends_on: usb_device
  sample.net.zperf.netusb_eem:
    harness: net
    extra_args: OVERLAY_CONFIG="overlay-netusb.conf"
    extra_configs:
      - CONFIG_USB_DEVICE_NETWORK_ECM=n
      - CONFIG_USB_DEVICE_NETWORK_EEM=y
    tags:
      - usb
      - net
      - zperf
    depends_on: usb_device
    # native_sim usb driver does not work with CONFIG_POSIX_API
    platform_exclude:
      - native_sim
      - native_sim/native/64
      - native_posix
      - native_posix/native/64
  sample.net.zperf.netusb_rndis:
    harness: net
    extra_args: OVERLAY_CONFIG="overlay-netusb.conf"
    extra_configs:
      - CONFIG_USB_DEVICE_NETWORK_ECM=n
      - CONFIG_USB_DEVICE_NETWORK_RNDIS=y
    tags:
      - usb
      - net
      - zperf
    depends_on: usb_device
    # native_sim usb driver does not work with CONFIG_POSIX_API
    platform_exclude:
      - native_sim
      - native_sim/native/64
      - native_posix
      - native_posix/native/64
  sample.net.zperf.shield:
    harness: net
    platform_allow: reel_board
    extra_args: SHIELD=link_board_eth
    tags:
      - shield
      - net
      - zperf
    depends_on:
      - arduino_spi
      - arduino_gpio
  sample.net.zperf.nxp_enet1g:
    extra_args: EXTRA_DTC_OVERLAY_FILE="nxp,enet1g.overlay"
    tags:
      - net
      - zperf
    platform_allow:
      - mimxrt1170_evk/mimxrt1176/cm7
```

## prj.conf
```kconfig
CONFIG_NETWORKING=y
CONFIG_NET_ZPERF=y
CONFIG_NET_LOG=y
CONFIG_NET_IPV6=y
CONFIG_NET_IPV4=y
CONFIG_NET_DHCPV4=n
CONFIG_NET_UDP=y
CONFIG_NET_TCP=y
CONFIG_NET_TCP_IPV6_ND_REACHABILITY_HINT=y
CONFIG_NET_STATISTICS=y

CONFIG_NET_PKT_RX_COUNT=40
CONFIG_NET_PKT_TX_COUNT=40
CONFIG_NET_BUF_RX_COUNT=160
CONFIG_NET_BUF_TX_COUNT=160
CONFIG_NET_BUF_DATA_SIZE=256
CONFIG_NET_IF_UNICAST_IPV6_ADDR_COUNT=4
CONFIG_NET_IF_MCAST_IPV6_ADDR_COUNT=5
CONFIG_NET_IF_UNICAST_IPV4_ADDR_COUNT=1
CONFIG_NET_MAX_CONTEXTS=5
CONFIG_NET_TC_TX_COUNT=1
CONFIG_NET_SOCKETS=y
CONFIG_NET_SOCKETS_SERVICE_THREAD_PRIO=-1
CONFIG_NET_SOCKETS_POLL_MAX=9
CONFIG_ZVFS_OPEN_MAX=12
CONFIG_POSIX_API=y

CONFIG_INIT_STACKS=y
CONFIG_TEST_RANDOM_GENERATOR=y

CONFIG_NET_L2_ETHERNET=y
CONFIG_NET_SHELL=y

CONFIG_NET_CONFIG_SETTINGS=y
CONFIG_NET_CONFIG_MY_IPV6_ADDR="2001:db8::1"
CONFIG_NET_CONFIG_PEER_IPV6_ADDR="2001:db8::2"
CONFIG_NET_CONFIG_MY_IPV4_ADDR="192.0.2.1"
CONFIG_NET_CONFIG_PEER_IPV4_ADDR="192.0.2.2"

CONFIG_LOG=y
CONFIG_SHELL_CMDS_RESIZE=n

CONFIG_CACHE_MANAGEMENT=y
CONFIG_SPEED_OPTIMIZATIONS=y
```

## overlay-loopback.conf
```kconfig
CONFIG_NET_DRIVERS=y
CONFIG_NET_LOOPBACK=y
CONFIG_NET_LOOPBACK_MTU=1100
# Enable for testing TX only
CONFIG_NET_LOOPBACK_SIMULATE_PACKET_DROP=y

CONFIG_NET_BUF_DATA_SIZE=1100
# Optimized networking settings for performance
CONFIG_NET_PKT_RX_COUNT=32
CONFIG_NET_PKT_TX_COUNT=48
CONFIG_NET_BUF_RX_COUNT=32
CONFIG_NET_BUF_TX_COUNT=96
```

## overlay-netusb.conf
```kconfig
# USB Device Settings
CONFIG_USB_DEVICE_STACK=y

# Select USB Configurations
CONFIG_USB_DEVICE_NETWORK_ECM=y
CONFIG_USB_DEVICE_INITIALIZE_AT_BOOT=n
```

## overlay-usbd_next_ecm.conf
```kconfig
CONFIG_USB_DEVICE_STACK_NEXT=y

CONFIG_LOG=y
CONFIG_USBD_LOG_LEVEL_WRN=y
CONFIG_UDC_DRIVER_LOG_LEVEL_WRN=y
```

## boards/fvp_base_revc_2xaemv8a.conf
```kconfig
CONFIG_NET_DHCPV4=y
CONFIG_MDIO=y
CONFIG_MDIO_SHELL=n
CONFIG_NET_IPV6=n
CONFIG_NET_CONFIG_MY_IPV4_ADDR=""
CONFIG_NET_CONFIG_PEER_IPV4_ADDR=""
CONFIG_MDIO_INIT_PRIORITY=81
CONFIG_PHY_INIT_PRIORITY=82
CONFIG_NET_BUF_RX_COUNT=56
CONFIG_NET_BUF_TX_COUNT=56
```

## boards/fvp_baser_aemv8r.conf
```kconfig
CONFIG_NET_DHCPV4=y
CONFIG_MDIO=y
CONFIG_MDIO_SHELL=n
CONFIG_NET_IPV6=n
CONFIG_NET_CONFIG_MY_IPV4_ADDR=""
CONFIG_NET_CONFIG_PEER_IPV4_ADDR=""
CONFIG_MDIO_INIT_PRIORITY=81
CONFIG_PHY_INIT_PRIORITY=82
```

## boards/mimxrt1050_evk.conf
```kconfig
# Note: HW accleration does not support IPV6
CONFIG_ETH_NXP_ENET_HW_ACCELERATION=y
CONFIG_NET_SAMPLE_CODE_RELOCATE=y
CONFIG_NET_SAMPLE_CODE_RAM_NAME="ITCM"
```

## usbd_next_ecm.overlay
```dts
/*
 * Copyright (c) 2023 Nordic Semiconductor ASA
 *
 * SPDX-License-Identifier: Apache-2.0
 */

/ {
	cdc_ecm_eth0: cdc_ecm_eth0 {
		compatible = "zephyr,cdc-ecm-ethernet";
		remote-mac-address = "00005E005301";
	};
};
```

## boards/fvp_baser_aemv8r.overlay
```dts
&eth {
	status = "okay";
};

&phy {
	status = "okay";
};

&mdio {
	status = "okay";
};
```

## src/main.c
```c
/*
 * Copyright (c) 2020 Nordic Semiconductor ASA
 *
 * SPDX-License-Identifier: Apache-2.0
 */

/**
 * @file
 * @brief Zperf sample.
 */
#include <zephyr/usb/usb_device.h>
#include <zephyr/net/net_config.h>

#ifdef CONFIG_NET_LOOPBACK_SIMULATE_PACKET_DROP
#include <zephyr/net/loopback.h>
#endif
int main(void)
{
#if defined(CONFIG_USB_DEVICE_STACK)
	int ret;

	ret = usb_enable(NULL);
	if (ret != 0) {
		printk("usb enable error %d\n", ret);
	}

	(void)net_config_init_app(NULL, "Initializing network");
#endif /* CONFIG_USB_DEVICE_STACK */
#ifdef CONFIG_NET_LOOPBACK_SIMULATE_PACKET_DROP
	loopback_set_packet_drop_ratio(1);
#endif
	return 0;
}
```
