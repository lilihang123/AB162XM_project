## CMakeLists.txt
```
# SPDX-License-Identifier: Apache-2.0

cmake_minimum_required(VERSION 3.20.0)

find_package(Zephyr REQUIRED HINTS $ENV{ZEPHYR_BASE})
project(ncp)

target_sources( app
    PRIVATE
        src/main.c
)

include(${ZEPHYR_BASE}/samples/net/common/common.cmake)

set(gen_dir ${ZEPHYR_BINARY_DIR}/include/generated/)
```

## sample.yaml
```
common:
  harness: net
  tags:
    - net
    - openthread
  depends_on: openthread
  min_flash: 140
sample:
  description: Runs the OpenThread stack as NCP BR
  name: OpenThread Network Co-Processor
tests:
  sample.net.openthread.coprocessor:
    build_only: true
    platform_allow:
      - nrf52840dk/nrf52840
      - nrf52833dk/nrf52833
      - tlsr9518adk80d
    integration_platforms:
      - nrf52840dk/nrf52840
  sample.net.openthread.coprocessor.usb:
    build_only: true
    platform_allow:
      - nrf52840dk/nrf52840
      - nrf52833dk/nrf52833
    integration_platforms:
      - nrf52840dk/nrf52840
    tags: ci_build
    extra_args:
      - OVERLAY_CONFIG=overlay-usb-nrf-br.conf
      - DTC_OVERLAY_FILE="usb.overlay"
  sample.openthread.coprocessor.rcp:
    build_only: true
    platform_allow:
      - nrf52840dk/nrf52840
      - nrf52833dk/nrf52833
      - tlsr9518adk80d
    integration_platforms:
      - nrf52840dk/nrf52840
    extra_args: OVERLAY_CONFIG=overlay-rcp.conf
```

## prj.conf
```kconfig
CONFIG_NETWORKING=y
CONFIG_NET_L2_OPENTHREAD=y

# Disable certain parts of Zephyr IPv6 stack
CONFIG_NET_IPV6_NBR_CACHE=n
CONFIG_NET_IPV6_MLD=n

# Logging
CONFIG_LOG=y
CONFIG_LOG_MAX_LEVEL=1
CONFIG_LOG_MODE_MINIMAL=n
CONFIG_LOG_BACKEND_SPINEL=y
CONFIG_LOG_BACKEND_RTT=y
CONFIG_LOG_BACKEND_UART=n
CONFIG_BOOT_BANNER=n

# Kernel options
CONFIG_MAIN_STACK_SIZE=2560
CONFIG_INIT_STACKS=y

# Increase logging thread stack size due to Spinel backend needs
CONFIG_LOG_PROCESS_THREAD_STACK_SIZE=2048

# Set OpenThread NCP architecture
CONFIG_OPENTHREAD_COPROCESSOR=y
CONFIG_OPENTHREAD_COPROCESSOR_NCP=y

# Add features required for NCP
CONFIG_OPENTHREAD_DIAG=y
CONFIG_OPENTHREAD_DHCP6_SERVER=y
CONFIG_OPENTHREAD_COMMISSIONER=y
CONFIG_OPENTHREAD_BORDER_AGENT=y
CONFIG_OPENTHREAD_BORDER_ROUTER=y
CONFIG_OPENTHREAD_UDP_FORWARD=y
CONFIG_OPENTHREAD_ENABLE_SERVICE=y
```

## overlay-tri-n4m-br.conf
```kconfig
# TRI n4m BR
CONFIG_SHELL_PROMPT_UART="ncp-uart:~$ "

CONFIG_STDOUT_CONSOLE=y
CONFIG_GPIO=y
CONFIG_USB_DEVICE_STACK=y
CONFIG_USB_DEVICE_PRODUCT="OpenThread Co-Processor K64"
CONFIG_LOG=y
CONFIG_USB_DRIVER_LOG_LEVEL_ERR=y
CONFIG_USB_CDC_ACM=y
CONFIG_USB_DEVICE_LOG_LEVEL_ERR=y
CONFIG_SERIAL=y
CONFIG_UART_INTERRUPT_DRIVEN=y
CONFIG_UART_LINE_CTRL=y
CONFIG_USB_REQUEST_BUFFER_SIZE=2048

# disable ethernet on K64
CONFIG_NET_L2_ETHERNET=n
CONFIG_ETH_MCUX=n

CONFIG_ISR_STACK_SIZE=4096
```

## overlay-usb-nrf-br.conf
```kconfig
# Nordic NCP USB CDC-ACM

CONFIG_SHELL_PROMPT_UART="ncp-uart:~$ "

# Use USB-CDC-ACM for Co-Processor
CONFIG_USB_DEVICE_STACK=y
CONFIG_USB_DEVICE_PRODUCT="OpenThread CoProcessor NRF"
CONFIG_USB_CDC_ACM=y
CONFIG_UART_LINE_CTRL=y
CONFIG_USB_REQUEST_BUFFER_SIZE=2048

CONFIG_ISR_STACK_SIZE=4096
```

## boards/tlsr9518adk80d.conf
```kconfig
# Telink B91 TLSR9518ADK80D

CONFIG_IEEE802154_B91_RANDOM_MAC=n
CONFIG_IEEE802154_B91_MAC4=0x01
CONFIG_IEEE802154_B91_MAC5=0x02
CONFIG_IEEE802154_B91_MAC6=0x03
CONFIG_IEEE802154_B91_MAC7=0x04
```

## usb.overlay
```dts
/*
 * Copyright (c) 2021 Nordic Semiconductor ASA
 *
 * SPDX-License-Identifier: Apache-2.0
 */

/ {
	chosen {
		zephyr,ot-uart = &cdc_acm_uart0;
	};
};

&zephyr_udc0 {
	cdc_acm_uart0: cdc_acm_uart0 {
		compatible = "zephyr,cdc-acm-uart";
	};
};
```

## boards/nrf52840dk_nrf52840.overlay
```dts
/*
 * Copyright (c) 2021 Nordic Semiconductor ASA
 *
 * SPDX-License-Identifier: Apache-2.0
 */

/ {
	chosen {
		zephyr,ot-uart = &uart0;
		zephyr,console = &uart1;
	};
};

&uart1 {
	status = "okay";
};
```

## boards/tlsr9518adk80d.overlay
```dts
/*
 * Copyright (c) 2021 Telink Semiconductor
 *
 * SPDX-License-Identifier: Apache-2.0
 */

/ {
	chosen {
		zephyr,ot-uart = &uart0;
		zephyr,console = &uart1;
	};
};

&uart0 {
	status = "okay";
	current-speed = <57600>;
	pinctrl-0 = <&uart0_tx_pb2_default &uart0_rx_pb3_default>;
	pinctrl-names = "default";
};

&uart1 {
	status = "okay";
	current-speed = <115200>;
	pinctrl-0 = <&uart1_tx_pc6_default &uart1_rx_pc7_default>;
	pinctrl-names = "default";
};
```

## src/main.c
```c
/* main.c - OpenThread NCP */

/*
 * Copyright (c) 2020 Tridonic GmbH & Co KG
 *
 * SPDX-License-Identifier: Apache-2.0
 */

#include <zephyr/logging/log.h>
LOG_MODULE_REGISTER(ot_br, LOG_LEVEL_DBG);

#define APP_BANNER "***** OpenThread NCP on Zephyr %s *****"

int main(void)
{
	LOG_INF(APP_BANNER, CONFIG_NET_SAMPLE_APPLICATION_VERSION);
	return 0;
}
```
