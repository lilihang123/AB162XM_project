## CMakeLists.txt
```
# SPDX-License-Identifier: Apache-2.0

cmake_minimum_required(VERSION 3.20.0)
find_package(Zephyr REQUIRED HINTS $ENV{ZEPHYR_BASE})
project(led_is31fl3194)

target_sources(app PRIVATE src/main.c)
```

## sample.yaml
```
sample:
  description: Demonstration of the IS31FL3194 LED driver
  name: is31fl3194 sample
tests:
  sample.drivers.led.is31fl3194:
    filter: dt_compat_enabled("issi,is31fl3194")
    tags: LED
    depends_on: i2c
    integration_platforms:
      - arduino_nicla_sense_me
```

## prj.conf
```kconfig
CONFIG_LED=y
CONFIG_LOG=y
```

## src/main.c
```c
/*
 * Copyright (c) 2024 Arduino SA
 *
 * SPDX-License-Identifier: Apache-2.0
 */

#include <stdio.h>
#include <zephyr/kernel.h>
#include <zephyr/drivers/led.h>

/* 1000 msec = 1 sec */
#define SLEEP_TIME_MS   1000

/* Structure describing a color by its component values and name */
struct color_data {
	uint8_t r, g, b;
	const char *name;
};

/* The sequence of colors the RGB LED will display */
static const struct color_data color_sequence[] = {
	{ 0xFF, 0x00, 0x00, "Red" },
	{ 0x00, 0xFF, 0x00, "Green" },
	{ 0x00, 0x00, 0xFF, "Blue" },
	{ 0xFF, 0xFF, 0xFF, "White" },
	{ 0xFF, 0xFF, 0x00, "Yellow" },
	{ 0xFF, 0x00, 0xFF, "Purple" },
	{ 0x00, 0xFF, 0xFF, "Cyan" },
	{ 0xF4, 0x79, 0x20, "Orange" },
};

/*
 * A build error on this line means your board is unsupported.
 */
const struct device *led = DEVICE_DT_GET_ANY(issi_is31fl3194);

int main(void)
{
	int ret;
	int i = 0;

	if (!device_is_ready(led)) {
		return 0;
	}

	while (1) {
		ret = led_set_color(led, 0, 3, &(color_sequence[i].r));
		if (ret < 0) {
			return 0;
		}

		printk("LED color: %s\n", color_sequence[i].name);
		k_msleep(SLEEP_TIME_MS);
		i = (i + 1) % ARRAY_SIZE(color_sequence);
	}

	return 0;
}
```
