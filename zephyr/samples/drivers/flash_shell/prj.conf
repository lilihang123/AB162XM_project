## CMakeLists.txt
```
# SPDX-License-Identifier: Apache-2.0

cmake_minimum_required(VERSION 3.20.0)
find_package(Zephyr REQUIRED HINTS $ENV{ZEPHYR_BASE})
project(flash_shell)

FILE(GLOB app_sources src/*.c)
target_sources(app PRIVATE ${app_sources})
```

## sample.yaml
```
sample:
  description: Shell commands for inspecting flash driver behavior
  name: Flash shell
tests:
  sample.drivers.flash.shell:
    tags:
      - flash
      - shell
    filter: CONFIG_FLASH_HAS_DRIVER_ENABLED
    platform_exclude:
      - nucleo_h745zi_q/stm32h745xx/m4
      - stm32h7s78_dk
      - stm32h745i_disco/stm32h745xx/m4
      - stm32h747i_disco/stm32h747xx/m4
      - gd32f350r_eval
      - arduino_portenta_h7/stm32h747xx/m4
      - arduino_giga_r1/stm32h747xx/m4
    harness: keyboard
    min_ram: 12
    integration_platforms:
      - qemu_x86
```

## prj.conf
```kconfig
CONFIG_PRINTK=y
CONFIG_SHELL=y
CONFIG_LOG=y
CONFIG_FLASH=y
CONFIG_FLASH_SHELL=y
CONFIG_FLASH_SHELL_TEST_COMMANDS=y
```

## boards/gd32vf103c_starter.conf
```kconfig
# This board only has 32KB SRAM, can not afford 16 KB memory pool, use 8KB instead.
CONFIG_HEAP_MEM_POOL_SIZE=8192
```

## boards/cy8cproto_062_4343w.overlay
```dts
&flash0 {
	partitions {
		#address-cells = <1>;
		#size-cells = <1>;
		compatible = "fixed-partitions";

		/* Set 3Kb of storage at the end of the of 2Mb flash 0 */
		storage_partition: partition@1ff400 {
			label = "storage";
			reg = <0x1ff400 DT_SIZE_K(3)>;
		};
	};
};
```

## src/main.c
```c
/*
 * Copyright (c) 2017 Linaro Limited
 *
 * SPDX-License-Identifier: Apache-2.0
 */

#include <stdio.h>

int main(void)
{
	printf("Flash shell sample");

	return 0;
}
```
