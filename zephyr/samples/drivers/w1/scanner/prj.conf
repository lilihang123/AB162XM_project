## CMakeLists.txt
```
cmake_minimum_required(VERSION 3.20.0)
find_package(Zephyr REQUIRED HINTS $ENV{ZEPHYR_BASE})
project(w1-scanner)

target_sources(app PRIVATE src/main.c)
```

## sample.yaml
```
sample:
  name: 1-Wire scanner sample

common:
  harness: console

tests:
  sample.drivers.w1.scanner.ds2482-800:
    depends_on: arduino_i2c
    extra_args: DTC_OVERLAY_FILE=ds2482-800.overlay
    platform_allow: nrf52840dk/nrf52840
    harness_config:
      type: one_line
      regex:
        - "Number of devices found on bus: .*"
      fixture: w1_scanner_ds2482_800
  sample.drivers.w1.scanner.ds2484:
    depends_on: arduino_i2c
    extra_args: DTC_OVERLAY_FILE=ds2484.overlay
    platform_allow:
      - nrf52840dk/nrf52840
      - nucleo_g0b1re
    harness_config:
      type: one_line
      regex:
        - "Number of devices found on bus: .*"
      fixture: w1_scanner_ds2484
  samples.drivers.w1.scanner.ds2485:
    depends_on: arduino_i2c
    extra_args: DTC_OVERLAY_FILE=ds2485.overlay
    platform_allow:
      - nrf52840dk/nrf52840
      - nucleo_g0b1re
    harness_config:
      type: one_line
      regex:
        - "Number of devices found on bus: .*"
      fixture: w1_scanner_ds2485
  samples.drivers.w1.scanner.w1_serial:
    depends_on:
      - arduino_serial
    extra_args: DTC_OVERLAY_FILE=w1_serial.overlay
    platform_allow:
      - nrf52840dk/nrf52840
      - nucleo_g0b1re
    harness_config:
      type: one_line
      regex:
        - "Number of devices found on bus: .*"
      fixture: w1_scanner_w1_serial
```

## prj.conf
```kconfig
CONFIG_LOG=y
CONFIG_W1=y
```

## src/main.c
```c
/*
 * Copyright (c) 2022 Caspar Friedrich <c.s.w.friedrich@gmail.com>
 *
 * SPDX-License-Identifier: Apache-2.0
 */

#include <zephyr/device.h>
#include <zephyr/devicetree.h>
#include <zephyr/drivers/w1.h>
#include <zephyr/logging/log.h>

LOG_MODULE_REGISTER(main, CONFIG_LOG_DEFAULT_LEVEL);

void w1_search_callback(struct w1_rom rom, void *user_data)
{
	LOG_INF("Device found; family: 0x%02x, serial: 0x%016llx", rom.family,
		w1_rom_to_uint64(&rom));
}

int main(void)
{
	const struct device *const dev = DEVICE_DT_GET(DT_NODELABEL(w1));

	if (!device_is_ready(dev)) {
		LOG_ERR("Device not ready");
		return 0;
	}

	int num_devices = w1_search_rom(dev, w1_search_callback, NULL);

	LOG_INF("Number of devices found on bus: %d", num_devices);
	return 0;
}
```
