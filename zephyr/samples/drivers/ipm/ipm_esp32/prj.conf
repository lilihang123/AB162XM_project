## CMakeLists.txt
```
# SPDX-License-Identifier: Apache-2.0

cmake_minimum_required(VERSION 3.20.0)

set(REMOTE_ZEPHYR_DIR ${CMAKE_CURRENT_BINARY_DIR}/ipm_esp32_appcpu-prefix/src/ipm_esp32_appcpu-build/zephyr)

if("${BOARD}" STREQUAL "esp32_devkitc_wrover/esp32/procpu")
  set(BOARD_REMOTE "esp32_devkitc_wrover/esp32/appcpu")
elseif("${BOARD}" STREQUAL "esp32_devkitc_wroom/esp32/procpu")
  set(BOARD_REMOTE "esp32_devkitc_wroom/esp32/appcpu")
elseif("${BOARD}" STREQUAL "esp32s3_devkitm/esp32s3/procpu")
  set(BOARD_REMOTE "esp32s3_devkitm/esp32s3/appcpu")
else()
  message(FATAL_ERROR "${BOARD} was not supported for this sample")
endif()

find_package(Zephyr REQUIRED HINTS $ENV{ZEPHYR_BASE})
project(ipm_esp32)

set_source_files_properties(${REMOTE_ZEPHYR_DIR}/esp32_appcpu_firmware.c PROPERTIES GENERATED TRUE)
target_sources(app PRIVATE src/main.c ${REMOTE_ZEPHYR_DIR}/esp32_appcpu_firmware.c)

include(ExternalProject)

ExternalProject_Add(
	ipm_esp32_appcpu
	SOURCE_DIR ${APPLICATION_SOURCE_DIR}/ipm_esp_appcpu
	INSTALL_COMMAND ""
	CMAKE_CACHE_ARGS -DBOARD:STRING=${BOARD_REMOTE}
	BUILD_BYPRODUCTS "${REMOTE_ZEPHYR_DIR}/${KERNEL_BIN_NAME}"
	BUILD_ALWAYS True
)

add_dependencies(app ipm_esp32_appcpu)
```

## sample.yaml
```
sample:
  name: ESP32 IPM Sample
tests:
  sample.ipm.ipm_esp32:
    platform_allow:
      - esp32_devkitc_wroom/esp32/procpu
      - esp32_devkitc_wrover/esp32/procpu
    tags:
      - samples
      - ipm
    skip: true
```

## prj.conf
```kconfig
CONFIG_IPM=y
CONFIG_LOG=y
```

## boards/yd_esp32_procpu.overlay
```dts
&ipm0 {
	status = "okay";
};
```

## src/main.c
```c
/*
 * Copyright (c) 2022 Espressif Systems (Shanghai) Co., Ltd.
 *
 * SPDX-License-Identifier: Apache-2.0
 */

#include <zephyr/kernel.h>
#include <zephyr/sys/printk.h>
#include <zephyr/drivers/ipm.h>
#include <zephyr/device.h>
#include <string.h>

static const char fake_request[] = {"PRO_CPU: Fake request to APP_CPU"};

static const struct device *ipm_dev;
static char received_string[64];
static struct k_sem sync;

static void ipm_receive_callback(const struct device *ipmdev, void *user_data,
			       uint32_t id, volatile void *data)
{
	ARG_UNUSED(ipmdev);
	ARG_UNUSED(user_data);

	strcpy(received_string, (const char *)data);
	k_sem_give(&sync);
}

int main(void)
{
	k_sem_init(&sync, 0, 1);

	ipm_dev = DEVICE_DT_GET(DT_NODELABEL(ipm0));
	if (!ipm_dev) {
		printk("Failed to get IPM device.\n\r");
		return 0;
	}

	ipm_register_callback(ipm_dev, ipm_receive_callback, NULL);

	while (1) {
		printk("PRO_CPU is sending a fake request, waiting remote response...\n\r");

		ipm_send(ipm_dev, -1, sizeof(fake_request), &fake_request, sizeof(fake_request));
		k_sem_take(&sync, K_FOREVER);

		printk("PRO_CPU received a message from APP_CPU : %s\n\r", received_string);

		k_sleep(K_MSEC(200));
	}
	return 0;
}
```
