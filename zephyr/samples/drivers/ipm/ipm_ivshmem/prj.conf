## CMakeLists.txt
```
# Copyright (c) 2023 Linaro
# SPDX-License-Identifier: Apache-2.0
cmake_minimum_required(VERSION 3.20.0)

find_package(Zephyr REQUIRED HINTS $ENV{ZEPHYR_BASE})
project(ivshmem_ipm_sample)

target_sources(app PRIVATE src/main.c)
```

## sample.yaml
```
sample:
  name: IVSHMEM IPM Sample
tests:
  sample.ipm.ipm_ivshmem:
    build_only: true
    platform_allow: qemu_cortex_a53
    tags:
      - samples
      - ipm
```

## prj.conf
```kconfig
CONFIG_PCIE=y
# required by doorbell
CONFIG_PCIE_MSI=y
CONFIG_PCIE_MSI_X=y
CONFIG_PCIE_MSI_MULTI_VECTOR=y
CONFIG_POLL=y

CONFIG_VIRTUALIZATION=y
CONFIG_IVSHMEM=y
CONFIG_IVSHMEM_DOORBELL=y

CONFIG_SHELL=y
CONFIG_IVSHMEM_SHELL=y
CONFIG_IPM=y
```

## boards/qemu_cortex_a53.conf
```kconfig
CONFIG_PCIE_CONTROLLER=y
CONFIG_PCIE_ECAM=y

# Hungry PCI requires at least 256M of virtual space
CONFIG_KERNEL_VM_SIZE=0x80000000

# Hungry PCI requires phys addresses with more than 32 bits
CONFIG_ARM64_VA_BITS_40=y
CONFIG_ARM64_PA_BITS_40=y

# MSI support requires ITS
CONFIG_GIC_V3_ITS=y

# ITS, in turn, requires dynamic memory (9x64 + alignment constrains)
# Additionally, our test also uses malloc
CONFIG_HEAP_MEM_POOL_SIZE=1048576
```

## boards/pcie_ivshmem.dtsi
```dts
/*
 * Copyright 2023 Linaro.
 *
 * SPDX-License-Identifier: Apache-2.0
 */
#include <zephyr/dt-bindings/pcie/pcie.h>

/ {
	ivhsmem {
		ivshmem0: ivshmem {
			compatible = "qemu,ivshmem";

			vendor-id = <0x1af4>;
			device-id = <0x1110>;
			status = "okay";
		};
	};
};
```

## boards/qemu_cortex_a53.overlay
```dts
/*
 * Copyright 2023 Linaro.
 *
 * SPDX-License-Identifier: Apache-2.0
 */
 #include "pcie_ivshmem.dtsi"

/ {
	ipm_ivshmem0: ipm_ivshmem {
		compatible = "linaro,ivshmem-ipm";
		ivshmem = <&ivshmem0>;
		status = "okay";
	};
};
```

## src/main.c
```c
/*
 * Copyright 2023 Linaro.
 *
 * SPDX-License-Identifier: Apache-2.0
 */

#include <stdio.h>
#include <stdlib.h>
#include <zephyr/shell/shell.h>
#include <zephyr/drivers/ipm.h>
#include <zephyr/kernel.h>

static void ipm_receive_callback(const struct device *ipmdev, void *user_data,
			       uint32_t id, volatile void *data)
{
	ARG_UNUSED(ipmdev);
	ARG_UNUSED(user_data);

	printf("Received IPM notification over IVSHMEM\n");
}

int main(void)
{
	const struct device *ipm_dev = DEVICE_DT_GET(DT_NODELABEL(ipm_ivshmem0));

	ipm_register_callback(ipm_dev, ipm_receive_callback, NULL);
	return 0;
}

static int cmd_ipm_send(const struct shell *sh,
			   size_t argc, char **argv)
{

	const struct device *ipm_dev = DEVICE_DT_GET(DT_NODELABEL(ipm_ivshmem0));

	int peer_id = strtol(argv[1], NULL, 10);

	return ipm_send(ipm_dev, 0, peer_id, NULL, 0);
}

SHELL_STATIC_SUBCMD_SET_CREATE(sub_ivshmem_ipm,
						SHELL_CMD_ARG(ivshmem_ipm_send, NULL,
								"Send notification to other side using IPM",
								cmd_ipm_send, 2, 0),
						SHELL_SUBCMD_SET_END);

SHELL_CMD_ARG_REGISTER(ivshmem_ipm_send,
				&sub_ivshmem_ipm,
				"Send notification to other side using IPM",
				cmd_ipm_send, 2, 0);
```
