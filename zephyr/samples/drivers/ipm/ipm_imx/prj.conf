## CMakeLists.txt
```
# SPDX-License-Identifier: Apache-2.0

cmake_minimum_required(VERSION 3.20.0)

find_package(Zephyr REQUIRED HINTS $ENV{ZEPHYR_BASE})
project(ipm_imx)

target_include_directories(app PRIVATE ${ZEPHYR_BASE}/drivers)
target_sources(app PRIVATE src/main.c)
```

## sample.yaml
```
sample:
  description: the sample reads the received data from the Messaging Unit using the
    IPM and transmits it back unchanged
  name: i.MX IPM sample
tests:
  sample.ipm.ipm_imx:
    build_only: true
    filter: CONFIG_SOC_FAMILY_NXP_IMX
    platform_allow:
      - udoo_neo_full/mcimx6x/m4
      - colibri_imx7d/mcimx7d/m4
      - warp7/mcimx7d/m4
    integration_platforms:
      - udoo_neo_full/mcimx6x/m4
    tags:
      - samples
      - ipm
```

## prj.conf
```kconfig
CONFIG_STDOUT_CONSOLE=n
CONFIG_PRINTK=y
CONFIG_IPM=y
CONFIG_IPM_IMX_MAX_DATA_SIZE_4=y
```

## src/main.c
```c
/*
 * Copyright (c) 2018, NXP
 *
 * SPDX-License-Identifier: Apache-2.0
 */

#include <zephyr/kernel.h>
#include <zephyr/sys/printk.h>
#include <zephyr/device.h>
#include <zephyr/drivers/ipm.h>

static void ipm_callback(const struct device *dev, void *context,
			 uint32_t id, volatile void *data)
{
	int i;
	int status;
	uint32_t *data32 = (uint32_t *)data;

	printk("%s: id = %u, data = 0x", __func__, id);
	for (i = 0; i < (CONFIG_IPM_IMX_MAX_DATA_SIZE / 4); i++) {
		printk("%08x", data32[i]);
	}
	printk("\n");

	status = ipm_send(dev, 1, id, (const void *)data,
			  CONFIG_IPM_IMX_MAX_DATA_SIZE);
	if (status) {
		printk("ipm_send() failed: %d\n", status);
	}
}

int main(void)
{
	const struct device *ipm;

	ipm = DEVICE_DT_GET(DT_NODELABEL(mub));
	if (!device_is_ready(ipm)) {
		while (1) {
		}
	}
	ipm_register_callback(ipm, ipm_callback, NULL);
	ipm_set_enabled(ipm, 1);
	printk("IPM initialized, data size = %d\n",
		CONFIG_IPM_IMX_MAX_DATA_SIZE);

	while (1) {
	}
	return 0;
}
```
