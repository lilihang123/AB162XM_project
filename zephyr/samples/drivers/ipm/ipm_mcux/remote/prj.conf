## CMakeLists.txt
```
cmake_minimum_required(VERSION 3.20.0)
# Copyright (c) 2017-2022, NXP
#
# SPDX-License-Identifier: Apache-2.0
#


find_package(Zephyr REQUIRED HINTS $ENV{ZEPHYR_BASE})

message(STATUS "${BOARD} compiles as remote in this sample")
project(ipm_mcux_remote)

target_sources(app PRIVATE src/main_remote.c)
target_include_directories(app PRIVATE ${CMAKE_CURRENT_SOURCE_DIR}/..)
```

## sample.yaml
```
sample:
  description: Sample app that sends messages between the two cores on the lpcxpresso54114
    using a mailbox.
  name: IPM MCUX Mailbox Sample
tests:
  sample.ipm.ipm_mcux.remote:
    platform_allow:
      - lpcxpresso54114/lpc54114/m0
      - lpcxpresso55s69/lpc55s69/cpu1
    integration_platforms:
      - lpcxpresso54114/lpc54114/m0
    tags: ipm
    harness: remote
```

## prj.conf
```kconfig
CONFIG_STDOUT_CONSOLE=n
CONFIG_PRINTK=n
CONFIG_IPM=y
CONFIG_PLATFORM_SPECIFIC_INIT=n
CONFIG_SECOND_CORE_MCUX=y
CONFIG_BUILD_OUTPUT_HEX=y
```

## src/main_remote.c
```c
/*
 * Copyright (c) 2018, NXP
 *
 * SPDX-License-Identifier: Apache-2.0
 */

#include <zephyr/kernel.h>
#include <zephyr/sys/printk.h>
#include <zephyr/device.h>
#include <zephyr/drivers/ipm.h>

void ping_ipm_callback(const struct device *dev, void *context,
		       uint32_t id, volatile void *data)
{
	ipm_send(dev, 1, 0, (const void *)data, 4);
}



int main(void)
{
	const struct device *ipm;

	ipm = DEVICE_DT_GET_ANY(nxp_lpc_mailbox);
	if (!(ipm && device_is_ready(ipm))) {
		while (1) {
		}
	}
	ipm_register_callback(ipm, ping_ipm_callback, NULL);
	ipm_set_enabled(ipm, 1);
	while (1) {
	}
	return 0;
}
```
