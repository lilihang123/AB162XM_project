## CMakeLists.txt
```
# Copyright (c) 2023 Intel Corporation
# SPDX-License-Identifier: Apache-2.0

cmake_minimum_required(VERSION 3.20.0)
find_package(Zephyr REQUIRED HINTS $ENV{ZEPHYR_BASE})
project(smbus)

target_sources(app PRIVATE src/main.c)
```

## sample.yaml
```
sample:
  description: SMBus sample
  name: smbus sample
common:
  platform_allow:
    - qemu_x86_64
    - intel_ehl_crb
    - intel_rpl_s_crb
  harness: console
  harness_config:
    type: one_line
    regex:
      - "Start SMBUS shell sample"
tests:
  sample.drivers.smbus.shell:
    tags: smbus
```

## prj.conf
```kconfig
CONFIG_SMBUS=y
CONFIG_SMBUS_SHELL=y
CONFIG_SMBUS_INTEL_PCH=y
CONFIG_SMBUS_LOG_LEVEL_DBG=y
CONFIG_USERSPACE=y
CONFIG_SHELL=y
CONFIG_LOG=y

CONFIG_EEPROM=y
CONFIG_EEPROM_EMULATOR=n
CONFIG_EEPROM_SIMULATOR=n
```

## src/main.c
```c
/*
 * Copyright (c) 2022 Intel Corporation
 *
 * SPDX-License-Identifier: Apache-2.0
 */

#include <zephyr/kernel.h>

int main(void)
{
	printk("Start SMBUS shell sample %s\n", CONFIG_BOARD);
	return 0;
}
```
