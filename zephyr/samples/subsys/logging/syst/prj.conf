## CMakeLists.txt
```
# SPDX-License-Identifier: Apache-2.0

cmake_minimum_required(VERSION 3.20.0)
find_package(Zephyr REQUIRED HINTS $ENV{ZEPHYR_BASE})
project(syst)

target_sources(app PRIVATE src/main.c)

if(CONFIG_CPP)
  # When building for C++, force C++ compilation
  set_source_files_properties(src/main.c PROPERTIES LANGUAGE CXX)
endif()
```

## sample.yaml
```
sample:
  name: syst sample
common:
  tags:
    - logging
    - mipi-sys-t
  modules:
    - mipi-sys-t
  arch_exclude:
    - mips
    - nios2
    - posix
    - sparc
tests:
  sample.logger.syst.deferred:
    toolchain_exclude: xcc
    integration_platforms:
      - mps2/an385
      - qemu_x86
    extra_args: OVERLAY_CONFIG=overlay_deferred.conf
    harness: console
    harness_config:
      type: multi_line
      regex:
        - "SYS-T RAW DATA: "
        - "SYST Sample Execution Completed"
    # "CONFIG_FULL_LIBC_SUPPORTED" filter was applied
    # because of following chain of dependencies:
    # LOG_MIPI_SYST_ENABLE=y --> CONFIG_MIPI_SYST_LIB --> \
    # --> REQUIRES_FULL_LIBC.
    #
    # Not all compillers announced in Zephyr support a full C library
    filter: CONFIG_FULL_LIBC_SUPPORTED
    extra_configs:
      - CONFIG_REQUIRES_FULL_LIBC=y
  sample.logger.syst.immediate:
    toolchain_exclude: xcc
    extra_args: OVERLAY_CONFIG=overlay_immediate.conf
    integration_platforms:
      - qemu_x86
      - sam_e70_xplained/same70q21
    harness: console
    harness_config:
      type: multi_line
      regex:
        - "SYS-T RAW DATA: "
        - "SYST Sample Execution Completed"
    filter: CONFIG_FULL_LIBC_SUPPORTED
    extra_configs:
      - CONFIG_REQUIRES_FULL_LIBC=y
  sample.logger.syst.catalog.deferred:
    toolchain_exclude: xcc
    extra_args: OVERLAY_CONFIG=overlay_deferred.conf
    integration_platforms:
      - qemu_x86
      - qemu_x86_64
    harness: console
    harness_config:
      type: one_line
      regex:
        - "SYS-T RAW DATA: "
    extra_configs:
      - CONFIG_LOG_MIPI_SYST_USE_CATALOG=y
      - CONFIG_REQUIRES_FULL_LIBC=y
    filter: CONFIG_FULL_LIBC_SUPPORTED
  sample.logger.syst.catalog.immediate:
    toolchain_exclude: xcc
    integration_platforms:
      - qemu_x86
      - qemu_x86_64
    harness: console
    harness_config:
      type: one_line
      regex:
        - "SYS-T RAW DATA: "
    extra_configs:
      - CONFIG_LOG_MIPI_SYST_USE_CATALOG=y
      - CONFIG_REQUIRES_FULL_LIBC=y
    filter: CONFIG_FULL_LIBC_SUPPORTED
  sample.logger.syst.deferred_cpp:
    toolchain_exclude: xcc
    extra_args: OVERLAY_CONFIG=overlay_deferred.conf
    integration_platforms:
      - qemu_x86
      - qemu_x86_64
    harness: console
    harness_config:
      type: one_line
      regex:
        - "SYS-T RAW DATA: "
    extra_configs:
      - CONFIG_CPP=y
      - CONFIG_REQUIRES_FULL_LIBC=y
    filter: CONFIG_FULL_LIBC_SUPPORTED
  sample.logger.syst.immediate_cpp:
    toolchain_exclude: xcc
    integration_platforms:
      - mps2/an385
      - qemu_x86
    harness: console
    harness_config:
      type: one_line
      regex:
        - "SYS-T RAW DATA: "
    extra_configs:
      - CONFIG_CPP=y
      - CONFIG_REQUIRES_FULL_LIBC=y
    filter: CONFIG_FULL_LIBC_SUPPORTED
  sample.logger.syst.catalog.deferred_cpp:
    toolchain_exclude: xcc
    extra_args: OVERLAY_CONFIG=overlay_deferred.conf
    integration_platforms:
      - qemu_x86
      - qemu_x86_64
    harness: console
    harness_config:
      type: one_line
      regex:
        - "SYS-T RAW DATA: "
    extra_configs:
      - CONFIG_LOG_MIPI_SYST_USE_CATALOG=y
      - CONFIG_CPP=y
      - CONFIG_REQUIRES_FULL_LIBC=y
    filter: CONFIG_FULL_LIBC_SUPPORTED
  sample.logger.syst.catalog.immediate_cpp:
    toolchain_exclude: xcc
    integration_platforms:
      - qemu_x86
      - qemu_x86_64
    harness: console
    harness_config:
      type: one_line
      regex:
        - "SYS-T RAW DATA: "
    extra_configs:
      - CONFIG_LOG_MIPI_SYST_USE_CATALOG=y
      - CONFIG_CPP=y
      - CONFIG_REQUIRES_FULL_LIBC=y
    filter: CONFIG_FULL_LIBC_SUPPORTED
```

## prj.conf
```kconfig
CONFIG_LOG=y
CONFIG_ASSERT=n
CONFIG_LOG_PRINTK=y
CONFIG_LOG_MIPI_SYST_ENABLE=y

# If using a different backend such as "ADSP"
# update the following 2 lines.
# Note: If using different platforms, be sure to
# use the correct logging backend.
CONFIG_LOG_BACKEND_UART=y
CONFIG_LOG_BACKEND_UART_OUTPUT_SYST=y

CONFIG_SOC_LOG_LEVEL_OFF=y
CONFIG_ARCH_LOG_LEVEL_OFF=y
CONFIG_KERNEL_LOG_LEVEL_OFF=y
CONFIG_LOG_RUNTIME_FILTERING=n
CONFIG_MAIN_THREAD_PRIORITY=5
CONFIG_LOG_FUNC_NAME_PREFIX_DBG=n

# Use immediate mode so all messages are being
# printed. Under deferred mode, there may be
# dropped messages as there are quite a number of
# messages to be printed.
CONFIG_LOG_MODE_IMMEDIATE=y

# Need bigger stack for immediate mode
CONFIG_MAIN_STACK_SIZE=4096
```

## overlay_deferred.conf
```kconfig
CONFIG_LOG_MODE_IMMEDIATE=n
CONFIG_LOG_MODE_DEFERRED=y
CONFIG_LOG_BUFFER_SIZE=1024
CONFIG_LOG_PROCESS_THREAD=y
CONFIG_LOG_PROCESS_THREAD_SLEEP_MS=100
CONFIG_LOG_PROCESS_TRIGGER_THRESHOLD=2
CONFIG_LOG_PROCESS_THREAD_STACK_SIZE=4096
CONFIG_LOG_BLOCK_IN_THREAD=y
CONFIG_LOG_BACKEND_UART=y
CONFIG_LOG_MIPI_SYST_ENABLE=y
CONFIG_LOG_BACKEND_UART_OUTPUT_SYST=y
```

## overlay_immediate.conf
```kconfig
CONFIG_LOG_BACKEND_UART=y
CONFIG_LOG_MIPI_SYST_ENABLE=y
CONFIG_LOG_BACKEND_UART_OUTPUT_SYST=y
```

## boards/intel_adsp_cavs18.conf
```kconfig
CONFIG_LOG_BACKEND_UART=n
CONFIG_LOG_BACKEND_UART_OUTPUT_SYST=n
CONFIG_LOG_BACKEND_ADSP=y
CONFIG_LOG_MIPI_SYST_ENABLE=y
CONFIG_LOG_BACKEND_ADSP_OUTPUT_SYST=y
```

## src/main.c
```c
/*
 * Copyright (c) 2019 Intel Corporation
 *
 * SPDX-License-Identifier: Apache-2.0
 */

#include <zephyr/kernel.h>
#include <zephyr/logging/log.h>
#include <zephyr/sys/printk.h>
#include <zephyr/logging/log_ctrl.h>
#include <zephyr/logging/log_output.h>

#define DATA_MAX_DLEN 8
#define LOG_MODULE_NAME syst
LOG_MODULE_REGISTER(LOG_MODULE_NAME, LOG_LEVEL_DBG);

struct test_frame {
	uint32_t id_type : 1;
	uint32_t rtr     : 1;
	/* Message identifier */
	union {
		uint32_t std_id  : 11;
		uint32_t ext_id  : 29;
	};
	/* The length of the message (max. 8) in byte */
	uint8_t dlc;
	/* The message data */
	union {
		uint8_t data[8];
		uint32_t data_32[2];
	};
} __packed;

void log_msgs(void)
{
	struct test_frame frame = { 0 };
	const uint8_t data[DATA_MAX_DLEN] = { 0x01, 0x02, 0x03, 0x04,
					0x05, 0x06, 0x07, 0x08 };

	char c = '!';
	const char *s = "static str";
	const char *s1 = "c str";
	char vs0[32];
	char vs1[32];

	/* standard print */
	LOG_ERR("Error message example.");
	LOG_WRN("Warning message example.");
	LOG_INF("Info message example.");
	LOG_DBG("Debug message example.");

	LOG_DBG("Debug message example, %d", 1);
	LOG_DBG("Debug message example, %d, %d", 1, 2);
	LOG_DBG("Debug message example, %d, %d, %d", 1, 2, 3);
	LOG_DBG("Debug message example, %d, %d, %d, 0x%x", 1, 2, 3, 4);

	memset(vs0, 0, sizeof(vs0));
	snprintk(&vs0[0], sizeof(vs0), "%s", "dynamic str");

	memset(vs1, 0, sizeof(vs1));
	snprintk(&vs1[0], sizeof(vs1), "%s", "another dynamic str");

	LOG_DBG("char %c", c);
	LOG_DBG("s str %s %s", s, s1);

	LOG_DBG("d str %s", vs0);
	LOG_DBG("mixed str %s %s %s %s %s %s %s", vs0, "---", vs0, "---", vs1, "---", vs1);
	LOG_DBG("mixed c/s %c %s %s %s %c", c, s, vs0, s, c);

	LOG_DBG("Debug message example, %f", 3.14159265359);

	/* hexdump */
	frame.rtr = 1U;
	frame.id_type = 1U;
	frame.std_id = 1234U;
	frame.dlc = sizeof(data);
	memcpy(frame.data, data, sizeof(data));

	LOG_HEXDUMP_ERR((const uint8_t *)&frame, sizeof(frame), "frame");
	LOG_HEXDUMP_WRN((const uint8_t *)&frame, sizeof(frame), "frame");
	LOG_HEXDUMP_INF((const uint8_t *)&frame, sizeof(frame), "frame");
	LOG_HEXDUMP_DBG((const uint8_t *)&frame, sizeof(frame), "frame");

	/* raw string */
	printk("hello sys-t on board %s\n", CONFIG_BOARD);

#if CONFIG_LOG_MODE_DEFERRED
	/*
	 * When deferred logging is enabled, the work is being performed by
	 * another thread. This k_sleep() gives that thread time to process
	 * those messages.
	 */

	k_sleep(K_TICKS(10));
#endif
}

int main(void)
{
	log_msgs();

	uint32_t log_type = LOG_OUTPUT_TEXT;

	log_format_set_all_active_backends(log_type);

	log_msgs();

	log_type = LOG_OUTPUT_SYST;
	log_format_set_all_active_backends(log_type);

	log_msgs();

	log_type = LOG_OUTPUT_TEXT;
	log_format_set_all_active_backends(log_type);

	/* raw string */
	printk("SYST Sample Execution Completed\n");
	return 0;
}
```
