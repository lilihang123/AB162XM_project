## CMakeLists.txt
```
# SPDX-License-Identifier: Apache-2.0

cmake_minimum_required(VERSION 3.20.0)

find_package(Zephyr REQUIRED HINTS $ENV{ZEPHYR_BASE})
project(hello_bindesc)

target_sources(app PRIVATE src/main.c)
```

## sample.yaml
```
sample:
  name: Hello Bindesc
tests:
  sample.bindesc:
    tags: bindesc
    filter: CONFIG_ARCH_SUPPORTS_ROM_START or CONFIG_ARCH_POSIX
    integration_platforms:
      - native_sim
    harness: console
    harness_config:
      type: multi_line
      ordered: true
      regex:
        - "Zephyr version: "
        - "App version: 1.0.0"
        - "Build time: "
        - "Compiler: "
        - "my_string: Hello world!"
        - "my_int: 5"
        - "my_bytes: 01 02 03 04"
```

## prj.conf
```kconfig
# Enable binary descriptors
CONFIG_BINDESC=y

# Enable definition of binary descriptors
CONFIG_BINDESC_DEFINE=y

# Enable default build time binary descriptors
CONFIG_BINDESC_DEFINE_BUILD_TIME=y
CONFIG_BINDESC_BUILD_DATE_TIME_STRING=y

# Enable default version binary descriptors
CONFIG_BINDESC_DEFINE_VERSION=y
CONFIG_BINDESC_KERNEL_VERSION_STRING=y
CONFIG_BINDESC_KERNEL_VERSION_MAJOR=y

CONFIG_BINDESC_APP_VERSION_STRING=y

# Enable default host info binary descriptors
CONFIG_BINDESC_DEFINE_HOST_INFO=y
CONFIG_BINDESC_C_COMPILER_NAME=y
CONFIG_BINDESC_C_COMPILER_VERSION=y
```

## src/main.c
```c
/*
 * Copyright (c) 2023 Yonatan Schachter
 *
 * SPDX-License-Identifier: Apache-2.0
 */

#include <zephyr/kernel.h>
#include <zephyr/bindesc.h>

BINDESC_STR_DEFINE(my_string, 1, "Hello world!");
BINDESC_UINT_DEFINE(my_int, 2, 5);
BINDESC_BYTES_DEFINE(my_bytes, 3, ({1, 2, 3, 4}));

int main(void)
{
	size_t i;

	/* Builtin descriptors */
	printk("Zephyr version: %s\n", BINDESC_GET_STR(kernel_version_string));
	printk("App version: %s\n", BINDESC_GET_STR(app_version_string));
	printk("Build time: %s\n", BINDESC_GET_STR(build_date_time_string));
	printk("Compiler: %s %s\n", BINDESC_GET_STR(c_compiler_name),
		BINDESC_GET_STR(c_compiler_version));

	/* Custom descriptors */
	printk("my_string: %s\n", BINDESC_GET_STR(my_string));
	printk("my_int: %d\n", BINDESC_GET_UINT(my_int));
	printk("my_bytes: ");
	for (i = 0; i < BINDESC_GET_SIZE(my_bytes); i++) {
		printk("%02x ", BINDESC_GET_BYTES(my_bytes)[i]);
	}
	printk("\n");

	return 0;
}
```
