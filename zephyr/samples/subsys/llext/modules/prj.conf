## CMakeLists.txt
```
# SPDX-License-Identifier: Apache-2.0

cmake_minimum_required(VERSION 3.20.0)

find_package(Zephyr REQUIRED HINTS $ENV{ZEPHYR_BASE})
project(fs_shell)

if(CONFIG_HELLO_WORLD_MODE STREQUAL "m")

  # Build the llext ...

  set(ext_name hello_world)
  set(ext_src src/${ext_name}_ext.c)
  set(ext_bin ${ZEPHYR_BINARY_DIR}/${ext_name}.llext)
  set(ext_inc ${ZEPHYR_BINARY_DIR}/include/generated/${ext_name}_ext.inc)
  add_llext_target(${ext_name}_ext
    OUTPUT  ${ext_bin}
    SOURCES ${ext_src}
  )
  generate_inc_file_for_target(app ${ext_bin} ${ext_inc})

  # ...and the code for loading and running it

  target_sources(app PRIVATE
    src/main_module.c
  )

elseif(CONFIG_HELLO_WORLD_MODE STREQUAL "y")

  # Just build the two files together

  target_sources(app PRIVATE
    src/main_builtin.c
    src/hello_world_ext.c
  )

else()
  message(FATAL_ERROR "Please choose 'y' or 'm' for CONFIG_HELLO_WORLD_MODE")
endif()
```

## Kconfig
```
# SPDX-License-Identifier: Apache-2.0
# Copyright (c) 2024 Intel Corporation.

mainmenu "LLEXT functionality test"

source "Kconfig.zephyr"

config HELLO_WORLD_MODE
	tristate "Include the hello_world function"
	default y
	help
	  This enables building the hello_world function, implemented in
	  hello_world_ext.c, either as an llext module or as a built-in part of
	  Zephyr.

	  If you select 'm', the hello_world function will be built as an llext
	  "module". If you select 'y', the hello_world function will be directly
	  linked in the Zephyr image.

	  Note that additional architecture-specific configuration may be
	  required if you select 'm'. Please review this sample's documentation
	  and sample.yaml for more information.
```

## sample.yaml
```
common:
  tags: llext
  platform_allow:
    - qemu_cortex_a9          # ARM Cortex-A9 (ARMv7-A ISA)
    - qemu_cortex_r5          # ARM Cortex-R5 (ARMv7-R ISA)
    - mps2/an385              # ARM Cortex-M3 (ARMv7-M ISA)
    - mps2/an521/cpu0         # ARM Cortex-M33 (ARMv8-M ISA)
    - qemu_xtensa
  integration_platforms:
    - qemu_xtensa
    - mps2/an385
  harness: console

sample:
  name: CONFIG_MODULES test
  description: Call code directly and from extensions

tests:
  sample.llext.modules.module_build:
    extra_configs:
      - CONFIG_HELLO_WORLD_MODE=m
      # Disabling MPU is the most compatible option. If the target supports
      # CONFIG_USERSPACE, that should be preferred as it has many additional
      # security benefits.
      - arch:arm:CONFIG_ARM_MPU=n
      - arch:arm:CONFIG_ARM_AARCH32_MMU=n
    harness_config:
      type: one_line
      regex:
        - "Hello, world, from an llext!"
  sample.llext.modules.builtin_build:
    harness_config:
      type: one_line
      regex:
        - "Hello, world, from the main binary!"
```

## prj.conf
```kconfig
CONFIG_LOG=y
CONFIG_LOG_MODE_IMMEDIATE=y

# CONFIG_MODULES must be enabled to allow setting any options to "m" in the
# Kconfig files. For compatibility with Kconfiglib, the name must be kept
# as-is even if Zephyr has a completely different concept for "modules".

CONFIG_MODULES=y

# LLEXT is only required when loading the extension at runtime. Since in this
# basic example there's only one llext, leaving it in when building the
# extension as a built-in is redundant; in a real application, however, there
# could be other uses of the llext subsystem.

CONFIG_LLEXT=y
CONFIG_LLEXT_LOG_LEVEL_DBG=y
CONFIG_LLEXT_HEAP_SIZE=64
CONFIG_LLEXT_TYPE_ELF_RELOCATABLE=y # supported by all targets

# This test consumes large amounts of stack when loading the LLEXT.
# Increase the available size to avoid overflowing (see issue #74536).

CONFIG_MAIN_STACK_SIZE=2048

# NOTE
#
# This project file explicitly does NOT include the configuration for
# CONFIG_HELLO_WORLD_MODE, so a clean compile will include the function as
# built-in by default.
#
# To build it as an llext, please follow the instructions in the documentation
# of this sample; there are architecture-specific settings that must be set in
# addition to CONFIG_HELLO_WORLD_MODE=m. For example, most ARM targets need to
# either enable CONFIG_USERSPACE (if they support it) or disable MPU/MMU
# features for LLEXT to work correctly.
```

## src/hello_world_ext.c
```c
/*
 * Copyright (c) 2023 Intel Corporation.
 *
 * SPDX-License-Identifier: Apache-2.0
 */

/*
 * This very simple hello world C code can be used as a test case for building
 * probably the simplest loadable extension. It requires a single symbol be
 * linked, section relocation support, and the ability to export and call out to
 * a function.
 */

#include <zephyr/llext/symbol.h>
#include <zephyr/sys/printk.h>

void hello_world(void)
{
#if defined(CONFIG_HELLO_WORLD_MODE)
	/* HELLO_WORLD_MODE=y: CONFIG_* is defined */
	printk("Hello, world, from the main binary!\n");
#else
	/* HELLO_WORLD_MODE=m: CONFIG_*_MODULE is defined instead */
	printk("Hello, world, from an llext!\n");
#endif
}
LL_EXTENSION_SYMBOL(hello_world);
```

## src/main_builtin.c
```c
/*
 * Copyright (c) 2024 Arduino SA
 *
 * SPDX-License-Identifier: Apache-2.0
 */

#define LOG_LEVEL CONFIG_LOG_DEFAULT_LEVEL
#include <zephyr/logging/log.h>
LOG_MODULE_REGISTER(app);

extern void hello_world(void);

int main(void)
{
	LOG_INF("Calling hello world as a builtin");

	hello_world();

	return 0;
}
```

## src/main_module.c
```c
/*
 * Copyright (c) 2024 Arduino SA
 *
 * SPDX-License-Identifier: Apache-2.0
 */

#define LOG_LEVEL CONFIG_LOG_DEFAULT_LEVEL
#include <zephyr/logging/log.h>
LOG_MODULE_REGISTER(app);

#include <zephyr/llext/llext.h>
#include <zephyr/llext/buf_loader.h>

static uint8_t llext_buf[] = {
#include "hello_world_ext.inc"
};

int main(void)
{
	LOG_INF("Calling hello world as a module");

	size_t llext_buf_len = ARRAY_SIZE(llext_buf);
	struct llext_buf_loader buf_loader = LLEXT_BUF_LOADER(llext_buf, llext_buf_len);
	struct llext_loader *ldr = &buf_loader.loader;

	struct llext_load_param ldr_parm = LLEXT_LOAD_PARAM_DEFAULT;
	struct llext *ext;
	int res;

	res = llext_load(ldr, "ext", &ext, &ldr_parm);
	if (res != 0) {
		LOG_ERR("Failed to load extension, return code %d\n", res);
		return res;
	}

	void (*hello_world_fn)() = llext_find_sym(&ext->exp_tab, "hello_world");

	if (hello_world_fn == NULL) {
		LOG_ERR("Failed to find symbol\n");
		return -1;
	}

	hello_world_fn();

	return llext_unload(&ext);
}
```
