## CMakeLists.txt
```
# SPDX-License-Identifier: Apache-2.0
cmake_minimum_required(VERSION 3.20.0)

find_package(Zephyr REQUIRED HINTS $ENV{ZEPHYR_BASE})
project(dyn_channel)

FILE(GLOB app_sources src/*.c)
target_sources(app PRIVATE ${app_sources})
```

## sample.yaml
```
sample:
  name: Dynamic channel
common:
  tags: zbus
  harness: console
  harness_config:
    type: multi_line
    ordered: true
    regex:
      - "W: size=01"
      - "W: Content"
      - "W: 00                      |."
      - "W: size=02"
      - "W: Content"
      - "W: 01 01                   |.."
      - "W: size=03"
      - "W: Content"
      - "W: 00 00 00                |..."
      - "W: size=04"
      - "W: Content"
      - "W: 03 03 03 03             |...."
      - "W: size=05"
      - "W: Content"
      - "W: 00 00 00 00 00          |....."
      - "W: size=06"
      - "W: Content"
      - "W: 05 05 05 05 05 05       |......"
      - "W: size=07"
      - "W: Content"
      - "W: 00 00 00 00 00 00 00    |......."
      - "W: size=08"
      - "W: Content"
      - "W: 07 07 07 07 07 07 07 07 |........"
      - "W: size=09"
      - "W: Content"
      - "W: 00 00 00 00 00 00 00 00 |........"
      - "W: 00                      |."
      - "W: size=10"
      - "W: Content"
      - "W: 09 09 09 09 09 09 09 09 |........"
      - "W: 09 09                   |.."
      - "W: size=11"
      - "W: Content"
      - "W: 00 00 00 00 00 00 00 00 |........"
      - "W: 00 00 00                |..."
      - "W: size=12"
      - "W: Content"
      - "W: 0b 0b 0b 0b 0b 0b 0b 0b |........"
      - "W: 0b 0b 0b 0b             |...."
      - "W: size=13"
      - "W: Content"
      - "W: 00 00 00 00 00 00 00 00 |........"
      - "W: 00 00 00 00 00          |....."
      - "W: size=14"
      - "W: Content"
      - "W: 0d 0d 0d 0d 0d 0d 0d 0d |........"
      - "W: 0d 0d 0d 0d 0d 0d       |......"
      - "W: size=15"
      - "W: Content"
      - "W: 00 00 00 00 00 00 00 00 |........"
      - "W: 00 00 00 00 00 00 00    |......."
      - "W: size=16"
      - "W: Content"
      - "W: 0f 0f 0f 0f 0f 0f 0f 0f |........"
      - "W: 0f 0f 0f 0f 0f 0f 0f 0f |........"
tests:
  sample.zbus.dyn_channel:
    tags: zbus
    integration_platforms:
      - qemu_x86
      - mps2/an521/cpu0
```

## prj.conf
```kconfig
CONFIG_LOG=y
CONFIG_LOG_MODE_MINIMAL=y
CONFIG_ASSERT=y
CONFIG_HEAP_MEM_POOL_SIZE=1024

CONFIG_ZBUS=y
CONFIG_ZBUS_CHANNEL_NAME=y
CONFIG_ZBUS_LOG_LEVEL_WRN=y
CONFIG_BOOT_BANNER=n
```

## src/main.c
```c
/*
 * Copyright (c) 2022 Rodrigo Peixoto <rodrigopex@gmail.com>
 * SPDX-License-Identifier: Apache-2.0
 */
#include "messages.h"

#include <stdint.h>

#include <zephyr/kernel.h>
#include <zephyr/logging/log.h>
#include <zephyr/zbus/zbus.h>

LOG_MODULE_DECLARE(zbus, CONFIG_ZBUS_LOG_LEVEL);

ZBUS_CHAN_DEFINE(pkt_chan,		   /* Name */
		 struct external_data_msg, /* Message type */

		 NULL,			     /* Validator */
		 NULL,			     /* User data */
		 ZBUS_OBSERVERS(filter_lis), /* observers */
		 ZBUS_MSG_INIT(0)	     /* Initial value {0} */
);

ZBUS_CHAN_DEFINE(version_chan,	     /* Name */
		 struct version_msg, /* Message type */

		 NULL,						   /* Validator */
		 NULL,						   /* User data */
		 ZBUS_OBSERVERS_EMPTY,				   /* observers */
		 ZBUS_MSG_INIT(.major = 0, .minor = 1, .build = 1) /* Initial value {0} */
);

ZBUS_CHAN_DEFINE(data_ready_chan, /* Name */
		 struct ack_msg,  /* Message type */

		 NULL,			       /* Validator */
		 NULL,			       /* User data */
		 ZBUS_OBSERVERS(consumer_sub), /* observers */
		 ZBUS_MSG_INIT(0)	       /* Initial value {0} */
);

ZBUS_CHAN_DEFINE(ack,		 /* Name */
		 struct ack_msg, /* Message type */

		 NULL,			       /* Validator */
		 NULL,			       /* User data */
		 ZBUS_OBSERVERS(producer_sub), /* observers */
		 ZBUS_MSG_INIT(0)	       /* Initial value {0} */
);

static void filter_cb(const struct zbus_channel *chan)
{
	/* Note that the listener does not change the actual message.
	 * It changes the external dynamic memory area but not the reference and size of the
	 * channel's message struct. Use that with care.
	 */

	const struct external_data_msg *chan_message;

	__ASSERT_NO_MSG(chan == &pkt_chan);

	chan_message = zbus_chan_const_msg(chan);

	if (chan_message->size % 2) {
		memset(chan_message->reference, 0, chan_message->size);
	}

	struct ack_msg dr = {1};

	zbus_chan_pub(&data_ready_chan, &dr, K_NO_WAIT);
}

ZBUS_LISTENER_DEFINE(filter_lis, filter_cb);

int main(void)
{
	const struct version_msg *v = zbus_chan_const_msg(&version_chan);

	LOG_DBG(" -> Dynamic channel sample version %u.%u-%u\n\n", v->major, v->minor, v->build);
	return 0;
}
```

## src/consumer.c
```c
/*
 * Copyright (c) 2022 Rodrigo Peixoto <rodrigopex@gmail.com>
 * SPDX-License-Identifier: Apache-2.0
 */
#include "messages.h"

#include <zephyr/logging/log.h>
#include <zephyr/zbus/zbus.h>
LOG_MODULE_DECLARE(zbus, CONFIG_ZBUS_LOG_LEVEL);

ZBUS_CHAN_DECLARE(pkt_chan, data_ready_chan, ack);

ZBUS_SUBSCRIBER_DEFINE(consumer_sub, 4);

static void consumer_thread(void)
{
	struct external_data_msg *dyn_alloc_msg;
	const struct zbus_channel *chan;

	while (!zbus_sub_wait(&consumer_sub, &chan, K_FOREVER)) {
		LOG_INF("Channel %s\n", zbus_chan_name(chan));

		__ASSERT_NO_MSG(chan == &data_ready_chan);

		if (!zbus_chan_claim(&pkt_chan, K_MSEC(100))) {
			dyn_alloc_msg = zbus_chan_msg(&pkt_chan);

			LOG_WRN("size=%02d", (int)dyn_alloc_msg->size);
			LOG_HEXDUMP_WRN(dyn_alloc_msg->reference, dyn_alloc_msg->size, "Content");

			/* Cleanup the dynamic memory after using that */
			k_free(dyn_alloc_msg->reference);
			dyn_alloc_msg->reference = NULL;
			dyn_alloc_msg->size = 0;

			zbus_chan_finish(&pkt_chan);
		}
		struct ack_msg a = {1};

		zbus_chan_pub(&ack, &a, K_MSEC(250));
	}
}

K_THREAD_DEFINE(consumer_thread_id, 1024, consumer_thread, NULL, NULL, NULL, 4, 0, 1000);
```

## src/messages.h
```c
/*
 * Copyright (c) 2022 Rodrigo Peixoto <rodrigopex@gmail.com>
 * SPDX-License-Identifier: Apache-2.0
 */
#ifndef _MESSAGES_H_
#define _MESSAGES_H_
#include <stddef.h>
#include <stdint.h>

struct version_msg {
	uint8_t major;
	uint8_t minor;
	uint16_t build;
};

struct external_data_msg {
	void *reference;
	size_t size;
};

struct ack_msg {
	uint8_t value;
};

#endif /* _MESSAGES_H_ */
```

## src/producer.c
```c
/*
 * Copyright (c) 2022 Rodrigo Peixoto <rodrigopex@gmail.com>
 * SPDX-License-Identifier: Apache-2.0
 */
#include "messages.h"

#include <zephyr/logging/log.h>
#include <zephyr/zbus/zbus.h>
LOG_MODULE_DECLARE(zbus, CONFIG_ZBUS_LOG_LEVEL);

ZBUS_CHAN_DECLARE(pkt_chan);

ZBUS_SUBSCRIBER_DEFINE(producer_sub, 4);

static void producer_thread(void)
{
	const struct zbus_channel *chan;
	void *msg;

	for (uint8_t i = 0; (i < 16); ++i) {
		msg = k_malloc(i + 1);

		__ASSERT_NO_MSG(msg != NULL);

		struct external_data_msg dyn_alloc_msg = {.reference = msg, .size = i + 1};

		for (int j = 0; j < dyn_alloc_msg.size; ++j) {
			((uint8_t *)dyn_alloc_msg.reference)[j] = i;
		}

		zbus_chan_pub(&pkt_chan, &dyn_alloc_msg, K_MSEC(250));

		/* Wait for an consumer's ACK */
		if (zbus_sub_wait(&producer_sub, &chan, K_FOREVER)) {
			LOG_ERR("Ack not received!");
		}
	}
}

K_THREAD_DEFINE(producer_thread_id, 1024, producer_thread, NULL, NULL, NULL, 5, 0, 1000);
```
