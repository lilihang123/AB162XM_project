## CMakeLists.txt
```
# Copyright (c) 2022 Nordic Semiconductor ASA
# SPDX-License-Identifier: Apache-2.0

cmake_minimum_required(VERSION 3.20.0)
find_package(Zephyr REQUIRED HINTS $ENV{ZEPHYR_BASE})
project(usb-shell)

FILE(GLOB app_sources src/*.c)
target_sources(app PRIVATE ${app_sources})
```

## sample.yaml
```
sample:
  name: USB support shell sample
common:
  depends_on:
    - usbd
tests:
  sample.usbd.shell:
    integration_platforms:
      - nrf52840dk/nrf52840
      - nrf54h20dk/nrf54h20/cpuapp
      - frdm_k64f
      - mimxrt685_evk/mimxrt685s/cm33
      - mimxrt1060_evk
    harness: keyboard
    tags: usb
  sample.usbh.shell:
    tags:
      - usb
      - shield
    extra_args:
      - CONF_FILE="device_and_host_prj.conf"
      - SHIELD="sparkfun_max3421e"
    platform_allow:
      - nrf52840dk/nrf52840
      - frdm_k64f
    build_only: true
  sample.usbh.shell.virtual:
    tags: usb
    extra_args: CONF_FILE="device_and_host_prj.conf"
    platform_allow: qemu_cortex_m3
    build_only: true
```

## prj.conf
```kconfig
CONFIG_SHELL=y
CONFIG_USB_DEVICE_STACK_NEXT=y
CONFIG_USBD_SHELL=y
CONFIG_USBD_LOOPBACK_CLASS=y

CONFIG_LOG=y
CONFIG_USBD_LOG_LEVEL_WRN=y
CONFIG_UDC_DRIVER_LOG_LEVEL_WRN=y
```

## device_and_host_prj.conf
```kconfig
CONFIG_SHELL=y
CONFIG_USB_DEVICE_STACK_NEXT=y
CONFIG_USBD_SHELL=y

CONFIG_USB_HOST_STACK=y
CONFIG_USBH_SHELL=y

CONFIG_LOG=y
CONFIG_USBD_LOG_LEVEL_WRN=y
CONFIG_USBH_LOG_LEVEL_WRN=y
CONFIG_UDC_DRIVER_LOG_LEVEL_WRN=y
CONFIG_UHC_DRIVER_LOG_LEVEL_WRN=y
```

## boards/qemu_cortex_m3.conf
```kconfig
# Copyright (c) 2022 Nordic Semiconductor ASA
# SPDX-License-Identifier: Apache-2.0

CONFIG_UHC_DRIVER=y
CONFIG_USB_HOST_STACK=y
```

## nucleo_f413zh_dwc2.overlay
```dts
/*
 * Copyright (c) 2023 Nordic Semiconductor ASA
 *
 * SPDX-License-Identifier: Apache-2.0
 */

/delete-node/ &zephyr_udc0;

/ {
	soc {
		dwc2_fsotg0: usb@50000000 {
			compatible = "st,stm32f4-fsotg", "snps,dwc2";
			reg = <0x50000000 0x40000>;
			interrupts = <67 0>;
			interrupt-names = "fsotg";
			clocks = <&rcc STM32_CLOCK_BUS_AHB2 0x00000080>,
				 <&rcc STM32_SRC_PLL_Q NO_SEL>;
			num-out-eps = <6>;
			num-in-eps = <6>;
			ghwcfg1 = <0x00000000>;
			ghwcfg2 = <0x229ed520>;
			ghwcfg4 = <0x17f08030>;
		};
	};
};

zephyr_udc0: &dwc2_fsotg0 {
	pinctrl-0 = <&usb_otg_fs_dm_pa11 &usb_otg_fs_dp_pa12>;
	pinctrl-names = "default";
	status = "okay";
};
```

## boards/qemu_cortex_m3.overlay
```dts
/*
 * Copyright (c) 2022 Nordic Semiconductor ASA
 *
 * SPDX-License-Identifier: Apache-2.0
 */

/ {
	zephyr_uhc0: uhc_vrt0 {
		compatible = "zephyr,uhc-virtual";

		zephyr_udc0: udc_vrt0 {
			compatible = "zephyr,udc-virtual";
			num-bidir-endpoints = <8>;
			maximum-speed = "high-speed";
		};

		udc1: udc_vrt1 {
			compatible = "zephyr,udc-virtual";
			num-bidir-endpoints = <8>;
			maximum-speed = "full-speed";
		};
	};
};
```

## src/main.c
```c
/*
 * Copyright (c) 2022 Nordic Semiconductor ASA
 *
 * SPDX-License-Identifier: Apache-2.0
 */

#include <zephyr/kernel.h>

int main(void)
{
	return 0;
}
```
