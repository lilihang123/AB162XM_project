## CMakeLists.txt
```
# SPDX-License-Identifier: Apache-2.0

cmake_minimum_required(VERSION 3.20.0)
find_package(Zephyr REQUIRED HINTS $ENV{ZEPHYR_BASE})
project(dfu)

FILE(GLOB app_sources src/*.c)
target_sources(app PRIVATE ${app_sources})
```

## sample.yaml
```
sample:
  name: USB DFU sample

common:
  build_only: true
  arch_exclude: posix
  platform_exclude:
    - mimxrt1010_evk
    - mimxrt1050_evk@qspi
    - mimxrt1020_evk
    - mimxrt1015_evk
    - mimxrt1060_evk
    - sam4l_ek
    - mimxrt1050_evk
    - mimxrt1060_evk@hyperflash
    - nucleo_f207zg
    - teensy40
    - teensy41
    - b_u585i_iot02a
    - frdm_kl25z
    - lpcxpresso55s69/lpc55s69/cpu0
    - stm32l562e_dk/stm32l562xx/ns
  depends_on: usb_device
  filter: dt_label_with_parent_compat_enabled("slot0_partition", "fixed-partitions")
    and dt_label_with_parent_compat_enabled("slot1_partition", "fixed-partitions")
    and dt_chosen_enabled("zephyr,flash-controller") and CONFIG_FLASH_HAS_DRIVER_ENABLED
  integration_platforms:
    - nrf52840dk/nrf52840
    - frdm_k64f
tests:
  sample.usb.dfu:
    tags: usb
  sample.usb.dfu.permanent.download:
    tags: usb
    extra_args: OVERLAY_CONFIG=overlay-permanent-download.conf
```

## prj.conf
```kconfig
CONFIG_STDOUT_CONSOLE=y
CONFIG_GPIO=y
CONFIG_USB_DEVICE_STACK=y
CONFIG_USB_DEVICE_PRODUCT="Zephyr DFU sample"
CONFIG_USB_DEVICE_PID=0x0005
CONFIG_USB_DFU_CLASS=y
CONFIG_USB_DFU_ENABLE_UPLOAD=y
CONFIG_FLASH=y
CONFIG_FLASH_MAP=y
CONFIG_STREAM_FLASH=y
CONFIG_IMG_MANAGER=y
CONFIG_LOG=y
CONFIG_USB_DRIVER_LOG_LEVEL_ERR=y
CONFIG_USB_DEVICE_LOG_LEVEL_ERR=y
CONFIG_BOOTLOADER_MCUBOOT=y
CONFIG_USB_DEVICE_INITIALIZE_AT_BOOT=n
```

## overlay-permanent-download.conf
```kconfig
CONFIG_USB_DFU_REBOOT=y

CONFIG_USB_DFU_PERMANENT_DOWNLOAD=y
```

## src/main.c
```c
/*
 * Copyright (c) 2016 Intel Corporation
 * Copyright (c) 2017 Phytec Messtechnik GmbH
 *
 * SPDX-License-Identifier: Apache-2.0
 */

/* Sample app for USB DFU class driver. */

#include <zephyr/kernel.h>
#include <zephyr/logging/log.h>
#include <zephyr/usb/usb_device.h>
LOG_MODULE_REGISTER(main);

int main(void)
{
	int ret;

	ret = usb_enable(NULL);
	if (ret != 0) {
		LOG_ERR("Failed to enable USB");
		return 0;
	}

	LOG_INF("This device supports USB DFU class.\n");
	return 0;
}
```
