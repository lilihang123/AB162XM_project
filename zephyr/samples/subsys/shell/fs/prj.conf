## sample.yaml
```
sample:
  description: FS shell sample
  name: FS shell
common:
  tags:
    - shell
    - filesystem
  harness: keyboard
tests:
  sample.filesystem.shell:
    platform_allow:
      - reel_board
      - mimxrt1060_evk
      - mr_canhubk3
      - native_sim
    integration_platforms:
      - reel_board
  sample.filesystem.shell.fuse:
    platform_allow:
      - native_sim
    extra_configs:
      - CONFIG_FUSE_FS_ACCESS=y
    # This test cannot be run in CI as we lack the fuse library
    skip: true
  sample.filesystem.shell.flash_load:
    tags:
      - flash_load
    platform_allow: nrf52dk/nrf52832
    extra_args: CONF_FILE=prj_flash_load.conf
    integration_platforms:
      - nrf52dk/nrf52832
```

## prj.conf
```kconfig
CONFIG_FLASH=y

CONFIG_LOG=y
#CONFIG_FS_LOG_LEVEL_DBG=y

CONFIG_HEAP_MEM_POOL_SIZE=16384

CONFIG_SHELL=y
CONFIG_SHELL_LOG_LEVEL_INF=y

CONFIG_FILE_SYSTEM=y
CONFIG_FILE_SYSTEM_SHELL=y


CONFIG_FILE_SYSTEM_LITTLEFS=y
CONFIG_FLASH_MAP=y
```

## prj_flash_load.conf
```kconfig
CONFIG_FLASH=y

CONFIG_LOG=y

CONFIG_HEAP_MEM_POOL_SIZE=16384

CONFIG_SHELL=y
CONFIG_SHELL_LOG_LEVEL_INF=y

CONFIG_FILE_SYSTEM=y
CONFIG_FILE_SYSTEM_SHELL=y

CONFIG_SHELL_BACKEND_SERIAL_RX_RING_BUFFER_SIZE=128

CONFIG_FILE_SYSTEM_LITTLEFS=y
CONFIG_FLASH_MAP=y
```

## src/main.c
```c
/*
 * Copyright (c) 2019 Jan Van Winkel <jan.van_winkel@dxplore.eu>
 *
 * SPDX-License-Identifier: Apache-2.0
 */


#define LOG_LEVEL CONFIG_LOG_DEFAULT_LEVEL
#include <zephyr/logging/log.h>
LOG_MODULE_REGISTER(app);

int main(void)
{
	return 0;
}
```
