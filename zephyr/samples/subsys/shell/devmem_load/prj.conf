## CMakeLists.txt
```
# Copyright (c) 2021 Antmicro <www.antmicro.com>
# SPDX-License-Identifier: Apache-2.0

cmake_minimum_required(VERSION 3.20.0)
find_package(Zephyr REQUIRED HINTS $ENV{ZEPHYR_BASE})
project(devmem_load)

target_sources(app PRIVATE src/main.c)
```

## sample.yaml
```
sample:
  name: devmem_load
  description: devmem load sample
common:
  harness: keyboard
  tags:
    - devmem
    - devmem_load
tests:
  sample.devmem_load.polled:
    integration_platforms:
      - native_sim
    extra_args: OVERLAY_CONFIG="prj_poll.conf"
  sample.devmem_load.uart.interrupt:
    integration_platforms:
      - frdm_k64f
    filter: CONFIG_SERIAL_SUPPORT_INTERRUPT
```

## prj.conf
```kconfig
CONFIG_BOOT_BANNER=n
CONFIG_SHELL=y
```

## prj_poll.conf
```kconfig
CONFIG_SHELL=y
CONFIG_SHELL_BACKEND_SERIAL_INTERRUPT_DRIVEN=n
CONFIG_SHELL_BACKEND_SERIAL_RX_POLL_PERIOD=1
CONFIG_BOOT_BANNER=n
```

## src/main.c
```c
/*
 * Copyright (c) 2021 Antmicro <www.antmicro.com>
 *
 * SPDX-License-Identifier: Apache-2.0
 */

int main(void)
{

	return 0;
};
```
