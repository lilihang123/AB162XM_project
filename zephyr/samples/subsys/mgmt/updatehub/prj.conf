## CMakeLists.txt
```
# Copyright (c) 2018-2020 O.S.Systems
#
# SPDX-License-Identifier: Apache-2.0

cmake_minimum_required(VERSION 3.20.0)

# This application has its own Kconfig options.
set(KCONFIG_ROOT ${CMAKE_CURRENT_SOURCE_DIR}/Kconfig)

find_package(Zephyr REQUIRED HINTS $ENV{ZEPHYR_BASE})
project(updatehub)

target_sources(app PRIVATE src/main.c)

if(CONFIG_UPDATEHUB_DTLS)
    set(gen_dir ${ZEPHYR_BINARY_DIR}/include/generated/)

    foreach(inc_file
            servercert.der
            privkey.der
            )
        generate_inc_file_for_target(
            ${ZEPHYR_CURRENT_LIBRARY}
            src/certificates/${inc_file}
            ${gen_dir}/${inc_file}.inc
            )
    endforeach()
endif()
```

## sample.yaml
```
sample:
  description: UpdateHub enterprise-grade Firmware Over-the-Air (FOTA)
  name: UpdateHub
common:
  harness: net
  tags:
    - net
    - wifi
    - updatehub
  depends_on: netif
  build_only: true
  platform_allow: frdm_k64f
  integration_platforms:
    - frdm_k64f
tests:
  sample.net.updatehub:
    extra_configs:
      - CONFIG_UPDATEHUB_PRODUCT_UID="e4d37cfe6ec48a2d069cc0bbb8b078677e9a0d8df3a027c4d8ea131130c4265f"
      - CONFIG_UPDATEHUB_POLL_INTERVAL=1
      - CONFIG_UPDATEHUB_CE=y
      - CONFIG_UPDATEHUB_SERVER="updatehub.io"
  sample.net.updatehub.psa:
    extra_args: OVERLAY_CONFIG="overlay-psa.conf"
    extra_configs:
      - CONFIG_UPDATEHUB_PRODUCT_UID="e4d37cfe6ec48a2d069cc0bbb8b078677e9a0d8df3a027c4d8ea131130c4265f"
      - CONFIG_UPDATEHUB_POLL_INTERVAL=1
      - CONFIG_UPDATEHUB_CE=y
      - CONFIG_UPDATEHUB_SERVER="updatehub.io"
  sample.net.updatehub.userspace:
    extra_configs:
      - CONFIG_UPDATEHUB_PRODUCT_UID="e4d37cfe6ec48a2d069cc0bbb8b078677e9a0d8df3a027c4d8ea131130c4265f"
      - CONFIG_UPDATEHUB_POLL_INTERVAL=1
      - CONFIG_UPDATEHUB_CE=y
      - CONFIG_UPDATEHUB_SERVER="updatehub.io"
      - CONFIG_USERSPACE=y
  sample.net.updatehub.dtls:
    extra_args: OVERLAY_CONFIG="overlay-dtls.conf"
    extra_configs:
      - CONFIG_UPDATEHUB_PRODUCT_UID="e4d37cfe6ec48a2d069cc0bbb8b078677e9a0d8df3a027c4d8ea131130c4265f"
      - CONFIG_UPDATEHUB_POLL_INTERVAL=1
      - CONFIG_UPDATEHUB_CE=y
      - CONFIG_UPDATEHUB_SERVER="updatehub.io"
```

## prj.conf
```kconfig
# Copyright (c) 2018-2020 O.S.Systems
# SPDX-License-Identifier: Apache-2.0
CONFIG_FLASH=y
CONFIG_STREAM_FLASH=y
CONFIG_FLASH_MAP=y
CONFIG_REBOOT=y
CONFIG_MCUBOOT_IMG_MANAGER=y
CONFIG_IMG_MANAGER=y
CONFIG_IMG_ENABLE_IMAGE_CHECK=y
CONFIG_BOOTLOADER_MCUBOOT=y
CONFIG_MPU_ALLOW_FLASH_WRITE=y
CONFIG_NETWORKING=y
CONFIG_NET_UDP=y
CONFIG_NET_SOCKETS=y
CONFIG_COAP=y
CONFIG_DNS_RESOLVER=y
CONFIG_JSON_LIBRARY=y
CONFIG_HWINFO=y
CONFIG_POSIX_API=y

# Turn on the updatehub
CONFIG_UPDATEHUB=y
CONFIG_COAP_INIT_ACK_TIMEOUT_MS=10000

# Heap mem pool size
CONFIG_HEAP_MEM_POOL_SIZE=8192
CONFIG_SYSTEM_WORKQUEUE_STACK_SIZE=8192

# Network events
CONFIG_NET_CONNECTION_MANAGER=y
CONFIG_NET_CONFIG_SETTINGS=y

CONFIG_NET_IPV6=n

CONFIG_NET_IPV4=y
CONFIG_NET_DHCPV4=y

# Enable Shell
CONFIG_SHELL=y
CONFIG_SHELL_STACK_SIZE=8192
CONFIG_UPDATEHUB_SHELL=y
CONFIG_NET_SHELL=y

# Debug helpers
CONFIG_LOG=y
#CONFIG_UPDATEHUB_LOG_LEVEL_DBG=y

CONFIG_MAX_THREAD_BYTES=3
```

## overlay-802154.conf
```kconfig
# Copyright (c) 2020 O.S.Systems
# SPDX-License-Identifier: Apache-2.0

# Disable default configs
CONFIG_BT=n

CONFIG_NET_L2_ETHERNET=n

CONFIG_NET_IPV4=n
CONFIG_NET_DHCPV4=n
CONFIG_NET_TCP=n

# Enable IEEE 802.15.4
CONFIG_NET_L2_IEEE802154=y
CONFIG_NET_L2_IEEE802154_SHELL=y

CONFIG_NET_CONFIG_IEEE802154_PAN_ID=0xcafe
CONFIG_NET_CONFIG_IEEE802154_CHANNEL=26

CONFIG_NET_IPV6=y
CONFIG_NET_IPV6_FRAGMENT=y
CONFIG_NET_6LO_CONTEXT=y
CONFIG_NET_MAX_6LO_CONTEXTS=10

CONFIG_NET_IF_UNICAST_IPV6_ADDR_COUNT=3
CONFIG_NET_IF_MCAST_IPV6_ADDR_COUNT=4
CONFIG_NET_MAX_CONTEXTS=10

CONFIG_NET_UDP=y

# Add DNS Server
CONFIG_DNS_SERVER_IP_ADDRESSES=y
CONFIG_DNS_SERVER1="2001:db8::1"

# UpdateHub
CONFIG_UPDATEHUB_SERVER="2001:db8::1"
CONFIG_UPDATEHUB_COAP_BLOCK_SIZE_EXP=2
```

## overlay-ot.conf
```kconfig
# Copyright (c) 2020 O.S.Systems
# SPDX-License-Identifier: Apache-2.0

# Disable default configs
CONFIG_BT=n

CONFIG_NET_L2_ETHERNET=n
CONFIG_NET_L2_IEEE802154=n

CONFIG_NET_IPV4=n
CONFIG_NET_DHCPV4=n
CONFIG_NET_TCP=n

# Enable OpenThread network
CONFIG_NET_L2_OPENTHREAD=y

CONFIG_OPENTHREAD_DEBUG=y
CONFIG_OPENTHREAD_L2_DEBUG=y
CONFIG_OPENTHREAD_L2_LOG_LEVEL_INF=y

# Enable OpenThread shell
CONFIG_SHELL=y
CONFIG_OPENTHREAD_SHELL=y

# This follows https://openthread.io/guides/border-router guides
# It uses the default values from otbr-web page
CONFIG_OPENTHREAD_PANID=4660
CONFIG_OPENTHREAD_CHANNEL=15
CONFIG_OPENTHREAD_NETWORK_NAME="OpenThreadDemo"
CONFIG_OPENTHREAD_XPANID="0x1111111122222222"
CONFIG_OPENTHREAD_JOINER=y
CONFIG_OPENTHREAD_JOINER_AUTOSTART=y
CONFIG_OPENTHREAD_JOINER_PSKD="J01NU5"
CONFIG_OPENTHREAD_SLAAC=y

CONFIG_NET_IPV6_NBR_CACHE=n
CONFIG_NET_IPV6_MLD=n

# mbedTLS tweaks
CONFIG_MBEDTLS_SSL_MAX_CONTENT_LEN=768

# UpdateHub
CONFIG_MAIN_STACK_SIZE=8192
CONFIG_UPDATEHUB_COAP_BLOCK_SIZE_EXP=2

# Only tested with 6to4
#
#######################
CONFIG_DNS_SERVER_IP_ADDRESSES=y
# Add google IPv4 DNS Server
# https://www.ultratools.com/tools/ipv4toipv6Result?address=8.8.8.8
# Mapped Address: 0:0:0:0:0:ffff:808:808
# Extract value                 >808:808<
# Add prefix        64:ff9b::
CONFIG_DNS_SERVER1="64:ff9b::808:808"
# Repeat the above step with your server IPv4 address translated to IPv6
CONFIG_UPDATEHUB_SERVER="<your server ip address>"
```

## overlay-wifi.conf
```kconfig
# Copyright (c) 2020 O.S.Systems
# SPDX-License-Identifier: Apache-2.0

# Disable default configs
CONFIG_NET_L2_ETHERNET=n

CONFIG_NET_DHCPV4=n

CONFIG_NET_CONFIG_SETTINGS=n

# Enable WIFI
CONFIG_WIFI=y
CONFIG_UPDATEHUB_SAMPLE_WIFI_SSID="<SSID>"
CONFIG_UPDATEHUB_SAMPLE_WIFI_PSK="<PASSWD>"

CONFIG_NET_PKT_RX_COUNT=8
CONFIG_NET_PKT_TX_COUNT=8
CONFIG_NET_BUF_RX_COUNT=20
CONFIG_NET_BUF_TX_COUNT=20

# Add DNS Server
CONFIG_DNS_SERVER_IP_ADDRESSES=y
CONFIG_DNS_SERVER1="8.8.8.8"
```

## src/main.c
```c
/*
 * Copyright (c) 2018-2023 O.S.Systems
 *
 * SPDX-License-Identifier: Apache-2.0
 */

#include <zephyr/kernel.h>
#include <zephyr/mgmt/updatehub.h>
#include <zephyr/net/net_mgmt.h>
#include <zephyr/net/net_event.h>
#include <zephyr/net/conn_mgr_monitor.h>

#ifdef CONFIG_NET_L2_WIFI_MGMT
#include <zephyr/net/wifi_mgmt.h>
#endif /* CONFIG_NET_L2_WIFI_MGMT */

#if defined(CONFIG_UPDATEHUB_DTLS)
#include <zephyr/net/tls_credentials.h>
#include "c_certificates.h"
#endif

#include <zephyr/logging/log.h>
LOG_MODULE_REGISTER(main);

#define EVENT_MASK (NET_EVENT_L4_CONNECTED | \
		    NET_EVENT_L4_DISCONNECTED)

static struct net_mgmt_event_callback mgmt_cb;

void start_updatehub(void)
{
#if defined(CONFIG_UPDATEHUB_SAMPLE_POLLING)
	LOG_INF("Starting UpdateHub polling mode");
	updatehub_autohandler();
#endif

#if defined(CONFIG_UPDATEHUB_SAMPLE_MANUAL)
	LOG_INF("Starting UpdateHub manual mode");

	switch (updatehub_probe()) {
	case UPDATEHUB_HAS_UPDATE:
		switch (updatehub_update()) {
		case UPDATEHUB_OK:
			ret = 0;
			updatehub_reboot();
			break;

		default:
			LOG_ERR("Error installing update.");
			break;
		}

	case UPDATEHUB_NO_UPDATE:
		LOG_INF("No update found");
		ret = 0;
		break;

	default:
		LOG_ERR("Invalid response");
		break;
	}
#endif
}

static void event_handler(struct net_mgmt_event_callback *cb,
			  uint32_t mgmt_event, struct net_if *iface)
{
	if ((mgmt_event & EVENT_MASK) != mgmt_event) {
		return;
	}

	if (mgmt_event == NET_EVENT_L4_CONNECTED) {
		LOG_INF("Network connected");
		start_updatehub();
		return;
	}

	if (mgmt_event == NET_EVENT_L4_DISCONNECTED) {
		LOG_INF("Network disconnected");
		return;
	}
}

int main(void)
{
	int ret;

	LOG_INF("UpdateHub sample app started");

#if defined(CONFIG_UPDATEHUB_DTLS)
	if (tls_credential_add(CA_CERTIFICATE_TAG,
			       TLS_CREDENTIAL_SERVER_CERTIFICATE,
			       server_certificate,
			       sizeof(server_certificate)) < 0) {
		LOG_ERR("Failed to register server certificate");
		return 0;
	}

	if (tls_credential_add(CA_CERTIFICATE_TAG,
			       TLS_CREDENTIAL_PRIVATE_KEY,
			       private_key,
			       sizeof(private_key)) < 0) {
		LOG_ERR("Failed to register private key");
		return 0;
	}
#endif

	/* The image of application needed be confirmed */
	LOG_INF("Confirming the boot image");
	ret = updatehub_confirm();
	if (ret < 0) {
		LOG_ERR("Error to confirm the image");
	}

#if defined(CONFIG_WIFI)
	int nr_tries = 10;
	struct net_if *iface = net_if_get_default();
	static struct wifi_connect_req_params cnx_params = {
		.ssid = CONFIG_UPDATEHUB_SAMPLE_WIFI_SSID,
		.ssid_length = 0,
		.psk = CONFIG_UPDATEHUB_SAMPLE_WIFI_PSK,
		.psk_length = 0,
		.channel = 0,
		.security = WIFI_SECURITY_TYPE_PSK,
	};

	cnx_params.ssid_length = strlen(CONFIG_UPDATEHUB_SAMPLE_WIFI_SSID);
	cnx_params.psk_length = strlen(CONFIG_UPDATEHUB_SAMPLE_WIFI_PSK);

	/* Let's wait few seconds to allow wifi device be on-line */
	while (nr_tries-- > 0) {
		ret = net_mgmt(NET_REQUEST_WIFI_CONNECT, iface, &cnx_params,
			       sizeof(struct wifi_connect_req_params));
		if (ret == 0) {
			break;
		}

		LOG_INF("Connect request failed %d. Waiting iface be up...", ret);
		k_msleep(500);
	}
#endif

	net_mgmt_init_event_callback(&mgmt_cb, event_handler, EVENT_MASK);
	net_mgmt_add_event_callback(&mgmt_cb);
	conn_mgr_mon_resend_status();
	return 0;
}
```
