## CMakeLists.txt
```
# Copyright (c) 2020 Linumiz
#
# SPDX-License-Identifier: Apache-2.0

cmake_minimum_required(VERSION 3.20.0)

# This application has its own Kconfig options.
set(KCONFIG_ROOT ${CMAKE_CURRENT_SOURCE_DIR}/Kconfig)

find_package(Zephyr REQUIRED HINTS $ENV{ZEPHYR_BASE})
project(hawkbit)

target_sources(app PRIVATE src/main.c)

include(${ZEPHYR_BASE}/samples/net/common/common.cmake)

set(gen_dir ${ZEPHYR_BINARY_DIR}/include/generated/)

generate_inc_file_for_target(
    app
    src/self_sign.der
    ${gen_dir}/self_sign.der.inc
    )
```

## Kconfig
```
#
# Copyright (c) 2020 Linumiz
#
# SPDX-License-Identifier: Apache-2.0
#
mainmenu "hawkBit sample configuration"

choice
	prompt "hawkBit mode"
	default HAWKBIT_POLLING
	depends on HAWKBIT

config HAWKBIT_POLLING
	bool "hawkBit Polling mode"
	help
	  Polling mode runs automatically on a predefined period, probing the
	  server for updates and installing them without requiring user
	  intervention.

config HAWKBIT_MANUAL
	bool "hawkBit manual mode"
	help
	  Manual mode requires the user to call the server probe and then, if
	  there is an available update, also requires the user to decide if
	  it is appropriate to update now or later.

endchoice

source "Kconfig.zephyr"
```

## sample.yaml
```
common:
  filter: CONFIG_FULL_LIBC_SUPPORTED
  harness: net
  tags: net
  depends_on: netif
  build_only: true
  platform_allow: frdm_k64f
  integration_platforms:
    - frdm_k64f
sample:
  description: hawkBit Firmware Over-the-Air (FOTA)
  name: hawkbit
tests:
  sample.net.hawkbit.default: {}
  sample.net.hawkbit.manual:
    extra_configs:
      - CONFIG_HAWKBIT_MANUAL=y
  sample.net.hawkbit.shell:
    extra_configs:
      - CONFIG_SHELL=y
      - CONFIG_HAWKBIT_SHELL=y
  sample.net.hawkbit.ddi.target:
    extra_configs:
      - CONFIG_HAWKBIT_DDI_TARGET_SECURITY=y
      - CONFIG_HAWKBIT_DDI_SECURITY_TOKEN="abcd1234"
  sample.net.hawkbit.ddi.gateway:
    extra_configs:
      - CONFIG_HAWKBIT_DDI_GATEWAY_SECURITY=y
      - CONFIG_HAWKBIT_DDI_SECURITY_TOKEN="abcd1234"
  sample.net.hawkbit.tls:
    extra_configs:
      - CONFIG_HAWKBIT_USE_TLS=y
      - CONFIG_NET_SOCKETS_SOCKOPT_TLS=y
  sample.net.hawkbit.set_settings_runtime:
    extra_configs:
      - CONFIG_HAWKBIT_SET_SETTINGS_RUNTIME=y
```

## prj.conf
```kconfig
#Enable hawkBit
CONFIG_HAWKBIT=y
CONFIG_NVS=y
CONFIG_FLASH=y
CONFIG_FLASH_MAP=y
CONFIG_STREAM_FLASH=y
CONFIG_REBOOT=y
CONFIG_HWINFO=y
CONFIG_NET_TCP=y
CONFIG_NET_SOCKETS=y
CONFIG_IMG_MANAGER=y
CONFIG_NETWORKING=y
CONFIG_HTTP_CLIENT=y
CONFIG_DNS_RESOLVER=y
CONFIG_JSON_LIBRARY=y
CONFIG_BOOTLOADER_MCUBOOT=y
CONFIG_SETTINGS=y
CONFIG_MCUBOOT_GENERATE_UNSIGNED_IMAGE=n
CONFIG_MCUBOOT_GENERATE_CONFIRMED_IMAGE=y
CONFIG_MCUBOOT_SIGNATURE_KEY_FILE="./bootloader/mcuboot/root-rsa-2048.pem"

#Main Stack Size
CONFIG_MAIN_STACK_SIZE=4096

#Minimal Heap mem pool size for hawkBit to work
CONFIG_HEAP_MEM_POOL_SIZE=4096
CONFIG_SYSTEM_WORKQUEUE_STACK_SIZE=4096

CONFIG_NET_CONFIG_SETTINGS=y
CONFIG_NET_CONFIG_NEED_IPV4=y

CONFIG_NET_IPV4=y
CONFIG_NET_IPV6=n

#Enable DHCPv4 server
CONFIG_NET_DHCPV4=y
CONFIG_NET_MGMT=y
CONFIG_NET_MGMT_EVENT=y

#Enable DNS Resolver
CONFIG_DNS_RESOLVER=y
CONFIG_DNS_SERVER_IP_ADDRESSES=y
CONFIG_DNS_SERVER1="8.8.8.8"
CONFIG_DNS_SERVER2="192.168.1.1"

#Optional if you would like test on the your server
CONFIG_SHELL=y
CONFIG_HAWKBIT_SHELL=y
CONFIG_KERNEL_SHELL=y
CONFIG_SHELL_STACK_SIZE=4096

#hawkBit polling mode
CONFIG_HAWKBIT_POLLING=y

#Config hawkBit Server
CONFIG_HAWKBIT_SERVER="192.168.1.110"

#Debug helpers
CONFIG_LOG=y
CONFIG_HAWKBIT_LOG_LEVEL_INF=n

#General Config
CONFIG_REQUIRES_FULL_LIBC=y
CONFIG_LOG_BUFFER_SIZE=4096

#Generate HEX output
CONFIG_BUILD_OUTPUT_HEX=y

#Use custom attributes for hawkBit
CONFIG_HAWKBIT_CUSTOM_ATTRIBUTES=y
```

## overlay-runtime.conf
```kconfig
CONFIG_HAWKBIT_SET_SETTINGS_RUNTIME=y
```

## overlay-tls.conf
```kconfig
CONFIG_MAIN_STACK_SIZE=8192

# TLS configuration
CONFIG_MBEDTLS=y
CONFIG_MBEDTLS_BUILTIN=y
CONFIG_MBEDTLS_ENABLE_HEAP=y
CONFIG_MBEDTLS_HEAP_SIZE=60000
CONFIG_MBEDTLS_SSL_MAX_CONTENT_LEN=16384

CONFIG_NET_SOCKETS_SOCKOPT_TLS=y
CONFIG_HAWKBIT_USE_TLS=y
```

## src/main.c
```c
/*
 * Copyright (c) 2020 Linumiz
 *
 * SPDX-License-Identifier: Apache-2.0
 */

#include <zephyr/kernel.h>
#include <zephyr/mgmt/hawkbit.h>
#include <zephyr/dfu/mcuboot.h>
#include <zephyr/sys/printk.h>
#include <zephyr/sys/reboot.h>
#include <zephyr/logging/log.h>
#include <zephyr/data/json.h>

#if defined(CONFIG_NET_SOCKETS_SOCKOPT_TLS)
#include <zephyr/net/tls_credentials.h>
#include "ca_certificate.h"
#endif

LOG_MODULE_REGISTER(main);

#ifdef CONFIG_HAWKBIT_CUSTOM_ATTRIBUTES
struct hawkbit_cfg_data {
	const char *VIN;
	const char *customAttr;
};

struct hawkbit_cfg {
	const char *mode;
	struct hawkbit_cfg_data data;
};

static const struct json_obj_descr json_cfg_data_descr[] = {
	JSON_OBJ_DESCR_PRIM(struct hawkbit_cfg_data, VIN, JSON_TOK_STRING),
	JSON_OBJ_DESCR_PRIM(struct hawkbit_cfg_data, customAttr, JSON_TOK_STRING),
};

static const struct json_obj_descr json_cfg_descr[] = {
	JSON_OBJ_DESCR_PRIM(struct hawkbit_cfg, mode, JSON_TOK_STRING),
	JSON_OBJ_DESCR_OBJECT(struct hawkbit_cfg, data, json_cfg_data_descr),
};

int hawkbit_new_config_data_cb(const char *device_id, uint8_t *buffer, const size_t buffer_size)
{
	struct hawkbit_cfg cfg = {
		.mode = "merge",
		.data.VIN = device_id,
		.data.customAttr = "Hello World!",
	};

	return json_obj_encode_buf(json_cfg_descr, ARRAY_SIZE(json_cfg_descr), &cfg, buffer,
				   buffer_size);
}
#endif /* CONFIG_HAWKBIT_CUSTOM_ATTRIBUTES */

int main(void)
{
	int ret = -1;

	LOG_INF("hawkBit sample app started");
	LOG_INF("Image build time: " __DATE__ " " __TIME__);

#if defined(CONFIG_NET_SOCKETS_SOCKOPT_TLS)
	tls_credential_add(CA_CERTIFICATE_TAG, TLS_CREDENTIAL_CA_CERTIFICATE,
			   ca_certificate, sizeof(ca_certificate));
#endif
#ifdef CONFIG_HAWKBIT_CUSTOM_ATTRIBUTES
	ret = hawkbit_set_custom_data_cb(hawkbit_new_config_data_cb);
	if (ret < 0) {
		LOG_ERR("Failed to set custom data callback");
	}
#endif /* CONFIG_HAWKBIT_CUSTOM_ATTRIBUTES */

	ret = hawkbit_init();
	if (ret < 0) {
		LOG_ERR("Failed to init hawkBit");
	}

#ifdef CONFIG_HAWKBIT_SET_SETTINGS_RUNTIME
	hawkbit_set_server_addr(CONFIG_HAWKBIT_SERVER);
	hawkbit_set_server_port(CONFIG_HAWKBIT_PORT);
#endif

#if defined(CONFIG_HAWKBIT_POLLING)
	LOG_INF("Starting hawkBit polling mode");
	hawkbit_autohandler();
#endif

#if defined(CONFIG_HAWKBIT_MANUAL)
	LOG_INF("Starting hawkBit manual mode");

	switch (hawkbit_probe()) {
	case HAWKBIT_UNCONFIRMED_IMAGE:
		LOG_ERR("Image is unconfirmed");
		LOG_ERR("Rebooting to previous confirmed image");
		LOG_ERR("If this image is flashed using a hardware tool");
		LOG_ERR("Make sure that it is a confirmed image");
		k_sleep(K_SECONDS(1));
		sys_reboot(SYS_REBOOT_WARM);
		break;

	case HAWKBIT_NO_UPDATE:
		LOG_INF("No update found");
		break;

	case HAWKBIT_CANCEL_UPDATE:
		LOG_INF("hawkBit update cancelled from server");
		break;

	case HAWKBIT_OK:
		LOG_INF("Image is already updated");
		break;

	case HAWKBIT_UPDATE_INSTALLED:
		LOG_INF("Update installed");
		break;

	case HAWKBIT_PROBE_IN_PROGRESS:
		LOG_INF("hawkBit is already running");
		break;

	default:
		break;
	}

#endif
	return 0;
}
```
