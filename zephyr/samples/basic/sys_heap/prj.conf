## CMakeLists.txt
```
# SPDX-License-Identifier: Apache-2.0

cmake_minimum_required(VERSION 3.20.0)

find_package(Zephyr REQUIRED HINTS $ENV{ZEPHYR_BASE})
project(sys_heap)

target_sources(app PRIVATE src/main.c)
```

## sample.yaml
```
sample:
  description: System heap sample showing how to use sys_heap functions
  name: Basic system heap sample
common:
  integration_platforms:
    - native_sim
  harness: console
  harness_config:
    type: multi_line
    ordered: true
    regex:
      - ".*allocated 15.,.*"
      - ".*allocated 10.,.*"
      - ".*allocated 0, free ..., max allocated ..., heap size 256.*"
tests:
  sample.basic.sys_heap:
    tags:
      - heap
      - statistics
      - dynamic_memory
```

## prj.conf
```kconfig
CONFIG_SYS_HEAP_RUNTIME_STATS=y
```

## src/main.c
```c
/*
 * Copyright (c) 2022 Jeppe Odgaard
 *
 * SPDX-License-Identifier: Apache-2.0
 */

#include <zephyr/kernel.h>
#include <zephyr/sys/sys_heap.h>

#define HEAP_SIZE	256

static char heap_mem[HEAP_SIZE];
static struct sys_heap heap;

static void print_sys_memory_stats(void);

int main(void)
{
	void *p;

	printk("System heap sample\n\n");

	sys_heap_init(&heap, heap_mem, HEAP_SIZE);
	print_sys_memory_stats();

	p = sys_heap_alloc(&heap, 150);
	print_sys_memory_stats();

	p = sys_heap_realloc(&heap, p, 100);
	print_sys_memory_stats();

	sys_heap_free(&heap, p);
	print_sys_memory_stats();
	return 0;
}

static void print_sys_memory_stats(void)
{
	struct sys_memory_stats stats;

	sys_heap_runtime_stats_get(&heap, &stats);

	printk("allocated %zu, free %zu, max allocated %zu, heap size %u\n",
		stats.allocated_bytes, stats.free_bytes,
		stats.max_allocated_bytes, HEAP_SIZE);
}
```
