## CMakeLists.txt
```
# SPDX-License-Identifier: Apache-2.0

cmake_minimum_required(VERSION 3.20.0)

find_package(Zephyr REQUIRED HINTS $ENV{ZEPHYR_BASE})

project(tfm_ipc)

target_sources(app PRIVATE src/main.c)

target_include_directories(app PRIVATE
  $<TARGET_PROPERTY:tfm,TFM_BINARY_DIR>/api_ns/interface/include
)
```

## sample.yaml
```
sample:
  description: This app provides an example of using TF-M on the secure side, with
    Zephyr on the NS side, using IPC.
  name: TF-M IPC example
tests:
  sample.tfm_ipc:
    tags:
      - introduction
      - trusted-firmware-m
      - mcuboot
    platform_allow:
      - mps2/an521/cpu0/ns
      - nrf5340dk/nrf5340/cpuapp/ns
      - nrf9160dk/nrf9160/ns
      - nucleo_l552ze_q/stm32l552xx/ns
      - stm32l562e_dk/stm32l562xx/ns
      - v2m_musca_s1/musca_s1/ns
      - bl5340_dvk/nrf5340/cpuapp/ns
      - b_u585i_iot02a/stm32u585xx/ns
    integration_platforms:
      - mps2/an521/cpu0/ns
    harness: console
    harness_config:
      type: multi_line
      regex:
        - "TF-M IPC on .*"
        - "The version of the PSA Framework API is"
        - "The PSA Crypto service minor version is"
        - "Generating 256 bytes of random data"
  sample.tfm_ipc.no_bl2:
    tags:
      - introduction
      - trusted-firmware-m
    platform_allow: mps2/an521/cpu0/ns
    extra_configs:
      - CONFIG_TFM_BL2=n
    harness: console
    harness_config:
      type: multi_line
      regex:
        - "TF-M IPC on .*"
        - "The version of the PSA Framework API is"
        - "The PSA Crypto service minor version is"
        - "Generating 256 bytes of random data"
```

## prj.conf
```kconfig
CONFIG_BUILD_WITH_TFM=y
CONFIG_TFM_PROFILE_TYPE_NOT_SET=y
CONFIG_TFM_IPC=y
CONFIG_REBOOT=y

# The Zephyr CMSIS emulation assumes that ticks are ms, currently
CONFIG_SYS_CLOCK_TICKS_PER_SEC=1000

CONFIG_MAIN_STACK_SIZE=4096
CONFIG_HEAP_MEM_POOL_SIZE=4096
```

## src/main.c
```c
/*
 * Copyright (c) 2019,2020, 2021, 2023 Linaro Limited
 *
 * SPDX-License-Identifier: Apache-2.0
 */

#include <zephyr/kernel.h>
#include <zephyr/sys/printk.h>

#include "tfm_ns_interface.h"
#ifdef TFM_PSA_API
#include "psa_manifest/sid.h"
#include "psa/crypto.h"
#endif

/**
 * \brief Retrieve the version of the PSA Framework API.
 *
 * \note This is a functional test only and doesn't
 *       mean to test all possible combinations of
 *       input parameters and return values.
 */
static void tfm_get_version(void)
{
	uint32_t version;

	version = psa_framework_version();
	if (version == PSA_FRAMEWORK_VERSION) {
		printk("The version of the PSA Framework API is %d.\n",
		       version);
	} else {
		printk("The version of the PSA Framework API is not valid!\n");
		return;
	}
}

#ifdef TFM_PSA_API
/**
 * \brief Retrieve the minor version of a RoT Service.
 */
static void tfm_get_sid(void)
{
	uint32_t version;

	version = psa_version(TFM_CRYPTO_SID);
	if (version == PSA_VERSION_NONE) {
		printk("RoT Service is not implemented or caller is not ");
		printk("authorized to access it!\n");
		return;
	}

	/* Valid version number */
	printk("The PSA Crypto service minor version is %d.\n", version);
}

/**
 * \brief Generates random data using the TF-M crypto service.
 */
void tfm_psa_crypto_rng(void)
{
	psa_status_t status;
	uint8_t outbuf[256] = { 0 };

	status = psa_generate_random(outbuf, 256);
	printk("Generating 256 bytes of random data:");
	for (uint16_t i = 0; i < 256; i++) {
		if (!(i % 16)) {
			printk("\n");
		}
		printk("%02X ", (uint8_t)(outbuf[i] & 0xFF));
	}
	printk("\n");
}
#endif

int main(void)
{
	printk("TF-M IPC on %s\n", CONFIG_BOARD);

	tfm_get_version();
#ifdef TFM_PSA_API
	tfm_get_sid();
	tfm_psa_crypto_rng();
#endif
	return 0;
}
```
