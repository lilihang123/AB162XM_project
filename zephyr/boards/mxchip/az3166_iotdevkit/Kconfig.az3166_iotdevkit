## zephyr/boards/mxchip/az3166_iotdevkit/Kconfig.az3166_iotdevkit
```kconfig
# Copyright (c) 2023 Benjamin Cabé <benjamin@zephyrproject.org>
# SPDX-License-Identifier: Apache-2.0

config BOARD_AZ3166_IOTDEVKIT
	select SOC_STM32F412RX
```

## zephyr/boards/olimex/lora_stm32wl_devkit/Kconfig.olimex_lora_stm32wl_devkit
```kconfig
# Copyright (c) 2022 Martin Jäger <martin@libre.solar>
# SPDX-License-Identifier: Apache-2.0

config BOARD_OLIMEX_LORA_STM32WL_DEVKIT
	select SOC_STM32WLE5XX
```

## zephyr/boards/st/nucleo_g070rb/Kconfig.nucleo_g070rb
```kconfig
# Copyright (c) 2023 Marin Jurjević <marin.jurjevic@hotmail.com>
# SPDX-License-Identifier: Apache-2.0

config BOARD_NUCLEO_G070RB
	select SOC_STM32G070XX
```
