# gpio_reva_me11 register map
Registers are access not given, no defined reset value unless marked. A register's access mark holds for its fields unless they carry their own. Offsets are from the block's base; lines under a group give offsets from that group; [hi:lo] are bit positions; {n}, {i} and the like mark numbered series; 'fields as' and 'values as' point back to an identical list; <NAME> marks a mode.

## Memory map
0x40008000 GPIO0 size 0x1000 — Individual I/O for each GPIO

## Interrupts
24 GPIO0 — GPIO0 interrupt.

## GPIO0 — Individual I/O for each GPIO
Base 0x40008000
0x00 EN0 — GPIO Function Enable 0 Register. Each bit controls the GPIO_EN setting for one GPIO pin on the associated port.
  [31:0] GPIO_EN — Mask of all of the pins on the port.
    0=Alternate function enabled; 1=GPIO (GPIO function is enabled.)
0x04 EN0_SET — GPIO Set Function Enable 0 Register. Writing a 1 to one or more bits in this register sets the bits in the same positions in GPIO_EN to 1, without affecting other bits in that register.
  [31:0] ALL — Mask of all of the pins on the port.
0x08 EN0_CLR — GPIO Clear Function Enable Register. Writing a 1 to one or more bits in this register clears the bits in the same positions in GPIO_EN to 0, without affecting other bits in that register.
  [31:0] ALL — Mask of all of the pins on the port.
0x0C OUT_EN — GPIO Output Enable Register. Each bit controls the GPIO_OUT_EN setting for one GPIO pin in the associated port.
  [31:0] GPIO_OUT_EN — Mask of all of the pins on the port.
    0=dis (GPIO Output Disable); 1=en (GPIO Output Enable)
0x10 OUT_EN_SET — GPIO Output Enable Set Function Enable Register. Writing a 1 to one or more bits in this register sets the bits in the same positions in GPIO_OUT_EN to 1, without affecting other bits in that register.
  [31:0] ALL — Mask of all of the pins on the port.
0x14 OUT_EN_CLR — GPIO Output Enable Clear Function Enable Register. Writing a 1 to one or more bits in this register clears the bits in the same positions in GPIO_OUT_EN to 0, without affecting other bits in that register.
  [31:0] ALL — Mask of all of the pins on the port.
0x18 OUT — GPIO Output Register. Each bit controls the GPIO_OUT setting for one pin in the associated port. This register can be written either directly, or by using the GPIO_OUT_SET and GPIO_OUT_CLR registers.
  [31:0] GPIO_OUT — Mask of all of the pins on the port.
    0=low (Drive Logic 0 (low) on GPIO output.); 1=high (Drive logic 1 (high) on GPIO output.)
0x1C OUT_SET wo — GPIO Output Set. Writing a 1 to one or more bits in this register sets the bits in the same positions in GPIO_OUT to 1, without affecting other bits in that register.
  [31:0] GPIO_OUT_SET — Mask of all of the pins on the port.
    0=no (No Effect.); 1=set (Set GPIO_OUT bit in this position to '1')
0x20 OUT_CLR wo — GPIO Output Clear. Writing a 1 to one or more bits in this register clears the bits in the same positions in GPIO_OUT to 0, without affecting other bits in that register.
  [31:0] GPIO_OUT_CLR — Mask of all of the pins on the port.
0x24 IN ro — GPIO Input Register. Read-only register to read from the logic states of the GPIO pins on this port.
  [31:0] GPIO_IN — Mask of all of the pins on the port.
0x28 INT_MOD — GPIO Interrupt Mode Register. Each bit in this register controls the interrupt mode setting for the associated GPIO pin on this port.
  [31:0] GPIO_INT_MOD — Mask of all of the pins on the port.
    0=level (Interrupts for this pin are level triggered.); 1=edge (Interrupts for this pin are edge triggered.)
0x2C INT_POL — GPIO Interrupt Polarity Register. Each bit in this register controls the interrupt polarity setting for one GPIO pin in the associated port.
  [31:0] GPIO_INT_POL — Mask of all of the pins on the port.
    0=falling (Interrupts are latched on a falling edge or low level condition for this pin.); 1=rising (Interrupts are latched on a rising edge or high condition for this pin.)
0x30 IN_EN — GPIO Port Input Enable.
  [31:0] GPIO_IN_EN — Mask of all of the pins on the port.
    0=dis (GPIO Input Disable); 1=en (GPIO Input Enable)
0x34 INT_EN — GPIO Interrupt Enable Register. Each bit in this register controls the GPIO interrupt enable for the associated pin on the GPIO port.
  [31:0] GPIO_INT_EN — Mask of all of the pins on the port.
    0=dis (Interrupts are disabled for this GPIO pin.); 1=en (Interrupts are enabled for this GPIO pin.)
0x38 INT_EN_SET — GPIO Interrupt Enable Set. Writing a 1 to one or more bits in this register sets the bits in the same positions in GPIO_INT_EN to 1, without affecting other bits in that register.
  [31:0] GPIO_INT_EN_SET — Mask of all of the pins on the port.
    0=no (No effect.); 1=set (Set GPIO_INT_EN bit in this position to '1')
0x3C INT_EN_CLR — GPIO Interrupt Enable Clear. Writing a 1 to one or more bits in this register clears the bits in the same positions in GPIO_INT_EN to 0, without affecting other bits in that register.
  [31:0] GPIO_INT_EN_CLR — Mask of all of the pins on the port.
    0=no (No Effect.); 1=Clear GPIO_INT_EN bit in this position to '0'
0x40 INT_STAT ro — GPIO Interrupt Status Register. Each bit in this register contains the pending interrupt status for the associated GPIO pin in this port.
  [31:0] GPIO_INT_STAT — Mask of all of the pins on the port.
    0=no (No Interrupt is pending on this GPIO pin.); 1=pending (An Interrupt is pending on this GPIO pin.)
0x48 INT_CLR — GPIO Status Clear. Writing a 1 to one or more bits in this register clears the bits in the same positions in GPIO_INT_STAT to 0, without affecting other bits in that register.
  [31:0] ALL — Mask of all of the pins on the port.
0x4C WAKE_EN — GPIO Wake Enable Register. Each bit in this register controls the PMU wakeup enable for the associated GPIO pin in this port.
  [31:0] GPIO_WAKE_EN — Mask of all of the pins on the port.
    0=dis (PMU wakeup for this GPIO is disabled.); 1=en (PMU wakeup for this GPIO is enabled.)
0x50 WAKE_EN_SET — GPIO Wake Enable Set. Writing a 1 to one or more bits in this register sets the bits in the same positions in GPIO_WAKE_EN to 1, without affecting other bits in that register.
  [31:0] ALL — Mask of all of the pins on the port.
0x54 WAKE_EN_CLR — GPIO Wake Enable Clear. Writing a 1 to one or more bits in this register clears the bits in the same positions in GPIO_WAKE_EN to 0, without affecting other bits in that register.
  [31:0] ALL — Mask of all of the pins on the port.
0x5C INT_DUAL_EDGE — GPIO Interrupt Dual Edge Mode Register. Each bit in this register selects dual edge mode for the associated GPIO pin in this port.
  [31:0] GPIO_INT_DUAL_EDGE — Mask of all of the pins on the port.
    0=no (No Effect.); 1=en (Dual Edge mode is enabled. If edge-triggered interrupts are enabled on this GPIO pin, then both rising and falling edges will trigger interrupts regardless of the GPIO_INT_POL setting.)
0x60 PAD_CFG1 — GPIO Input Mode Config 1. Each bit in this register enables the weak pull-up for the associated GPIO pin in this port.
  [31:0] GPIO_PAD_CFG1 — The two bits in GPIO_PAD_CFG1 and GPIO_PAD_CFG2 for each GPIO pin work together to determine the pad mode when the GPIO is set to input mode.
    0=impedance (High Impedance.); 1=pu (Weak pull-up mode.); 2=pd (weak pull-down mode.)
0x64 PAD_CFG2 — GPIO Input Mode Config 2. Each bit in this register enables the weak pull-up for the associated GPIO pin in this port.
  [31:0] GPIO_PAD_CFG2 — The two bits in GPIO_PAD_CFG1 and GPIO_PAD_CFG2 for each GPIO pin work together to determine the pad mode when the GPIO is set to input mode.
    values as PAD_CFG1.GPIO_PAD_CFG1
0x68 EN1 — GPIO Alternate Function Enable Register. Each bit in this register selects between primary/secondary functions for the associated GPIO pin in this port.
  [31:0] GPIO_EN1 — Mask of all of the pins on the port.
    0=Primary function selected; 1=Secondary function selected
0x6C EN1_SET — GPIO Alternate Function Set. Writing a 1 to one or more bits in this register sets the bits in the same positions in GPIO_EN1 to 1, without affecting other bits in that register.
  [31:0] ALL — Mask of all of the pins on the port.
0x70 EN1_CLR — GPIO Alternate Function Clear. Writing a 1 to one or more bits in this register clears the bits in the same positions in GPIO_EN1 to 0, without affecting other bits in that register.
  [31:0] ALL — Mask of all of the pins on the port.
0x74 EN2 — GPIO Alternate Function Enable Register. Each bit in this register selects between primary/secondary functions for the associated GPIO pin in this port.
  [31:0] GPIO_EN2 — Mask of all of the pins on the port.
    0=Primary function selected; 1=Secondary function selected
0x78 EN2_SET — GPIO Alternate Function 2 Set. Writing a 1 to one or more bits in this register sets the bits in the same positions in GPIO_EN2 to 1, without affecting other bits in that register.
  [31:0] ALL — Mask of all of the pins on the port.
0x7C EN2_CLR — GPIO Wake Alternate Function Clear. Writing a 1 to one or more bits in this register clears the bits in the same positions in GPIO_EN2 to 0, without affecting other bits in that register.
  [31:0] ALL — Mask of all of the pins on the port.
0xA8 IS — GPIO Input Hysteresis Enable.
  [31:0] ALL — Mask of all of the pins on the port.
0xAC SR — GPIO Slew Rate Enable Register.
  [31:0] ALL — Mask of all of the pins on the port.
    0=FAST (Fast Slew Rate selected.); 1=SLOW (Slow Slew Rate selected.)
0xB0 DS0 — GPIO Drive Strength Register. Each bit in this register selects the drive strength for the associated GPIO pin in this port. Refer to the Datasheet for sink/source current of GPIO pins in each mode.
  [31:0] ALL — Mask of all of the pins on the port.
    0=ld (GPIO port pin is in low-drive mode.); 1=hd (GPIO port pin is in high-drive mode.)
0xB4 DS1 — GPIO Drive Strength 1 Register. Each bit in this register selects the drive strength for the associated GPIO pin in this port. Refer to the Datasheet for sink/source current of GPIO pins in each mode.
  [31:0] ALL — Mask of all of the pins on the port.
0xB8 PS — GPIO Pull Select Mode.
  [31:0] ALL — Mask of all of the pins on the port.
0xC0 VSSEL — GPIO Voltage Select.
  [31:0] ALL — Mask of all of the pins on the port.
