# spixf_fifo_reva register map
Registers are 8-bit, access not given, no defined reset value unless marked. A register's access mark holds for its fields unless they carry their own. Offsets are from the block's base; lines under a group give offsets from that group; [hi:lo] are bit positions; {n}, {i} and the like mark numbered series; 'fields as' and 'values as' point back to an identical list; <NAME> marks a mode.

## Memory map
0x400BC000 SPIXFC_FIFO size 0x1000 — SPI XiP Master Controller FIFO.

## SPIXFC_FIFO — SPI XiP Master Controller FIFO.
Base 0x400BC000
0x00 TX_8 — SPI TX FIFO 8-Bit Write
0x00 TX_16 16-bit (alternate view of TX_8) — SPI TX FIFO 16-Bit Write
0x00 TX_32 32-bit (alternate view of TX_8) — SPI TX FIFO 32-Bit Write
0x04 RX_8 — SPI RX FIFO 8-Bit Access
0x04 RX_16 16-bit (alternate view of RX_8) — SPI RX FIFO 16-Bit Access
0x04 RX_32 32-bit (alternate view of RX_8) — SPI RX FIFO 32-Bit Access
