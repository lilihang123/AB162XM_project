# usr_aeskeys_reva_me21 register map
Registers are access not given, no defined reset value unless marked. A register's access mark holds for its fields unless they carry their own. Offsets are from the block's base; lines under a group give offsets from that group; [hi:lo] are bit positions; {n}, {i} and the like mark numbered series; 'fields as' and 'values as' point back to an identical list; <NAME> marks a mode.

## Memory map
0x40005000 USR_AESKEYS size 0x400 — User AES Key Registers.

## USR_AESKEYS — User AES Key Registers.
Base 0x40005000
0x00 SRAM_KEY 32-bit — AES SRAM KEY
0x20 CODE_KEY — AES CODE Key
0x40 DATA_KEY — AES DATA KEY
