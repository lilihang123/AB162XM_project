# aeskeys_me10 register map
Registers are 32-bit, access not given, no defined reset value unless marked. A register's access mark holds for its fields unless they carry their own. Offsets are from the block's base; lines under a group give offsets from that group; [hi:lo] are bit positions; {n}, {i} and the like mark numbered series; 'fields as' and 'values as' point back to an identical list; <NAME> marks a mode.

## Memory map
0x40007800 AESKEYS size 0x400 — AES Key Registers.

## AESKEYS — AES Key Registers.
Base 0x40007800
{0x0+4i} KEY0[{i}] (i=0..3) — AES Key 0.
{0x20+4i} KEY1[{i}] (i=0..3) — AES Key 1.
{0x100+4i} KEY2[{i}] (i=0..3) — AES Key 2.
{0x180+4i} KEY3[{i}] (i=0..3) — AES Key 3.
