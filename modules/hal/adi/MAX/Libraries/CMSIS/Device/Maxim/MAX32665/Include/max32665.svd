# max32665 register map
Vendor: Maxim-Integrated; Series: ARMCM3; File version: 1.0
MAX32665 32-bit ARM Cortex-M4 microcontroller, 128KB of system RAM, 4KB of One-Time-Programmable (OTP) memory, 64KB of Boot ROM, 8KB of battery-backed and AES self-encrypted SRAM.
CPU: CM4 r2p1, little endian, MPU, FPU, 3 interrupt priority bits
Registers are 32-bit, read-write, reset 0x0 unless marked. A register's access mark holds for its fields unless they carry their own. Offsets are from the block's base; lines under a group give offsets from that group; [hi:lo] are bit positions; {n}, {i} and the like mark numbered series; 'fields as' and 'values as' point back to an identical list; <NAME> marks a mode.

## Memory map
0x40000000 GCR size 0x400 — Global Control Registers.
0x40000400 SIR size 0x400 — System Initialization Registers.
0x40000800 FCR size 0x400 — Function Control.
0x40001000 TPU size 0x1000 — The Trust Protection Unit used to assist the computationally intensive operations of several common cryptographic algorithms.
0x40002000 RPU size 0x1000 — Resource Protection Unit
0x40003000 WDT0 size 0x400 — Watchdog Timer 0
0x40003400 WDT1 size 0x400 — Watchdog Timer 0 1
0x40003800 WDT2 size 0x400 — Watchdog Timer 0 2
0x40004000 SMON size 0x400 — The Security Monitor block used to monitor system threat conditions.
0x40004400 SIMO size 0x400 — Single Inductor Multiple Output Switching Converter
0x40004800 DVS size 0x30 — Dynamic Voltage Scaling
0x40005000 AESKEYS size 0x400 — AES Key Registers.
0x40005400 TRIMSIR size 0x400 — Trim System Initilazation Registers
0x40006000 RTC size 0x400 — Real Time Clock and Alarm.
0x40006400 WUT size 0x400 — Wake Up Timer
0x40006800 PWRSEQ size 0x400 — Power Sequencer / Low Power Control Register.
0x40006C00 MCR size 0x400 — Misc Control.
0x40008000 GPIO0 size 0x1000 — Individual I/O for each GPIO
0x40009000 GPIO1 size 0x1000 — Individual I/O for each GPIO 1
0x40010000 TMR0 size 0x1000 — 32-bit reloadable timer that can be used for timing and event counting.
0x40011000 TMR1 size 0x1000 — 32-bit reloadable timer that can be used for timing and event counting. 1
0x40012000 TMR2 size 0x1000 — 32-bit reloadable timer that can be used for timing and event counting. 2
0x40013000 TMR3 size 0x1000 — 32-bit reloadable timer that can be used for timing and event counting. 3
0x40014000 TMR4 size 0x1000 — 32-bit reloadable timer that can be used for timing and event counting. 4
0x40015000 TMR5 size 0x1000 — 32-bit reloadable timer that can be used for timing and event counting. 5
0x4001B000 HTMR size 0xFFF — High Speed Timer Module.
0x4001C000 HTMR1 size 0xFFF — High Speed Timer Module. 1
0x4001D000 I2C0 size 0x1000 — Inter-Integrated Circuit.
0x4001E000 I2C1 size 0x1000 — Inter-Integrated Circuit. 1
0x4001F000 I2C2 size 0x1000 — Inter-Integrated Circuit. 2
0x40026000 SPIXFM size 0x1000 — SPIXF Master
0x40027000 SPIXFC size 0x1000 — SPI XiP Flash Configuration Controller
0x40028000 DMA size 0x1000 — DMA Controller Fully programmable, chaining capable DMA channels.
0x40029000 FLC size 0x400 — Flash Memory Control.
0x40029400 FLC1 size 0x400 — Flash Memory Control. 1
0x4002A000 ICC0 size 0x1000 — Instruction Cache Controller Registers
0x40033000 SRCC size 0x1000 — External Memory Cache Controller Registers.
0x40034000 ADC size 0x1000 — 10-bit Analog to Digital Converter
0x40035000 DMA1 size 0x1000 — DMA Controller Fully programmable, chaining capable DMA channels.
0x4003A000 SPIXR size 0x1000 — SPIXR peripheral.
0x4003C000 PTG size 0x18 — Pulse Train Generation
0x4003C020 PT size 0x10 — Pulse Train
{0x4003C020+0x10*n} PT{n} size 0x10 (n=1..15) — Pulse Train {n}
0x4003D000 OWM size 0x1000 — 1-Wire Master Interface.
0x4003E000 SEMA size 0x1000 — The Semaphore peripheral allows multiple cores in a system to cooperate when accessing shred resources. The peripheral contains eight semaphores that can be atomically set and cleared. It is left to the discretion of the software architect to decide how and when the semaphores are used and how they are allocated. Existing hardware does not have to be modified for this type of cooperative sharing, and the use of semaphores is exclusively within the software domain.
0x40042000 UART0 size 0x1000 — UART
0x40043000 UART1 size 0x1000
0x40044000 UART2 size 0x1000
0x40046000 SPI1 size 0x1000 — SPI peripheral. 1
0x40047000 SPI2 size 0x1000 — SPI peripheral. 2
0x4004D000 TRNG size 0x1000 — Random Number Generator.
0x400B1000 USBHS size 0x1000 — USB 2.0 High-speed Controller.
0x400B6000 SDHC size 0x1000 — SDHC/SDIO Controller
0x400BC000 SPIXFC_FIFO size 0x1000 — SPI XiP Master Controller FIFO.
0x400BE000 SPI size 0x1000 — SPI peripheral.
0x4002AC000 ICC1 size 0x1000 — Instruction Cache Controller Registers 1

## Interrupts
1 WDT0
2 USB (USBHS)
3 RTC — RTC interrupt.
4 TRNG — TRNG interrupt.
5 TMR0 — TMR0 IRQ
6 TMR1 — TMR1 IRQ
7 TMR2 — TMR2 IRQ
8 TMR3 — TMR3 IRQ
9 TMR4 — TMR4 IRQ
10 TMR5 — TMR5 IRQ
13 I2C0 — I2C0 IRQ
14 UART0 — UART0 IRQ
15 UART1 — UART1 IRQ
16 SPI1 — SPI1 IRQ
17 SPI2 — SPI2 IRQ
20 ADC — ADC IRQ
23 Flash_Controller (FLC) — Flash Controller interrupt.
24 GPIO0 — GPIO0 interrupt.
25 GPIO1 — GPIO1 IRQ
27 Crypto_Engine (TPU) — Crypto Engine interrupt.
28 DMA0_CH0 (DMA)
29 DMA0_CH1 (DMA)
30 DMA0_CH2 (DMA)
31 DMA0_CH3 (DMA)
34 UART2 — UART2 IRQ
36 I2C1 — I2C1 IRQ
38 SPIXFC — SPIXFC IRQ
53 WUT
56 SPI0 (SPI)
57 WDT1 — WDT1 IRQ
59 PT (PTG) — Pulse Train IRQ
62 I2C2 — I2C2 IRQ
66 SDHC
67 OneWire (OWM)
68 DMA0_CH4 (DMA)
69 DMA0_CH5 (DMA)
70 DMA0_CH6 (DMA)
71 DMA0_CH7 (DMA)
{n+72} DMA1_CH{n} (DMA1) (n=0..7)
81 WDT2 — WDT2 IRQ
83 DVS — Dynamic Voltage Scaling Interrupt
87 FLC1 — FLC1 IRQ
93 HTimer (HTMR) — HTimer interrupt.
94 HTMR1 — HTMR1 IRQ
